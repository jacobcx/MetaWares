AUTOSAR XML (schema 4-2-2)
package /VSTAR/CanTrcv_TJA1145/BswDescr
  bsw module description CanTrcv: module-id=70
    bsw internal behavior CanTrcv_BswBehavior
      7 x exclusive area:
        SCHM_CANTRCV_EXCLUSIVE_AREA_{0..6}
      bsw schedulable entity CanTrcv_MainFunction: can-enter-exclusive-area=[SCHM_CANTRCV_EXCLUSIVE_AREA_1, SCHM_CANTRCV_EXCLUSIVE_AREA_2, SCHM_CANTRCV_EXCLUSIVE_AREA_3, SCHM_CANTRCV_EXCLUSIVE_AREA_4, SCHM_CANTRCV_EXCLUSIVE_AREA_5, SCHM_CANTRCV_EXCLUSIVE_AREA_6], implemented-entry=CanTrcv_MainFunction
      6 x bsw called entity:
        CanTrcv_31_TJA1145_GetBusWuReason: can-enter-exclusive-area=SCHM_CANTRCV_EXCLUSIVE_AREA_1, implemented-entry=CanTrcv_31_TJA1145_GetBusWuReason
        CanTrcv_31_TJA1145_GetOpMode: can-enter-exclusive-area=SCHM_CANTRCV_EXCLUSIVE_AREA_1, implemented-entry=CanTrcv_31_TJA1145_GetOpMode
        CanTrcv_Init: can-enter-exclusive-area=SCHM_CANTRCV_EXCLUSIVE_AREA_1, implemented-entry=CanTrcv_Init
        CanTrcv_SetOpMode: can-enter-exclusive-area=[SCHM_CANTRCV_EXCLUSIVE_AREA_1, SCHM_CANTRCV_EXCLUSIVE_AREA_3], implemented-entry=CanTrcv_SetOpMode
        CanTrcv_SetWakeupMode: can-enter-exclusive-area=[SCHM_CANTRCV_EXCLUSIVE_AREA_1, SCHM_CANTRCV_EXCLUSIVE_AREA_0, SCHM_CANTRCV_EXCLUSIVE_AREA_2], implemented-entry=CanTrcv_SetWakeupMode
        CanTrcv_CheckWakeup: can-enter-exclusive-area=[SCHM_CANTRCV_EXCLUSIVE_AREA_0, SCHM_CANTRCV_EXCLUSIVE_AREA_2], implemented-entry=CanTrcv_CheckWakeup
      bsw schedulable entity CanTrcv_MainFunctionDiagnostics: can-enter-exclusive-area=SCHM_CANTRCV_EXCLUSIVE_AREA_6, implemented-entry=CanTrcv_MainFunctionDiagnostics
      8 x bsw called entity:
        CanTrcv_GetVersionInfo: implemented-entry=CanTrcv_GetVersionInfo
        CanTrcv_GetTrcvSystemData: implemented-entry=CanTrcv_GetTrcvSystemData
        CanTrcv_ClearTrcvWufFlag: can-enter-exclusive-area=SCHM_CANTRCV_EXCLUSIVE_AREA_4, implemented-entry=CanTrcv_ClearTrcvWufFlag
        CanTrcv_ReadTrcvTimeoutFlag: implemented-entry=CanTrcv_ReadTrcvTimeoutFlag
        CanTrcv_ClearTrcvTimeoutFlag: implemented-entry=CanTrcv_ClearTrcvTimeoutFlag
        CanTrcv_ReadTrcvSilenceFlag: implemented-entry=CanTrcv_ReadTrcvSilenceFlag
        CanTrcv_SetPNActivationState: implemented-entry=CanTrcv_SetPNActivationState
        CanTrcv_CheckWakeFlag: implemented-entry=CanTrcv_CheckWakeFlag
      bsw timing event Evt_CanTrcv_MainFunction: starts-on-event=CanTrcv_MainFunction, period=0.01
      bsw timing event Evt_CanTrcv_MainFunctionDiagnostics: starts-on-event=CanTrcv_MainFunctionDiagnostics, period=0.01
  16 x bsw module entry, all with execution-context=TASK:
    CanTrcv_Init: service-id=0, is-reentrant=false, is-synchronous=true, call-type=REGULAR
    CanTrcv_SetOpMode: service-id=1, is-reentrant=true, is-synchronous=false, call-type=REGULAR
    CanTrcv_GetOpMode: service-id=2, is-reentrant=true, is-synchronous=true, call-type=REGULAR
    CanTrcv_GetBusWuReason: service-id=3, is-reentrant=true, is-synchronous=true, call-type=REGULAR
    CanTrcv_GetVersionInfo: service-id=4, is-reentrant=true, is-synchronous=true, call-type=REGULAR
    CanTrcv_SetWakeupMode: service-id=5, is-reentrant=true, is-synchronous=true, call-type=REGULAR
    CanTrcv_CheckWakeup: service-id=7, is-reentrant=true, is-synchronous=true, call-type=REGULAR
    CanTrcv_MainFunction: service-id=6, is-reentrant=false, is-synchronous=true, call-type=SCHEDULED
    CanTrcv_GetTrcvSystemData: service-id=9, is-reentrant=false, is-synchronous=true, call-type=REGULAR
    CanTrcv_ClearTrcvWufFlag: service-id=10, is-reentrant=true, is-synchronous=true, call-type=REGULAR
    CanTrcv_ReadTrcvTimeoutFlag: service-id=11, is-synchronous=true, call-type=REGULAR
    CanTrcv_ClearTrcvTimeoutFlag: service-id=12, is-reentrant=false, is-synchronous=false, call-type=REGULAR
    CanTrcv_ReadTrcvSilenceFlag: service-id=13, is-reentrant=false, is-synchronous=true, call-type=REGULAR
    CanTrcv_SetPNActivationState: service-id=15, is-reentrant=false, is-synchronous=true, call-type=REGULAR
    CanTrcv_CheckWakeFlag: service-id=14, is-reentrant=false, is-synchronous=true, call-type=REGULAR
    CanTrcv_MainFunctionDiagnostics: service-id=8, is-reentrant=false, is-synchronous=true, call-type=SCHEDULED
