AUTOSAR XML (schema 4-2-2)
# Copyright 2016 Mentor Graphics Corporation
# All Rights Reserved
# THIS WORK CONTAINS TRADE SECRET
# AND PROPRIETARY INFORMATION WHICH IS THE
# PROPERTY OF MENTOR GRAPHICS
# CORPORATION OR ITS LICENSORS AND IS
# SUBJECT TO LICENSE TERMS.
package /VSTAR/BswMd
  bsw module description CanSM: module-id=140
    bsw internal behavior BswBehavior_CanSM
      exclusive area Area_0
      bsw schedulable entity CanSM_MainFunction: can-enter-exclusive-area=Area_0, implemented-entry=CanSM_MainFunction
      14 x bsw called entity:
        CanSM_ControllerBusOff: can-enter-exclusive-area=Area_0, implemented-entry=CanSM_ControllerBusOff
        CanSM_ControllerModeIndication: can-enter-exclusive-area=Area_0, implemented-entry=CanSM_ControllerModeIndication
        CanSM_GetCurrentComMode: implemented-entry=CanSM_GetCurrentComMode
        CanSM_GetVersionInfo: implemented-entry=CanSM_GetVersionInfo
        CanSM_Init: can-enter-exclusive-area=Area_0, implemented-entry=CanSM_Init
        CanSM_RequestComMode: implemented-entry=CanSM_RequestComMode
        CanSM_TransceiverModeIndication: can-enter-exclusive-area=Area_0, implemented-entry=CanSM_TransceiverModeIndication
        CanSM_ConfirmPnAvailability: can-enter-exclusive-area=Area_0, implemented-entry=CanSM_ConfirmPnAvailability
        CanSM_CheckTranseiverWakeFlagIndication: can-enter-exclusive-area=Area_0, implemented-entry=CanSM_CheckTransceiverWakeFlagIndication
        CanSM_ClearTrcvWufFlagIndication: can-enter-exclusive-area=Area_0, implemented-entry=CanSM_ClearTrcvWufFlagIndication
        CanSM_TxTimeoutException: can-enter-exclusive-area=Area_0, implemented-entry=CanSM_TxTimeoutException
        CanSM_ChangeBaudrate: can-enter-exclusive-area=Area_0, implemented-entry=CanSM_ChangeBaudrate
        CanSM_CheckBaudrate: can-enter-exclusive-area=Area_0, implemented-entry=CanSM_CheckBaudrate
        CanSM_SetEcuPassive: implemented-entry=CanSM_SetEcuPassive
      bsw timing event Evt_CanSM_MainFunction: starts-on-event=CanSM_MainFunction, period=0.01
      service-needs:
        diagnostic event needs CanCluster_DemEvent_EVENT
package /AUTOSAR_CanSM/BswModuleEntrys
  15 x bsw module entry, all with sw-service-impl-policy=STANDARD:
    CanSM_ControllerBusOff: service-id=4, is-reentrant=true, is-synchronous=true, call-type=CALLBACK, execution-context=UNSPECIFIED
    CanSM_ControllerModeIndication: service-id=7, is-reentrant=true, is-synchronous=true, call-type=CALLBACK, execution-context=UNSPECIFIED
    CanSM_GetCurrentComMode: service-id=3, is-reentrant=true, is-synchronous=true, call-type=REGULAR, execution-context=TASK
    CanSM_GetVersionInfo: service-id=1, is-reentrant=true, is-synchronous=true, call-type=REGULAR, execution-context=TASK
    CanSM_Init: service-id=0, is-reentrant=false, is-synchronous=true, call-type=REGULAR, execution-context=TASK
    CanSM_MainFunction: service-id=5, is-reentrant=false, is-synchronous=true, call-type=SCHEDULED, execution-context=TASK
    CanSM_RequestComMode: service-id=2, is-reentrant=true, is-synchronous=true, call-type=REGULAR, execution-context=TASK
    CanSM_TransceiverModeIndication: service-id=9, is-reentrant=false, is-synchronous=true, call-type=CALLBACK, execution-context=UNSPECIFIED
    CanSM_CheckBaudrate: service-id=12, is-reentrant=true, is-synchronous=true, call-type=REGULAR, execution-context=TASK
    CanSM_ChangeBaudrate: service-id=14, is-reentrant=true, call-type=REGULAR, execution-context=TASK
    CanSM_TxTimeoutException: service-id=11, is-reentrant=true, is-synchronous=true, call-type=CALLBACK, execution-context=TASK
    CanSM_ClearTrcvWufFlagIndication: service-id=8, is-reentrant=true, is-synchronous=true, call-type=CALLBACK, execution-context=TASK
    CanSM_CheckTransceiverWakeFlagIndication: service-id=10, is-reentrant=true, is-synchronous=true, call-type=CALLBACK, execution-context=TASK
    CanSM_ConfirmPnAvailability: service-id=6, is-reentrant=true, is-synchronous=true, call-type=CALLBACK, execution-context=TASK
    CanSM_SetEcuPassive: service-id=19, is-reentrant=false, is-synchronous=true, call-type=REGULAR, execution-context=TASK
