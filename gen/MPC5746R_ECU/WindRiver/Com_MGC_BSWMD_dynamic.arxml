AUTOSAR XML (schema 4-2-2)
# Copyright 2016 Mentor Graphics Corporation
# All Rights Reserved
# THIS WORK CONTAINS TRADE SECRET
# AND PROPRIETARY INFORMATION WHICH IS THE
# PROPERTY OF MENTOR GRAPHICS
# CORPORATION OR ITS LICENSORS AND IS
# SUBJECT TO LICENSE TERMS.
package /VSTAR/BswMd
  bsw module description Com: module-id=50
    bsw internal behavior BswBehavior_Com
      14 x exclusive area:
        COM_RXIND_DEFERRED_BACKGROUND
        COM_RXIND_IMMEDIATE_BACKGROUND
        COM_MAIN_IMMEDIATE_BACKGROUND
        COM_MAIN_DEFERRED_BACKGROUND
        COM_MAIN_DEFERRED_FOREGROUND
        COM_APPLICAITON_BACKGROUND
        COM_APPLICAITON_FOREGROUND
        COM_TP_BACKGROUND
        COM_TP_FOREGROUND
        COM_APPLICATION_TXIPDU
        COM_MAIN_TXIPDU
        COM_TXCONF_TXIPDU
        COM_TRIGGER_TXIPDU
        COM_TP_TXIPDU
      bsw schedulable entity Com_MainFunctionRx: can-enter-exclusive-area=[COM_MAIN_IMMEDIATE_BACKGROUND, COM_MAIN_DEFERRED_BACKGROUND, COM_MAIN_DEFERRED_FOREGROUND], implemented-entry=Com_MainFunctionRx
      bsw schedulable entity Com_MainFunctionTx: can-enter-exclusive-area=COM_MAIN_TXIPDU, implemented-entry=Com_MainFunctionTx
      29 x bsw called entity:
        Com_ClearIpduGroupVector: implemented-entry=Com_ClearIpduGroupVector
        Com_CopyRxData: can-enter-exclusive-area=COM_TP_BACKGROUND, implemented-entry=Com_CopyRxData
        Com_CopyTxData: can-enter-exclusive-area=COM_TP_TXIPDU, implemented-entry=Com_CopyTxData
        Com_DeInit: implemented-entry=Com_DeInit
        Com_GetConfigurationId: implemented-entry=Com_GetConfigurationId
        Com_GetStatus: implemented-entry=Com_GetStatus
        Com_GetVersionInfo: implemented-entry=Com_GetVersionInfo
        Com_Init: implemented-entry=Com_Init
        Com_InvalidateShadowSignal: can-enter-exclusive-area=COM_APPLICATION_TXIPDU, implemented-entry=Com_InvalidateShadowSignal
        Com_InvalidateSignal: can-enter-exclusive-area=COM_APPLICATION_TXIPDU, implemented-entry=Com_InvalidateSignal
        Com_InvalidateSignalGroup: can-enter-exclusive-area=COM_APPLICATION_TXIPDU, implemented-entry=Com_InvalidateSignalGroup
        Com_IpduGroupControl: implemented-entry=Com_IpduGroupControl
        Com_ReceiveDynSignal: can-enter-exclusive-area=[COM_APPLICAITON_BACKGROUND, COM_APPLICAITON_FOREGROUND], implemented-entry=Com_ReceiveDynSignal
        Com_ReceiveShadowSignal: can-enter-exclusive-area=COM_APPLICAITON_FOREGROUND, implemented-entry=Com_ReceiveShadowSignal
        Com_ReceiveSignal: can-enter-exclusive-area=[COM_APPLICAITON_BACKGROUND, COM_APPLICAITON_FOREGROUND], implemented-entry=Com_ReceiveSignal
        Com_ReceiveSignalGroup: can-enter-exclusive-area=[COM_APPLICAITON_BACKGROUND, COM_APPLICAITON_FOREGROUND], implemented-entry=Com_ReceiveSignalGroup
        Com_ReceptionDMControl: implemented-entry=Com_ReceptionDMControl
        Com_RxIndication: can-enter-exclusive-area=[COM_RXIND_DEFERRED_BACKGROUND, COM_RXIND_IMMEDIATE_BACKGROUND], implemented-entry=Com_RxIndication
        Com_SendDynSignal: can-enter-exclusive-area=COM_APPLICATION_TXIPDU, implemented-entry=Com_SendDynSignal
        Com_SendSignal: can-enter-exclusive-area=COM_APPLICATION_TXIPDU, implemented-entry=Com_SendSignal
        Com_SendSignalGroup: implemented-entry=Com_SendSignalGroup
        Com_SetIpduGroup: implemented-entry=Com_SetIpduGroup
        Com_StartOfReception: implemented-entry=Com_StartOfReception
        Com_SwitchIpduTxMode: implemented-entry=Com_SwitchIpduTxMode
        Com_TpRxIndication: can-enter-exclusive-area=[COM_TP_BACKGROUND, COM_TP_FOREGROUND], implemented-entry=Com_TpRxIndication
        Com_TpTxConfirmation: can-enter-exclusive-area=COM_TXCONF_TXIPDU, implemented-entry=Com_TpTxConfirmation
        Com_TriggerTransmit: can-enter-exclusive-area=COM_TRIGGER_TXIPDU, implemented-entry=Com_TriggerTransmit
        Com_TxConfirmation: can-enter-exclusive-area=COM_TXCONF_TXIPDU, implemented-entry=Com_TxConfirmation
        Com_UpdateShadowSignal: can-enter-exclusive-area=COM_APPLICATION_TXIPDU, implemented-entry=Com_UpdateShadowSignal
      bsw timing event Evt_Com_MainFunctionRx: starts-on-event=Com_MainFunctionRx, period=0.01
      bsw timing event Evt_Com_MainFunctionTx: starts-on-event=Com_MainFunctionTx, period=0.01
  bsw module description ComXf: module-id=175
    bsw internal behavior BswBehavior_ComXf
      bsw called entity ComXf_Init: implemented-entry=ComXf_Init
      bsw called entity ComXf_DeInit: implemented-entry=ComXf_DeInit
      bsw called entity ComXf_GetVersionInfo: implemented-entry=ComXf_GetVersionInfo
package /AUTOSAR_Com/BswModuleEntrys
  32 x bsw module entry, all with sw-service-impl-policy=STANDARD:
    Com_Init: service-id=1, is-reentrant=false, is-synchronous=true, call-type=REGULAR, execution-context=TASK
    Com_DeInit: service-id=2, is-reentrant=false, is-synchronous=true, call-type=REGULAR, execution-context=TASK
    Com_IpduGroupControl: service-id=3, is-reentrant=false, is-synchronous=true, call-type=REGULAR, execution-context=TASK
    Com_ReceptionDMControl: service-id=6, is-reentrant=false, is-synchronous=true, call-type=REGULAR, execution-context=TASK
    Com_GetStatus: service-id=7, is-reentrant=true, is-synchronous=true, call-type=REGULAR, execution-context=TASK
    Com_GetConfigurationId: service-id=8, is-reentrant=false, is-synchronous=true, call-type=REGULAR, execution-context=TASK
    Com_GetVersionInfo: service-id=9, is-reentrant=false, is-synchronous=true, call-type=REGULAR, execution-context=TASK
    Com_ClearIpduGroupVector: service-id=28, is-reentrant=false, is-synchronous=true, call-type=REGULAR, execution-context=TASK
    Com_SetIpduGroup: service-id=29, is-reentrant=false, is-synchronous=true, call-type=REGULAR, execution-context=TASK
    Com_SendSignal: service-id=10, is-reentrant=true, is-synchronous=false, call-type=REGULAR, execution-context=TASK
    Com_SendDynSignal: service-id=33, is-reentrant=true, is-synchronous=false, call-type=REGULAR, execution-context=TASK
    Com_ReceiveSignal: service-id=11, is-reentrant=true, is-synchronous=true, call-type=REGULAR, execution-context=TASK
    Com_ReceiveDynSignal: service-id=34, is-reentrant=true, is-synchronous=true, call-type=REGULAR, execution-context=TASK
    Com_UpdateShadowSignal: service-id=12, is-reentrant=true, is-synchronous=true, call-type=REGULAR, execution-context=TASK
    Com_SendSignalGroup: service-id=13, is-reentrant=true, is-synchronous=false, call-type=REGULAR, execution-context=TASK
    Com_ReceiveSignalGroup: service-id=14, is-reentrant=true, is-synchronous=true, call-type=REGULAR, execution-context=TASK
    Com_ReceiveShadowSignal: service-id=15, is-reentrant=true, is-synchronous=true, call-type=REGULAR, execution-context=TASK
    Com_InvalidateSignal: service-id=16, is-reentrant=true, is-synchronous=false, call-type=REGULAR, execution-context=TASK
    Com_InvalidateShadowSignal: service-id=22, is-reentrant=true, is-synchronous=true, call-type=REGULAR, execution-context=TASK
    Com_InvalidateSignalGroup: service-id=27, is-reentrant=true, is-synchronous=false, call-type=REGULAR, execution-context=TASK
    Com_TriggerIPDUSend: service-id=23, is-reentrant=false, is-synchronous=true, call-type=REGULAR, execution-context=TASK
    Com_SwitchIpduTxMode: service-id=39, is-reentrant=true, is-synchronous=false, call-type=REGULAR, execution-context=TASK
    Com_TriggerTransmit: service-id=65, is-reentrant=true, is-synchronous=true, call-type=CALLBACK, execution-context=INTERRUPT-CAT-1
    Com_RxIndication: service-id=66, is-reentrant=true, is-synchronous=true, call-type=CALLBACK, execution-context=INTERRUPT-CAT-1
    Com_TpRxIndication: service-id=30, is-reentrant=true, is-synchronous=true, call-type=CALLBACK, execution-context=INTERRUPT-CAT-1
    Com_TxConfirmation: service-id=64, is-reentrant=true, is-synchronous=true, call-type=CALLBACK, execution-context=INTERRUPT-CAT-1
    Com_TpTxConfirmation: service-id=38, is-reentrant=true, is-synchronous=true, call-type=CALLBACK, execution-context=TASK
    Com_StartOfReception: service-id=37, is-reentrant=true, is-synchronous=true, call-type=CALLBACK, execution-context=TASK
    Com_CopyRxData: service-id=35, is-reentrant=true, is-synchronous=true, call-type=CALLBACK, execution-context=INTERRUPT-CAT-1
    Com_CopyTxData: service-id=36, is-reentrant=true, is-synchronous=true, call-type=CALLBACK, execution-context=INTERRUPT-CAT-1
    Com_MainFunctionRx: service-id=24, is-reentrant=false, is-synchronous=true, call-type=SCHEDULED, execution-context=TASK
    Com_MainFunctionTx: service-id=25, is-reentrant=false, is-synchronous=true, call-type=SCHEDULED, execution-context=TASK
package /AUTOSAR_ComXf/BswModuleEntrys
  bsw module entry ComXf_Init: service-id=1, is-reentrant=true, is-synchronous=true, call-type=REGULAR, execution-context=TASK, sw-service-impl-policy=STANDARD
  bsw module entry ComXf_DeInit: service-id=2, is-reentrant=true, is-synchronous=true, call-type=REGULAR, execution-context=TASK, sw-service-impl-policy=STANDARD
  bsw module entry ComXf_GetVersionInfo: service-id=0, is-reentrant=true, is-synchronous=true, call-type=REGULAR, execution-context=TASK, sw-service-impl-policy=STANDARD
