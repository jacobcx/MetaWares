AUTOSAR XML (schema 4-2-2)
# Copyright 2017 Mentor Graphics Corporation
# All rights reserved
# THIS WORK CONTAINS TRADE SECRET AND PROPRIETARY INFORMATION WHICH IS
# THE PROPERTY OF MENTOR GRAPHICS CORPORATION OR ITS LICENSORS AND IS
# SUBJECT TO LICENSE TERMS.
package /VSTAR/BswMd
  bsw implementation BswImpl_Rte: programming-language=C, sw-version=6.1.1, used-code-generator=vstar_rte_scg.exe, vendor-id=31, ar-release-version=4.2.2, behavior=BswBehavior_Rte, vendor-specific-module-def=Rte
    generated-artifacts:
      4 x dependency on artifact, all with usages=CODEGENERATION:
        Rte_Type_h: artifact-descriptor={short-label=Rte_Type.h, category=SWHDR}
        Rte_Os_Type_h: artifact-descriptor={short-label=Rte_Os_Type.h, category=SWHDR}
        Rte_Os_h: artifact-descriptor={short-label=Rte_Os.h, category=SWHDR}
        Rte_DataHandleType_h: artifact-descriptor={short-label=Rte_DataHandleType.h, category=SWHDR}
    resource consumption Rc
      memory section CODE: sw-addrmethod=CODE
      memory section CONST_UNSPECIFIED: alignment=UNSPECIFIED, sw-addrmethod=CONST
  bsw module description Rte: module-id=002  # RTE
    bsw internal behavior BswBehavior_Rte
