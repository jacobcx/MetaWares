AUTOSAR XML (schema 4.0)
package /VSTAR/BswMd
  bsw implementation BswImpl_Os: behavior=BswBehavior_Os, vendor-specific-module-def=Os
    resource consumption ResConsumption_Os
      26 x memory section, all with alignment=32, sw-addrmethod=VAR_NO_INIT:
        OS_CAT2_ISR_LEVEL_P6_Core1_App0_STACK_VAR_NO_INIT
        OS_CAT2_ISR_LEVEL_P7_Core1_App0_STACK_VAR_NO_INIT
        MasterBlinker_STACK_VAR_NO_INIT
        OS_CAT2_ISR_LEVEL_P5_Core1_App0_STACK_VAR_NO_INIT
        MasterController_STACK_VAR_NO_INIT
        MasterFastBlinker_STACK_VAR_NO_INIT
        OsTask_Core0_20ms_STACK_VAR_NO_INIT
        OsTask_Core1_10ms_STACK_VAR_NO_INIT
        OsTask_Core1_StartUp_STACK_VAR_NO_INIT
        SlaveBlinker_STACK_VAR_NO_INIT
        OS_CAT2_ISR_LEVEL_P5_Core1_App1_STACK_VAR_NO_INIT
        SlaveController_STACK_VAR_NO_INIT
        SlaveFastBlinker_STACK_VAR_NO_INIT
        OS_CAT2_ISR_LEVEL_P6_Core1_App0_CONTEXT_VAR_NO_INIT
        OS_CAT2_ISR_LEVEL_P7_Core1_App0_CONTEXT_VAR_NO_INIT
        MasterBlinker_CONTEXT_VAR_NO_INIT
        OS_CAT2_ISR_LEVEL_P5_Core1_App0_CONTEXT_VAR_NO_INIT
        MasterController_CONTEXT_VAR_NO_INIT
        MasterFastBlinker_CONTEXT_VAR_NO_INIT
        OsTask_Core0_20ms_CONTEXT_VAR_NO_INIT
        OsTask_Core1_10ms_CONTEXT_VAR_NO_INIT
        OsTask_Core1_StartUp_CONTEXT_VAR_NO_INIT
        SlaveBlinker_CONTEXT_VAR_NO_INIT
        OS_CAT2_ISR_LEVEL_P5_Core1_App1_CONTEXT_VAR_NO_INIT
        SlaveController_CONTEXT_VAR_NO_INIT
        SlaveFastBlinker_CONTEXT_VAR_NO_INIT
  bsw module description Os: module-id=1
    bsw internal behavior BswBehavior_Os
