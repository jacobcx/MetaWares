AUTOSAR XML (schema 4-2-2)
# Copyright 2017 Mentor Graphics Corporation
# All rights reserved
# THIS WORK CONTAINS TRADE SECRET AND PROPRIETARY INFORMATION WHICH IS
# THE PROPERTY OF MENTOR GRAPHICS CORPORATION OR ITS LICENSORS AND IS
# SUBJECT TO LICENSE TERMS.
package /VSTAR/BswMd
  data type mapping set DcmModeMappingSet
    mode-request-type-maps:
      implementation-data-type=uint8, mode-group=DcmCommunicationControl
      implementation-data-type=uint8, mode-group=DcmControlDTCSetting
      implementation-data-type=uint8, mode-group=DcmDiagnosticSessionControl
      implementation-data-type=uint8, mode-group=DcmEcuReset
      implementation-data-type=uint8, mode-group=DcmModeRapidPowerShutDown
  6 x mode declaration group, all with category=EXPLICIT_ORDER:
    DcmDiagnosticSessionControl: initial-mode=DEFAULT_SESSION, on-transition-value=255
      mode DEFAULT_SESSION: value=1
      mode PROGRAMMING_SESSION: value=2
      mode EXTENDED_DIAGNOSTIC_SESSION: value=3
    DcmEcuReset: initial-mode=NONE, on-transition-value=7
      7 x mode:
        NONE: value=0
        HARD: value=1
        KEYONOFF: value=2
        SOFT: value=3
        JUMPTOBOOTLOADER: value=4
        JUMPTOSYSSUPPLIERBOOTLOADER: value=5
        EXECUTE: value=6
    DcmModeRapidPowerShutDown: initial-mode=ENABLE_RAPIDPOWERSHUTDOWN, on-transition-value=2
      mode ENABLE_RAPIDPOWERSHUTDOWN: value=0
      mode DISABLE_RAPIDPOWERSHUTDOWN: value=1
    DcmControlDTCSetting: initial-mode=ENABLEDTCSETTING, on-transition-value=2
      mode ENABLEDTCSETTING: value=0
      mode DISABLEDTCSETTING: value=1
    DcmCommunicationControl: initial-mode=DCM_ENABLE_RX_TX_NORM, on-transition-value=12
      12 x mode:
        DCM_ENABLE_RX_TX_NORM: value=0
        DCM_ENABLE_RX_DISABLE_TX_NORM: value=1
        DCM_DISABLE_RX_ENABLE_TX_NORM: value=2
        DCM_DISABLE_RX_TX_NORMAL: value=3
        DCM_ENABLE_RX_TX_NM: value=4
        DCM_ENABLE_RX_DISABLE_TX_NM: value=5
        DCM_DISABLE_RX_ENABLE_TX_NM: value=6
        DCM_DISABLE_RX_TX_NM: value=7
        DCM_ENABLE_RX_TX_NORM_NM: value=8
        DCM_ENABLE_RX_DISABLE_TX_NORM_NM: value=9
        DCM_DISABLE_RX_ENABLE_TX_NORM_NM: value=10
        DCM_DISABLE_RX_TX_NORM_NM: value=11
    DcmResponseOnEvent: initial-mode=EVENT_CLEARED, on-transition-value=3
      mode EVENT_STARTED: value=0
      mode EVENT_STOPPED: value=1
      mode EVENT_CLEARED: value=2
  bsw module description Dcm: module-id=35  # Diagnostic Communication Manager
    provided-entrys:
      Dcm_GetVersionInfo
      Dcm_MainFunction
      Dcm_Init
      Dcm_StartOfReception
      Dcm_CopyRxData
      Dcm_TpRxIndication
      Dcm_CopyTxData
      Dcm_TpTxConfirmation
      Dcm_TxConfirmation
      Dcm_ComM_NoComModeEntered
      Dcm_ComM_SilentComModeEntered
      Dcm_ComM_FullComModeEntered
      Dcm_DemTriggerOnDTCStatus
      Dcm_TriggerOnEvent
      Dcm_ResetToDefaultSession
    provided-mode-groups:
      5 x mode declaration group prototype:
        DcmEcuReset: type=DcmEcuReset
        DcmModeRapidPowerShutDown: type=DcmModeRapidPowerShutDown
        DcmControlDTCSetting: type=DcmControlDTCSetting
        DcmCommunicationControl: type=DcmCommunicationControl
        DcmDiagnosticSessionControl: type=DcmDiagnosticSessionControl
    bsw internal behavior BswBehavior_Dcm: data-type-mapping=DcmModeMappingSet
      exclusive area EaRxBuffers  # Dcm_EaRxBuffers | Exclusive area for Rx buffers in the Dcm
      exclusive area EaTimers  # Dcm_EaTimers | Exclusive area for timers in the Dcm
      9 x bsw internal triggering point:
        IntTrP_Dcm_ClearDiagnosticInformation
        IntTrP_Dcm_DiagnosticSessionControl
        IntTrP_Dcm_ReadDTCInformation
        IntTrP_Dcm_ReadDataByIdentifier
        IntTrP_Dcm_SecurityAccess
        IntTrP_Dcm_TesterPresent
        IntTrP_Dcm_WriteDataByIdentifier
        IntTrP_DslStateMachine
        IntTrP_DsdStateMachine
      10 x bsw schedulable entity:
        SE_Dcm_ClearDiagnosticInformation: activation-points=IntTrP_DsdStateMachine, implemented-entry=Dcm_SE_Dcm_ClearDiagnosticInformation
        SE_Dcm_DiagnosticSessionControl: activation-points=IntTrP_DsdStateMachine, implemented-entry=Dcm_SE_Dcm_DiagnosticSessionControl, managed-mode-groups=DcmEcuReset
        SE_Dcm_MainFunction: can-enter-exclusive-area=EaTimers, activation-points=[IntTrP_DslStateMachine, IntTrP_DsdStateMachine], implemented-entry=Dcm_MainFunction
          managed-mode-groups:
            DcmCommunicationControl
            DcmControlDTCSetting
            DcmDiagnosticSessionControl
            DcmEcuReset
            DcmModeRapidPowerShutDown
        SE_Dcm_ReadDTCInformation: activation-points=IntTrP_DsdStateMachine, implemented-entry=Dcm_SE_Dcm_ReadDTCInformation
        SE_Dcm_ReadDataByIdentifier: activation-points=IntTrP_DsdStateMachine, implemented-entry=Dcm_SE_Dcm_ReadDataByIdentifier
        SE_Dcm_SecurityAccess: activation-points=IntTrP_DsdStateMachine, implemented-entry=Dcm_SE_Dcm_SecurityAccess
        SE_Dcm_TesterPresent: activation-points=IntTrP_DsdStateMachine, implemented-entry=Dcm_SE_Dcm_TesterPresent
        SE_Dcm_WriteDataByIdentifier: activation-points=IntTrP_DsdStateMachine, implemented-entry=Dcm_SE_Dcm_WriteDataByIdentifier
        SE_DsdStateMachine: implemented-entry=Dcm_SE_DsdStateMachine
          activation-points:
            IntTrP_DslStateMachine
            IntTrP_DsdStateMachine
            IntTrP_Dcm_ClearDiagnosticInformation
            IntTrP_Dcm_DiagnosticSessionControl
            IntTrP_Dcm_ReadDTCInformation
            IntTrP_Dcm_ReadDataByIdentifier
            IntTrP_Dcm_SecurityAccess
            IntTrP_Dcm_TesterPresent
            IntTrP_Dcm_WriteDataByIdentifier
        SE_DslStateMachine: activation-points=[IntTrP_DslStateMachine, IntTrP_DsdStateMachine], implemented-entry=Dcm_SE_DslStateMachine
      11 x bsw called entity:
        Dcm_ComM_FullComModeEntered: implemented-entry=Dcm_ComM_FullComModeEntered
        Dcm_ComM_NoComModeEntered: implemented-entry=Dcm_ComM_NoComModeEntered
        Dcm_ComM_SilentComModeEntered: implemented-entry=Dcm_ComM_SilentComModeEntered
        Dcm_CopyRxData: implemented-entry=Dcm_CopyRxData
        Dcm_CopyTxData: activation-points=IntTrP_DslStateMachine, implemented-entry=Dcm_CopyTxData
        Dcm_Init: can-enter-exclusive-area=EaTimers, implemented-entry=Dcm_Init
        Dcm_ResetToDefaultSession: activation-points=IntTrP_DslStateMachine, implemented-entry=Dcm_ResetToDefaultSession
        Dcm_StartOfReception: can-enter-exclusive-area=[EaTimers, EaRxBuffers], activation-points=IntTrP_DslStateMachine, implemented-entry=Dcm_StartOfReception
        Dcm_TpRxIndication: can-enter-exclusive-area=EaTimers, activation-points=IntTrP_DslStateMachine, implemented-entry=Dcm_TpRxIndication
        Dcm_TpTxConfirmation: can-enter-exclusive-area=EaTimers, activation-points=IntTrP_DsdStateMachine, implemented-entry=Dcm_TpTxConfirmation
        Dcm_TxConfirmation: can-enter-exclusive-area=EaTimers, activation-points=IntTrP_DsdStateMachine, implemented-entry=Dcm_TxConfirmation
      bsw timing event Evt_Dcm_MainFunction: starts-on-event=SE_Dcm_MainFunction, period=0.01
      9 x bsw internal trigger occurred event:
        IntTrOccEv_Dcm_ClearDiagnosticInformation: starts-on-event=SE_Dcm_ClearDiagnosticInformation, event-source=IntTrP_Dcm_ClearDiagnosticInformation
        IntTrOccEv_Dcm_DiagnosticSessionControl: starts-on-event=SE_Dcm_DiagnosticSessionControl, event-source=IntTrP_Dcm_DiagnosticSessionControl
        IntTrOccEv_Dcm_ReadDTCInformation: starts-on-event=SE_Dcm_ReadDTCInformation, event-source=IntTrP_Dcm_ReadDTCInformation
        IntTrOccEv_Dcm_ReadDataByIdentifier: starts-on-event=SE_Dcm_ReadDataByIdentifier, event-source=IntTrP_Dcm_ReadDataByIdentifier
        IntTrOccEv_Dcm_SecurityAccess: starts-on-event=SE_Dcm_SecurityAccess, event-source=IntTrP_Dcm_SecurityAccess
        IntTrOccEv_Dcm_TesterPresent: starts-on-event=SE_Dcm_TesterPresent, event-source=IntTrP_Dcm_TesterPresent
        IntTrOccEv_Dcm_WriteDataByIdentifier: starts-on-event=SE_Dcm_WriteDataByIdentifier, event-source=IntTrP_Dcm_WriteDataByIdentifier
        IntTrOccEv_DslStateMachine: starts-on-event=SE_DslStateMachine, event-source=IntTrP_DslStateMachine
        IntTrOccEv_DsdStateMachine: starts-on-event=SE_DsdStateMachine, event-source=IntTrP_DsdStateMachine
      mode-sender-policys:
        provided-mode-group=DcmEcuReset, queue-length=2
        provided-mode-group=DcmModeRapidPowerShutDown, queue-length=2
        provided-mode-group=DcmControlDTCSetting, queue-length=2
        provided-mode-group=DcmCommunicationControl, queue-length=2
        provided-mode-group=DcmDiagnosticSessionControl, queue-length=2
  swc bsw mapping SwcBswMapping_Dcm: bsw-behavior=BswBehavior_Dcm, swc-behavior=IB_Dcm
    runnable-mappings:
      bsw-entity=SE_Dcm_MainFunction, swc-runnable=RE_Dcm_MainFunction
      bsw-entity=SE_Dcm_ClearDiagnosticInformation, swc-runnable=RE_Dcm_ClearDiagnosticInformation
      bsw-entity=SE_Dcm_DiagnosticSessionControl, swc-runnable=RE_Dcm_DiagnosticSessionControl
      bsw-entity=SE_Dcm_ReadDTCInformation, swc-runnable=RE_Dcm_ReadDTCInformation
      bsw-entity=SE_Dcm_ReadDataByIdentifier, swc-runnable=RE_Dcm_ReadDataByIdentifier
      bsw-entity=SE_Dcm_SecurityAccess, swc-runnable=RE_Dcm_SecurityAccess
      bsw-entity=SE_Dcm_TesterPresent, swc-runnable=RE_Dcm_TesterPresent
      bsw-entity=SE_Dcm_WriteDataByIdentifier, swc-runnable=RE_Dcm_WriteDataByIdentifier
    synchronized-mode-groups:
      bsw-mode-group=DcmEcuReset, swc-mode-group=DcmEcuReset.DcmEcuReset
      bsw-mode-group=DcmModeRapidPowerShutDown, swc-mode-group=DcmModeRapidPowerShutDown.DcmModeRapidPowerShutDown
      bsw-mode-group=DcmControlDTCSetting, swc-mode-group=DcmControlDTCSetting.DcmControlDTCSetting
      bsw-mode-group=DcmCommunicationControl, swc-mode-group=DcmCommunicationControl.DcmCommunicationControl
      bsw-mode-group=DcmDiagnosticSessionControl, swc-mode-group=DcmDiagnosticSessionControl.DcmDiagnosticSessionControl
  bsw implementation BswImpl_Dcm
    mc-parameter-instances:
      mc data instance DcmDsdServiceTable: category=ARRAY, array-size=8, symbol=dcmCfgServiceSupport_0
        7 x mc data instance, all with category=VALUE:
          DcmDsdServiceTable_DcmDsdService_0x10_Supported: resulting-properties={base-type=uint8, sw-bit-representation={bit-position=0, number-of-bits=1}, sw-calibration-access=READ-WRITE, compu {0=FALSE, 1=TRUE}, data-constr=boolean}, symbol=[2]  # DcmDsdServiceTable: DcmDsdService_0x10 0: Service disabled, 1: Service enabled
          DcmDsdServiceTable_DcmDsdService_0x14_Supported: resulting-properties={base-type=uint8, sw-bit-representation={bit-position=4, number-of-bits=1}, sw-calibration-access=READ-WRITE, compu {0=FALSE, 1=TRUE}, data-constr=boolean}, symbol=[2]  # DcmDsdServiceTable: DcmDsdService_0x14 0: Service disabled, 1: Service enabled
          DcmDsdServiceTable_DcmDsdService_0x19_Supported: resulting-properties={base-type=uint8, sw-bit-representation={bit-position=1, number-of-bits=1}, sw-calibration-access=READ-WRITE, compu {0=FALSE, 1=TRUE}, data-constr=boolean}, symbol=[3]  # DcmDsdServiceTable: DcmDsdService_0x19 0: Service disabled, 1: Service enabled
          DcmDsdServiceTable_DcmDsdService_0x22_Supported: resulting-properties={base-type=uint8, sw-bit-representation={bit-position=2, number-of-bits=1}, sw-calibration-access=READ-WRITE, compu {0=FALSE, 1=TRUE}, data-constr=boolean}, symbol=[4]  # DcmDsdServiceTable: DcmDsdService_0x22 0: Service disabled, 1: Service enabled
          DcmDsdServiceTable_DcmDsdService_0x27_Supported: resulting-properties={base-type=uint8, sw-bit-representation={bit-position=7, number-of-bits=1}, sw-calibration-access=READ-WRITE, compu {0=FALSE, 1=TRUE}, data-constr=boolean}, symbol=[4]  # DcmDsdServiceTable: DcmDsdService_0x27 0: Service disabled, 1: Service enabled
          DcmDsdServiceTable_DcmDsdService_0x2E_Supported: resulting-properties={base-type=uint8, sw-bit-representation={bit-position=6, number-of-bits=1}, sw-calibration-access=READ-WRITE, compu {0=FALSE, 1=TRUE}, data-constr=boolean}, symbol=[5]  # DcmDsdServiceTable: DcmDsdService_0x2E 0: Service disabled, 1: Service enabled
          DcmDsdServiceTable_DcmDsdService_0x3E_Supported: resulting-properties={base-type=uint8, sw-bit-representation={bit-position=6, number-of-bits=1}, sw-calibration-access=READ-WRITE, compu {0=FALSE, 1=TRUE}, data-constr=boolean}, symbol=[7]  # DcmDsdServiceTable: DcmDsdService_0x3E 0: Service disabled, 1: Service enabled
    resource consumption RC_Dcm
      13 x memory section:
        CALIB_8: alignment=8, sw-addrmethod=CALIB
        CODE: alignment=UNSPECIFIED, sw-addrmethod=CODE
        CONST_32: alignment=32, sw-addrmethod=CONST
        CONST_8: alignment=8, sw-addrmethod=CONST
        CONST_UNSPECIFIED: alignment=UNSPECIFIED, sw-addrmethod=CONST
        POSTBUILD_CONST_32: alignment=32, sw-addrmethod=CONFIG_DATA
        POSTBUILD_CONST_UNSPECIFIED: alignment=UNSPECIFIED, sw-addrmethod=CONFIG_DATA
        POSTBUILD_VAR_NO_INIT_8: alignment=8, sw-addrmethod=POSTBUILD_VAR_NO_INIT
        POSTBUILD_VAR_NO_INIT_BOOLEAN: alignment=BOOLEAN, sw-addrmethod=POSTBUILD_VAR_NO_INIT
        POSTBUILD_VAR_NO_INIT_UNSPECIFIED: alignment=UNSPECIFIED, sw-addrmethod=POSTBUILD_VAR_NO_INIT
        READ_DID_0X2345_CODE: alignment=UNSPECIFIED, sw-addrmethod=CODE
        VAR_NO_INIT_UNSPECIFIED: alignment=UNSPECIFIED, sw-addrmethod=VAR_NO_INIT
        WRITE_DID_0X2345_CODE: alignment=UNSPECIFIED, sw-addrmethod=CODE
package /AUTOSAR_Dcm/BswModuleEntrys
  24 x bsw module entry, all with is-synchronous=true, sw-service-impl-policy=STANDARD:
    Dcm_GetVersionInfo: service-id=36, is-reentrant=true, call-type=REGULAR, execution-context=UNSPECIFIED
    Dcm_MainFunction: service-id=37, is-reentrant=false, call-type=SCHEDULED, execution-context=TASK
    Dcm_Init: service-id=1, is-reentrant=false, call-type=REGULAR, execution-context=UNSPECIFIED
    Dcm_StartOfReception: service-id=70, is-reentrant=false, call-type=CALLBACK, execution-context=UNSPECIFIED
    Dcm_CopyRxData: service-id=68, is-reentrant=false, call-type=CALLBACK, execution-context=UNSPECIFIED
    Dcm_TpRxIndication: service-id=69, is-reentrant=true, call-type=CALLBACK, execution-context=UNSPECIFIED
    Dcm_CopyTxData: service-id=67, is-reentrant=false, call-type=CALLBACK, execution-context=UNSPECIFIED
    Dcm_TpTxConfirmation: service-id=72, is-reentrant=true, call-type=CALLBACK, execution-context=UNSPECIFIED
    Dcm_TxConfirmation: service-id=64, is-reentrant=true, call-type=CALLBACK, execution-context=UNSPECIFIED
    Dcm_ComM_NoComModeEntered: service-id=33, is-reentrant=true, call-type=CALLBACK, execution-context=UNSPECIFIED
    Dcm_ComM_SilentComModeEntered: service-id=34, is-reentrant=true, call-type=CALLBACK, execution-context=UNSPECIFIED
    Dcm_ComM_FullComModeEntered: service-id=35, is-reentrant=true, call-type=CALLBACK, execution-context=UNSPECIFIED
    Dcm_DemTriggerOnDTCStatus: service-id=43, is-reentrant=false, call-type=REGULAR, execution-context=UNSPECIFIED
    Dcm_TriggerOnEvent: service-id=45, is-reentrant=true, call-type=REGULAR, execution-context=UNSPECIFIED
    Dcm_ResetToDefaultSession: service-id=42, is-reentrant=true, call-type=REGULAR, execution-context=UNSPECIFIED
    Dcm_SE_Dcm_ClearDiagnosticInformation: service-id=100, is-reentrant=false, call-type=SCHEDULED, execution-context=TASK
    Dcm_SE_Dcm_DiagnosticSessionControl: service-id=100, is-reentrant=false, call-type=SCHEDULED, execution-context=TASK
    Dcm_SE_Dcm_ReadDTCInformation: service-id=100, is-reentrant=false, call-type=SCHEDULED, execution-context=TASK
    Dcm_SE_Dcm_ReadDataByIdentifier: service-id=100, is-reentrant=false, call-type=SCHEDULED, execution-context=TASK
    Dcm_SE_Dcm_SecurityAccess: service-id=100, is-reentrant=false, call-type=SCHEDULED, execution-context=TASK
    Dcm_SE_Dcm_TesterPresent: service-id=100, is-reentrant=false, call-type=SCHEDULED, execution-context=TASK
    Dcm_SE_Dcm_WriteDataByIdentifier: service-id=100, is-reentrant=false, call-type=SCHEDULED, execution-context=TASK
    Dcm_SE_DslStateMachine: service-id=100, is-reentrant=false, call-type=SCHEDULED, execution-context=TASK
    Dcm_SE_DsdStateMachine: service-id=100, is-reentrant=false, call-type=SCHEDULED, execution-context=TASK
