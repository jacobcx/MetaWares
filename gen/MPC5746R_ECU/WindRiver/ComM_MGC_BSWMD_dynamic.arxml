AUTOSAR XML (schema 4-2-2)
# Copyright 2016 Mentor Graphics Corporation
# All Rights Reserved
# THIS WORK CONTAINS TRADE SECRET
# AND PROPRIETARY INFORMATION WHICH IS THE
# PROPERTY OF MENTOR GRAPHICS
# CORPORATION OR ITS LICENSORS AND IS
# SUBJECT TO LICENSE TERMS.
package /VSTAR/BswMd
  bsw module description ComM: module-id=12
    bsw internal behavior BswBehavior_ComM
      4 x exclusive area:
        ComM_ModeIndication
        ComM_InhibitionCounter
        ComM_Channel0_StateMachine
        ComM_Channel1_StateMachine
      bsw schedulable entity ComM_MainFunction_0: can-enter-exclusive-area=ComM_Channel0_StateMachine, implemented-entry=ComM_MainFunction_0
      bsw schedulable entity ComM_MainFunction_1: can-enter-exclusive-area=ComM_Channel1_StateMachine, implemented-entry=ComM_MainFunction_1
      7 x bsw called entity:
        ComM_DCM_ActiveDiagnostic: can-enter-exclusive-area=[ComM_Channel0_StateMachine, ComM_Channel1_StateMachine], implemented-entry=ComM_DCM_ActiveDiagnostic
        ComM_DCM_InactiveDiagnostic: can-enter-exclusive-area=[ComM_Channel0_StateMachine, ComM_Channel1_StateMachine], implemented-entry=ComM_DCM_InactiveDiagnostic
        ComM_EcuM_WakeUpIndication: implemented-entry=ComM_EcuM_WakeUpIndication
        ComM_Nm_NetworkStartIndication: implemented-entry=ComM_Nm_NetworkStartIndication
        ComM_Nm_RestartIndication: implemented-entry=ComM_Nm_RestartIndication
        ComM_BusSM_ModeIndication: can-enter-exclusive-area=ComM_ModeIndication, implemented-entry=ComM_BusSM_ModeIndication
        ComM_RequestComMode: can-enter-exclusive-area=ComM_InhibitionCounter, implemented-entry=ComM_RequestComMode
      bsw timing event Evt_ComM_MainFunction_0: starts-on-event=ComM_MainFunction_0, period=0.02
      bsw timing event Evt_ComM_MainFunction_1: starts-on-event=ComM_MainFunction_1, period=0.02
package /AUTOSAR_ComM/BswModuleEntrys
  27 x bsw module entry, all with execution-context=TASK:
    ComM_MainFunction: service-id=96, is-reentrant=false, is-synchronous=true, call-type=SCHEDULED
    ComM_Init: service-id=1, is-reentrant=false, is-synchronous=true, call-type=REGULAR
    ComM_DeInit: service-id=2, is-reentrant=false, is-synchronous=true, call-type=REGULAR
    ComM_GetStatus: service-id=3, is-reentrant=false, is-synchronous=true, call-type=REGULAR
    ComM_GetInhibitionStatus: service-id=4, is-reentrant=false, is-synchronous=true, call-type=REGULAR
    ComM_RequestComMode: service-id=5, is-reentrant=true, is-synchronous=true, call-type=REGULAR
    ComM_GetMaxComMode: service-id=6, is-reentrant=true, is-synchronous=true, call-type=REGULAR
    ComM_GetRequestedComMode: service-id=7, is-reentrant=true, is-synchronous=true, call-type=REGULAR
    ComM_GetCurrentComMode: service-id=8, is-reentrant=true, is-synchronous=true, call-type=REGULAR
    ComM_PreventWakeUp: service-id=9, is-reentrant=false, is-synchronous=true, call-type=REGULAR
    ComM_LimitChannelToNoComMode: service-id=11, is-reentrant=false, is-synchronous=true, call-type=REGULAR
    ComM_LimitECUToNoComMode: service-id=12, is-reentrant=false, is-synchronous=true, call-type=REGULAR
    ComM_SetECUGroupClassification: service-id=15, is-reentrant=false, is-synchronous=true, call-type=REGULAR
    ComM_GetVersionInfo: service-id=16, is-reentrant=true, is-synchronous=true, call-type=REGULAR
    ComM_Nm_NetworkStartIndication: service-id=21, is-reentrant=true, is-synchronous=true, call-type=CALLBACK
    ComM_Nm_NetworkMode: service-id=24, is-reentrant=true, is-synchronous=true, call-type=REGULAR
    ComM_Nm_PrepareBusSleepMode: service-id=25, is-reentrant=true, is-synchronous=true, call-type=REGULAR
    ComM_Nm_BusSleepMode: service-id=26, is-reentrant=true, is-synchronous=true, call-type=REGULAR
    ComM_Nm_RestartIndication: service-id=27, is-reentrant=true, is-synchronous=true, call-type=REGULAR
    ComM_DCM_ActiveDiagnostic: service-id=31, is-reentrant=true, is-synchronous=true, call-type=REGULAR
    ComM_DCM_InactiveDiagnostic: service-id=32, is-reentrant=true, is-synchronous=true, call-type=REGULAR
    ComM_EcuM_WakeUpIndication: service-id=42, is-reentrant=true, is-synchronous=true, call-type=REGULAR
    ComM_BusSM_ModeIndication: service-id=51, is-reentrant=true, is-synchronous=false, call-type=REGULAR
    ComM_CommunicationAllowed: service-id=53, is-reentrant=false, is-synchronous=true, call-type=REGULAR
    ComM_MainFunction_0: service-id=96, is-reentrant=false, is-synchronous=true, call-type=SCHEDULED
    ComM_MainFunction_1: service-id=96, is-reentrant=false, is-synchronous=true, call-type=SCHEDULED
    ComM_GetState: service-id=52, is-reentrant=false, is-synchronous=true, call-type=REGULAR
