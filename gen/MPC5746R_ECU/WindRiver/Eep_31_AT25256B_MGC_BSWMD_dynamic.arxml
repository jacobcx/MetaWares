AUTOSAR XML (schema 4-2-2)
package /VSTAR/BswMd
  bsw module entry Eep_MainFunction: call-type=REGULAR, execution-context=TASK, sw-service-impl-policy=STANDARD
  bsw module description Eep: module-id=90  # EEPROM Driver
    bsw internal behavior BSWBehavior_Eep_31_AT25256B
      exclusive area EaProcess
      exclusive area EaMainFunctionArea
      bsw schedulable entity BEn_Eep_MainFunction: can-enter-exclusive-area=[EaProcess, EaMainFunctionArea], implemented-entry=Eep_MainFunction
      bsw timing event BEv_EepMainfunction: starts-on-event=BEn_Eep_MainFunction, period=0.01
