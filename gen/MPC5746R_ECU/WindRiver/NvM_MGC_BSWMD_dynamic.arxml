AUTOSAR XML (schema 4-2-2)
# Copyright 2015 Mentor Graphics Corporation
# All Rights Reserved
# THIS WORK CONTAINS TRADE SECRET
# AND PROPRIETARY INFORMATION WHICH IS THE
# PROPERTY OF MENTOR GRAPHICS
# CORPORATION OR ITS LICENSORS AND IS
# SUBJECT TO LICENSE TERMS.
package /VSTAR/BswMd
  bsw module entry NvM_MainFunction: service-id=14, is-synchronous=true, call-type=SCHEDULED, execution-context=TASK, sw-service-impl-policy=STANDARD
  swc bsw mapping SwcBswMapping_NvM: bsw-behavior=BswBehavior_NvM, swc-bsw-runnable-mapping{bsw-entity=NvMMainFunctionEntity, swc-runnable=NvM_MainFunction}, swc-behavior=IB_NVM
  bsw module description NvM: module-id=20  # NVRAM Manager
    bsw internal behavior BswBehavior_NvM
      exclusive area EaServiceProcessQueue
      bsw schedulable entity NvMMainFunctionEntity: can-enter-exclusive-area=EaServiceProcessQueue, implemented-entry=NvM_MainFunction
      bsw timing event Evt_NvM_MainFunction: starts-on-event=NvMMainFunctionEntity, period=0.01
      service-needs:
        diagnostic event manager needs NVM_E_INTEGRITY_FAILED
      service-needs:
        diagnostic event manager needs NVM_E_REQ_FAILED
      service-needs:
        diagnostic event manager needs NVM_E_WRONG_BLOCK_ID
      service-needs:
        diagnostic event manager needs NVM_E_VERIFY_FAILED
      service-needs:
        diagnostic event manager needs NVM_E_LOSS_OF_REDUNDANCY
      service-needs:
        diagnostic event manager needs NVM_E_QUEUE_OVERFLOW
      service-needs:
        diagnostic event manager needs NVM_E_WRITE_PROTECTED
