AUTOSAR XML (schema 4-2-2)
# Copyright 2016 Mentor Graphics Corporation
# All Rights Reserved
# THIS WORK CONTAINS TRADE SECRET
# AND PROPRIETARY INFORMATION WHICH IS THE
# PROPERTY OF MENTOR GRAPHICS
# CORPORATION OR ITS LICENSORS AND IS
# SUBJECT TO LICENSE TERMS.
package /AUTOSAR_WdgM/BswModuleEntrys
  bsw module entry WdgM_MainFunction: service-id=2, call-type=SCHEDULED, execution-context=TASK, sw-service-impl-policy=STANDARD
package /VSTAR/BswMd
  bsw module description WdgM: module-id=13  # Watchdog Manager
    bsw module dependency BswModuleDependency_Dem: target-module-id=54
      service-items:
        diagnostic event needs WDGM_E_SET_MODE: dtc-kind=EMISSION-RELATED-DTC
        diagnostic event needs WDGM_E_MONITORING: dtc-kind=EMISSION-RELATED-DTC
        diagnostic event needs WDGM_E_IMPROPER_CALLER: dtc-kind=EMISSION-RELATED-DTC
    bsw internal behavior BswBehavior_WdgM
      exclusive area EaActStatusProtect
      bsw schedulable entity BEn_WdgM_MainFunction: can-enter-exclusive-area=EaActStatusProtect, implemented-entry=BswModuleEntrys/WdgM_MainFunction
      4 x bsw called entity, all with can-enter-exclusive-area=EaActStatusProtect:
        BEn_WdgM_DeInit: implemented-entry=WdgM_DeInit
        BEn_WdgM_DeInit: implemented-entry=WdgM_DeInit
        BEn_WdgM_SetMode: implemented-entry=WdgM_SetMode
        BEn_WdgM_CheckpointReached: implemented-entry=WdgM_CheckpointReached
      bsw timing event BEv_WdgMMainFunction_WdgMMode: starts-on-event=BEn_WdgM_MainFunction, period=0.01
  4 x bsw module entry, all with is-synchronous=true, sw-service-impl-policy=STANDARD:
    WdgM_DeInit: service-id=1, is-reentrant=false, call-type=REGULAR
    WdgM_SetMode: service-id=3, is-reentrant=false, call-type=REGULAR
    WdgM_MainFunction: service-id=2, is-reentrant=false, call-type=SCHEDULED, execution-context=TASK
    WdgM_CheckpointReached: service-id=14, is-reentrant=true, call-type=REGULAR
  impl type WdgM_ModeType: implementation-data-type=uint8
  swc bsw mapping SwcBswMapping_WdgM: bsw-behavior=BswBehavior_WdgM, swc-bsw-runnable-mapping{bsw-entity=BEn_WdgM_MainFunction, swc-runnable=RE_MAINFUNCTION}, swc-behavior=IB_WDGM
  mode declaration group WdgMMode: initial-mode=WdgMMode
    mode WdgMMode: value=0
