AUTOSAR XML (schema 4-2-2)
# Copyright 2016 Mentor Graphics Corporation
# All Rights Reserved
# THIS WORK CONTAINS TRADE SECRET
# AND PROPRIETARY INFORMATION WHICH IS THE
# PROPERTY OF MENTOR GRAPHICS
# CORPORATION OR ITS LICENSORS AND IS
# SUBJECT TO LICENSE TERMS.
package /VSTAR/BswMd
  bsw module description LinSM: module-id=141
    bsw internal behavior BswBehavior_LinSM
      exclusive area ExclusiveArea0
      bsw schedulable entity LinSM_MainFunction: can-enter-exclusive-area=ExclusiveArea0, implemented-entry=LinSM_MainFunction
      8 x bsw called entity:
        LinSM_Init: implemented-entry=LinSM_Init
        LinSM_ScheduleRequest: implemented-entry=LinSM_ScheduleRequest
        LinSM_GetVersionInfo: implemented-entry=LinSM_GetVersionInfo
        LinSM_GetCurrentComMode: implemented-entry=LinSM_GetCurrentComMode
        LinSM_RequestComMode: implemented-entry=LinSM_RequestComMode
        LinSM_ScheduleRequestConfirmation: implemented-entry=LinSM_ScheduleRequestConfirmation
        LinSM_GotoSleepConfirmation: implemented-entry=LinSM_GotoSleepConfirmation
        LinSM_WakeupConfirmation: implemented-entry=LinSM_WakeupConfirmation
      bsw timing event Evt_LinSM_MainFunction: starts-on-event=LinSM_MainFunction, period=0.01
package /AUTOSAR_LinSM/BswModuleEntrys
  9 x bsw module entry, all with execution-context=TASK, sw-service-impl-policy=STANDARD:
    LinSM_Init: service-id=1, is-reentrant=false, is-synchronous=true, call-type=REGULAR
    LinSM_GetVersionInfo: service-id=2, is-reentrant=true, is-synchronous=true, call-type=REGULAR
    LinSM_ScheduleRequest: service-id=16, is-reentrant=true, is-synchronous=false, call-type=REGULAR
    LinSM_GetCurrentComMode: service-id=17, is-reentrant=true, is-synchronous=true, call-type=REGULAR
    LinSM_RequestComMode: service-id=18, is-reentrant=true, is-synchronous=false, call-type=REGULAR
    LinSM_ScheduleRequestConfirmation: service-id=32, is-reentrant=true, is-synchronous=true, call-type=CALLBACK
    LinSM_WakeupConfirmation: service-id=33, is-reentrant=true, is-synchronous=true, call-type=CALLBACK
    LinSM_GotoSleepConfirmation: service-id=34, is-reentrant=true, is-synchronous=true, call-type=CALLBACK
    LinSM_MainFunction: service-id=48, is-reentrant=false, is-synchronous=true, call-type=SCHEDULED
