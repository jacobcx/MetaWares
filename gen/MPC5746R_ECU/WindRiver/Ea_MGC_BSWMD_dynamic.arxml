AUTOSAR XML (schema 4-2-2)
# Copyright 2016 Mentor Graphics Corporation
# All Rights Reserved
# THIS WORK CONTAINS TRADE SECRET
# AND PROPRIETARY INFORMATION WHICH IS THE
# PROPERTY OF MENTOR GRAPHICS
# CORPORATION OR ITS LICENSORS AND IS
# SUBJECT TO LICENSE TERMS.
package /AUTOSAR_Ea/BswModuleEntrys
  bsw module entry Ea_MainFunction: service-id=12, is-synchronous=false, call-type=REGULAR, execution-context=TASK, sw-service-impl-policy=STANDARD
package /VSTAR/BswMd
  bsw module description Ea: module-id=40  # EEPROM Abstraction
    bsw internal behavior BswBehavior_Ea
      exclusive area EaStateChange
      bsw schedulable entity Ea_MainFunction: can-enter-exclusive-area=EaStateChange, implemented-entry=Ea_MainFunction
      bsw timing event Evt_Ea_MainFunction: starts-on-event=Ea_MainFunction, period=0.01
