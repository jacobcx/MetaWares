AUTOSAR XML (schema 4-2-2)
# Copyright 2016 Mentor Graphics Corporation
# All Rights Reserved
# THIS WORK CONTAINS TRADE SECRET
# AND PROPRIETARY INFORMATION WHICH IS THE
# PROPERTY OF MENTOR GRAPHICS
# CORPORATION OR ITS LICENSORS AND IS
# SUBJECT TO LICENSE TERMS.
package /VSTAR/BswMd
  bsw module description CanIf: module-id=60
    bsw internal behavior BswBehavior_CanIf
      exclusive area EXCLUSIVE_AREA_0
      bsw schedulable entity CanIf_MainFunction: can-enter-exclusive-area=EXCLUSIVE_AREA_0, implemented-entry=CanIf_MainFunction
      12 x bsw called entity, all with can-enter-exclusive-area=EXCLUSIVE_AREA_0:
        CanIf_CancelTxConfirmation: implemented-entry=CanIf_CancelTxConfirmation
        CanIf_GetControllerMode: implemented-entry=CanIf_GetControllerMode
        CanIf_ReadRxNotifStatus: implemented-entry=CanIf_ReadRxNotifStatus
        CanIf_ReadRxPduData: implemented-entry=CanIf_ReadRxPduData
        CanIf_ReadTxNotifStatus: implemented-entry=CanIf_ReadTxNotifStatus
        CanIf_SetDynamicTxId: implemented-entry=CanIf_SetDynamicTxId
        CanIf_Transmit: implemented-entry=CanIf_Transmit
        CanIf_TxConfirmation: implemented-entry=CanIf_TxConfirmation
        CanIf_RxIndication: implemented-entry=CanIf_RxIndication
        CanIf_ControllerBusOff: implemented-entry=CanIf_ControllerBusOff
        CanIf_ControllerModeIndication: implemented-entry=CanIf_ControllerModeIndication
        CanIf_SetPduMode: implemented-entry=CanIf_SetPduMode
      bsw timing event Evt_CanIf_MainFunction: starts-on-event=CanIf_MainFunction, period=0.01
package /AUTOSAR_CanIf/BswModuleEntrys
  14 x bsw module entry, all with is-synchronous=true, execution-context=TASK:
    CanIf_Init: service-id=1, is-reentrant=false, call-type=REGULAR
    CanIf_MainFunction: is-reentrant=false, call-type=SCHEDULED
    CanIf_CancelTxConfirmation: service-id=19, is-reentrant=false, call-type=CALLBACK
    CanIf_ControllerBusOff: service-id=22, is-reentrant=true, call-type=CALLBACK
    CanIf_GetControllerMode: service-id=4, is-reentrant=false, call-type=REGULAR
    CanIf_ReadRxNotifStatus: service-id=8, is-reentrant=false, call-type=REGULAR
    CanIf_ReadRxPduData: service-id=6, is-reentrant=false, call-type=REGULAR
    CanIf_ReadTxNotifStatus: service-id=7, is-reentrant=false, call-type=REGULAR
    CanIf_RxIndication: service-id=20, is-reentrant=true, call-type=CALLBACK
    CanIf_SetDynamicTxId: service-id=12, is-reentrant=false, call-type=REGULAR
    CanIf_Transmit: service-id=5, is-reentrant=true, call-type=REGULAR
    CanIf_TxConfirmation: service-id=19, is-reentrant=true, call-type=CALLBACK
    CanIf_ControllerModeIndication: service-id=23, is-reentrant=true, call-type=CALLBACK
    CanIf_SetPduMode: service-id=9, is-reentrant=false, call-type=REGULAR
