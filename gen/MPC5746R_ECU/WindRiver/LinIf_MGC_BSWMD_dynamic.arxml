AUTOSAR XML (schema 4-2-2)
# Copyright 2016 Mentor Graphics Corporation
# All Rights Reserved
# THIS WORK CONTAINS TRADE SECRET
# AND PROPRIETARY INFORMATION WHICH IS THE
# PROPERTY OF MENTOR GRAPHICS
# CORPORATION OR ITS LICENSORS AND IS
# SUBJECT TO LICENSE TERMS.
package /VSTAR/BswMd
  bsw module description LinIf: module-id=62
    bsw internal behavior BswBehavior_LinIf
      exclusive area ExclusiveArea0
      bsw schedulable entity LinIf_MainFunction: can-enter-exclusive-area=ExclusiveArea0, implemented-entry=LinIf_MainFunction
      19 x bsw called entity:
        LinIf_Init: implemented-entry=LinIf_Init
        LinIf_GetVersionInfo: implemented-entry=LinIf_GetVersionInfo
        LinIf_Transmit: can-enter-exclusive-area=ExclusiveArea0, implemented-entry=LinIf_Transmit
        LinIf_ScheduleRequest: implemented-entry=LinIf_ScheduleRequest
        LinIf_GotoSleep: can-enter-exclusive-area=ExclusiveArea0, implemented-entry=LinIf_GotoSleep
        LinIf_Wakeup: implemented-entry=LinIf_Wakeup
        LinIf_SetTrcvMode: implemented-entry=LinIf_SetTrcvMode
        LinIf_GetTrcvMode: implemented-entry=LinIf_GetTrcvMode
        LinIf_GetTrcvWakeupReason: implemented-entry=LinIf_GetTrcvWakeupReason
        LinIf_SetTrcvWakeupMode: implemented-entry=LinIf_SetTrcvWakeupMode
        LinIf_CancelTransmit: implemented-entry=LinIf_CancelTransmit
        LinTp_Init: implemented-entry=LinTp_Init
        LinTp_Transmit: implemented-entry=LinTp_Transmit
        LinTp_GetVersionInfo: implemented-entry=LinTp_GetVersionInfo
        LinTp_Shutdown: implemented-entry=LinTp_Shutdown
        LinTp_CancelTransmit: implemented-entry=LinTp_CancelTransmit
        LinTp_ChangeParameter: implemented-entry=LinTp_ChangeParameter
        LinIf_CheckWakeup: can-enter-exclusive-area=ExclusiveArea0, implemented-entry=LinIf_CheckWakeup
        LinTp_CancelReceive: implemented-entry=LinTp_CancelReceive
      bsw timing event Evt_LinIf_MainFunction: starts-on-event=LinIf_MainFunction, period=0.01
package /AUTOSAR_LinIf/BswModuleEntrys
  20 x bsw module entry, all with execution-context=TASK, sw-service-impl-policy=STANDARD:
    LinIf_CancelTransmit: service-id=12, is-reentrant=false, is-synchronous=true, call-type=REGULAR
    LinIf_CheckWakeup: service-id=96, is-reentrant=true, is-synchronous=true, call-type=REGULAR
    LinIf_GetTrcvMode: service-id=9, is-reentrant=true, is-synchronous=true, call-type=REGULAR
    LinIf_GetTrcvWakeupReason: service-id=10, is-reentrant=true, is-synchronous=true, call-type=REGULAR
    LinIf_GetVersionInfo: service-id=3, is-reentrant=true, is-synchronous=true, call-type=REGULAR
    LinIf_GotoSleep: service-id=6, is-reentrant=false, is-synchronous=false, call-type=REGULAR
    LinIf_Init: service-id=1, is-reentrant=false, is-synchronous=true, call-type=REGULAR
    LinIf_MainFunction: service-id=128, is-reentrant=false, is-synchronous=true, call-type=SCHEDULED
    LinIf_ScheduleRequest: service-id=5, is-reentrant=true, is-synchronous=false, call-type=REGULAR
    LinIf_SetTrcvMode: service-id=8, is-reentrant=true, is-synchronous=true, call-type=REGULAR
    LinIf_SetTrcvWakeupMode: service-id=11, is-reentrant=true, is-synchronous=true, call-type=REGULAR
    LinIf_Transmit: service-id=4, is-reentrant=false, is-synchronous=false, call-type=REGULAR
    LinIf_Wakeup: service-id=7, is-reentrant=true, is-synchronous=false, call-type=REGULAR
    LinTp_CancelReceive: service-id=71, is-reentrant=false, is-synchronous=true, call-type=REGULAR
    LinTp_CancelTransmit: service-id=70, is-reentrant=false, is-synchronous=true, call-type=REGULAR
    LinTp_ChangeParameter: service-id=68, is-reentrant=false, is-synchronous=true, call-type=REGULAR
    LinTp_GetVersionInfo: service-id=66, is-reentrant=false, is-synchronous=true, call-type=REGULAR
    LinTp_Init: service-id=64, is-reentrant=false, is-synchronous=true, call-type=REGULAR
    LinTp_Shutdown: service-id=67, is-reentrant=false, is-synchronous=true, call-type=REGULAR
    LinTp_Transmit: service-id=65, is-reentrant=false, is-synchronous=false, call-type=REGULAR
