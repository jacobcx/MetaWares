AUTOSAR XML (schema 4-2-2)
# Copyright 2017 Mentor Graphics Corporation
# All rights reserved
# THIS WORK CONTAINS TRADE SECRET AND PROPRIETARY INFORMATION WHICH IS
# THE PROPERTY OF MENTOR GRAPHICS CORPORATION OR ITS LICENSORS AND IS
# SUBJECT TO LICENSE TERMS.
package /VSTAR/BswMd
  bsw module description Dem: module-id=41  # Diagnostic Event Manager
    provided-entrys:
      Dem_ClearDTC
      Dem_DcmClearDTC
      Dem_DcmReadDataOfPID21
      Dem_DcmReadDataOfPID31
      Dem_DcmReadDataOfPID4D
      Dem_DcmReadDataOfPID4E
      Dem_Init
      Dem_MainFunction
      Dem_ReportErrorStatus
      Dem_ResetEventStatus
      Dem_SetAgingCycleState
      Dem_SetEventStatus
      Dem_SetOperationCycleState
      Dem_PrestoreFreezeFrame
      Dem_GetFaultDetectionCounter
      Dem_DcmGetExtendedDataRecordByDTC
      Dem_DcmGetNextFilteredDTCAndFDC
      Dem_GetEventExtendedDataRecord
      Dem_DltGetAllExtendedDataRecords
      Dem_SetStorageCondition
      Dem_SetEventDisabled
      Dem_SetPermClearCondFulfilled
    bsw internal behavior BswBehavior_Dem
      11 x exclusive area:
        EaEventStatus
        EaObdOdometer
        EaObdTime
        EaDebounceCounter
        EaDebounceTime
        EaEventStateBuffer
        EaClearDtc
        EaPrestorageFF
        EaOpCycleQueue
        EaNvStorageOngoing
        EaSi
      21 x bsw called entity:
        Dem_Init: can-enter-exclusive-area=[EaEventStatus, EaSi], implemented-entry=Dem_Init
        Dem_SetEventStatus: can-enter-exclusive-area=[EaDebounceCounter, EaDebounceTime, EaEventStateBuffer, EaEventStatus, EaNvStorageOngoing, EaSi], implemented-entry=Dem_SetEventStatus
        Dem_ResetEventStatus: can-enter-exclusive-area=[EaDebounceCounter, EaDebounceTime, EaEventStatus, EaNvStorageOngoing], implemented-entry=Dem_ResetEventStatus
        Dem_ReportErrorStatus: can-enter-exclusive-area=[EaDebounceCounter, EaDebounceTime, EaEventStateBuffer, EaEventStatus, EaNvStorageOngoing, EaSi], implemented-entry=Dem_ReportErrorStatus
        Dem_SetAgingCycleState: can-enter-exclusive-area=EaOpCycleQueue, implemented-entry=Dem_SetAgingCycleState
        Dem_SetOperationCycleState: can-enter-exclusive-area=EaOpCycleQueue, implemented-entry=Dem_SetOperationCycleState
        Dem_DcmReadDataOfPID21: can-enter-exclusive-area=EaObdOdometer, implemented-entry=Dem_DcmReadDataOfPID21
        Dem_DcmReadDataOfPID31: can-enter-exclusive-area=EaObdOdometer, implemented-entry=Dem_DcmReadDataOfPID31
        Dem_DcmReadDataOfPID4D: can-enter-exclusive-area=EaObdTime, implemented-entry=Dem_DcmReadDataOfPID4D
        Dem_DcmReadDataOfPID4E: can-enter-exclusive-area=EaObdTime, implemented-entry=Dem_DcmReadDataOfPID4E
        Dem_ClearDTC: can-enter-exclusive-area=EaClearDtc, implemented-entry=Dem_ClearDTC
        Dem_CddClearDTC: can-enter-exclusive-area=EaClearDtc, implemented-entry=Dem_DcmClearDTC
        Dem_PrestoreFreezeFrame: can-enter-exclusive-area=EaPrestorageFF, implemented-entry=Dem_PrestoreFreezeFrame
        Dem_GetFaultDetectionCounter: can-enter-exclusive-area=EaDebounceTime, implemented-entry=Dem_GetFaultDetectionCounter
        Dem_DcmGetExtendedDataRecordByDTC: can-enter-exclusive-area=EaDebounceTime, implemented-entry=Dem_DcmGetExtendedDataRecordByDTC
        Dem_DcmGetNextFilteredDTCAndFDC: can-enter-exclusive-area=EaDebounceTime, implemented-entry=Dem_DcmGetNextFilteredDTCAndFDC
        Dem_GetEventExtendedDataRecord: can-enter-exclusive-area=EaDebounceTime, implemented-entry=Dem_GetEventExtendedDataRecord
        Dem_DltGetAllExtendedDataRecords: can-enter-exclusive-area=EaDebounceTime, implemented-entry=Dem_DltGetAllExtendedDataRecords
        Dem_SetStorageCondition: can-enter-exclusive-area=[EaNvStorageOngoing, EaEventStatus, EaSi], implemented-entry=Dem_SetStorageCondition
        Dem_SetEventDisabled: can-enter-exclusive-area=EaNvStorageOngoing, implemented-entry=Dem_SetEventDisabled
        Dem_SetPermClearCondFulfilled: can-enter-exclusive-area=EaNvStorageOngoing, implemented-entry=Dem_SetPermClearCondFulfilled
      bsw schedulable entity Dem_MainFunction: can-enter-exclusive-area=[EaDebounceCounter, EaDebounceTime, EaEventStatus, EaEventStateBuffer, EaObdOdometer, EaObdTime, EaPrestorageFF, EaOpCycleQueue, EaNvStorageOngoing, EaSi], implemented-entry=Dem_MainFunction
      bsw timing event Evt_Dem_MainFunction: starts-on-event=Dem_MainFunction, period=0.02
      bsw-service-dependency:
        symbolic name props Admin_Symbol: symbol=Admin
        service-needs:
          nv block needs DEM_Admin: calc-ram-block-crc=1, check-static-block-id=0, n-data-sets=0, n-rom-blocks=0, ram-block-status-control=NV-RAM-MANAGER, readonly=0, reliability=ERROR-DETECTION, resistant-to-changed-sw=0, restore-at-start=1, store-at-shutdown=1, use-auto-validation-at-shut-down=0, use-crc-comp-mechanism=1, write-only-once=0, write-verification=0, writing-priority=HIGH
      bsw-service-dependency:
        symbolic name props UdsStatus_Symbol: symbol=UdsStatus
        service-needs:
          nv block needs DEM_UdsStatus: calc-ram-block-crc=1, check-static-block-id=0, n-data-sets=0, n-rom-blocks=0, ram-block-status-control=NV-RAM-MANAGER, readonly=0, reliability=ERROR-DETECTION, resistant-to-changed-sw=0, restore-at-start=1, store-at-shutdown=1, use-auto-validation-at-shut-down=0, use-crc-comp-mechanism=1, write-only-once=0, write-verification=0, writing-priority=HIGH
      bsw-service-dependency:
        symbolic name props OpCycleState_Symbol: symbol=OpCycleState
        service-needs:
          nv block needs DEM_OpCycleState: calc-ram-block-crc=1, check-static-block-id=0, n-data-sets=0, n-rom-blocks=0, ram-block-status-control=NV-RAM-MANAGER, readonly=0, reliability=ERROR-DETECTION, resistant-to-changed-sw=0, restore-at-start=1, store-at-shutdown=1, use-auto-validation-at-shut-down=0, use-crc-comp-mechanism=1, write-only-once=0, write-verification=0, writing-priority=HIGH
      bsw-service-dependency:
        symbolic name props Si_Symbol: symbol=Si
        service-needs:
          nv block needs DEM_Si: calc-ram-block-crc=1, check-static-block-id=0, n-data-sets=0, n-rom-blocks=0, ram-block-status-control=NV-RAM-MANAGER, readonly=0, reliability=ERROR-DETECTION, resistant-to-changed-sw=0, restore-at-start=1, store-at-shutdown=1, use-auto-validation-at-shut-down=0, use-crc-comp-mechanism=1, write-only-once=0, write-verification=0, writing-priority=HIGH
      bsw-service-dependency:
        symbolic name props PrimaryEvMemEntry01_Symbol: symbol=PrimaryEvMemEntry01
        service-needs:
          nv block needs DEM_PrimaryEvMemEntry01: calc-ram-block-crc=1, check-static-block-id=0, n-data-sets=0, n-rom-blocks=0, ram-block-status-control=NV-RAM-MANAGER, readonly=0, reliability=ERROR-DETECTION, resistant-to-changed-sw=0, restore-at-start=1, store-at-shutdown=1, use-auto-validation-at-shut-down=0, use-crc-comp-mechanism=1, write-only-once=0, write-verification=0, writing-priority=HIGH
      bsw-service-dependency:
        symbolic name props PrimaryEvMemEntry02_Symbol: symbol=PrimaryEvMemEntry02
        service-needs:
          nv block needs DEM_PrimaryEvMemEntry02: calc-ram-block-crc=1, check-static-block-id=0, n-data-sets=0, n-rom-blocks=0, ram-block-status-control=NV-RAM-MANAGER, readonly=0, reliability=ERROR-DETECTION, resistant-to-changed-sw=0, restore-at-start=1, store-at-shutdown=1, use-auto-validation-at-shut-down=0, use-crc-comp-mechanism=1, write-only-once=0, write-verification=0, writing-priority=HIGH
      bsw-service-dependency:
        symbolic name props PrimaryEvMemEntry03_Symbol: symbol=PrimaryEvMemEntry03
        service-needs:
          nv block needs DEM_PrimaryEvMemEntry03: calc-ram-block-crc=1, check-static-block-id=0, n-data-sets=0, n-rom-blocks=0, ram-block-status-control=NV-RAM-MANAGER, readonly=0, reliability=ERROR-DETECTION, resistant-to-changed-sw=0, restore-at-start=1, store-at-shutdown=1, use-auto-validation-at-shut-down=0, use-crc-comp-mechanism=1, write-only-once=0, write-verification=0, writing-priority=HIGH
      bsw-service-dependency:
        symbolic name props PrimaryEvMemEntry04_Symbol: symbol=PrimaryEvMemEntry04
        service-needs:
          nv block needs DEM_PrimaryEvMemEntry04: calc-ram-block-crc=1, check-static-block-id=0, n-data-sets=0, n-rom-blocks=0, ram-block-status-control=NV-RAM-MANAGER, readonly=0, reliability=ERROR-DETECTION, resistant-to-changed-sw=0, restore-at-start=1, store-at-shutdown=1, use-auto-validation-at-shut-down=0, use-crc-comp-mechanism=1, write-only-once=0, write-verification=0, writing-priority=HIGH
      bsw-service-dependency:
        symbolic name props PrimaryEvMemEntry05_Symbol: symbol=PrimaryEvMemEntry05
        service-needs:
          nv block needs DEM_PrimaryEvMemEntry05: calc-ram-block-crc=1, check-static-block-id=0, n-data-sets=0, n-rom-blocks=0, ram-block-status-control=NV-RAM-MANAGER, readonly=0, reliability=ERROR-DETECTION, resistant-to-changed-sw=0, restore-at-start=1, store-at-shutdown=1, use-auto-validation-at-shut-down=0, use-crc-comp-mechanism=1, write-only-once=0, write-verification=0, writing-priority=HIGH
      bsw-service-dependency:
        symbolic name props PrimaryEvMemEntry06_Symbol: symbol=PrimaryEvMemEntry06
        service-needs:
          nv block needs DEM_PrimaryEvMemEntry06: calc-ram-block-crc=1, check-static-block-id=0, n-data-sets=0, n-rom-blocks=0, ram-block-status-control=NV-RAM-MANAGER, readonly=0, reliability=ERROR-DETECTION, resistant-to-changed-sw=0, restore-at-start=1, store-at-shutdown=1, use-auto-validation-at-shut-down=0, use-crc-comp-mechanism=1, write-only-once=0, write-verification=0, writing-priority=HIGH
      bsw-service-dependency:
        symbolic name props PrimaryEvMemEntry07_Symbol: symbol=PrimaryEvMemEntry07
        service-needs:
          nv block needs DEM_PrimaryEvMemEntry07: calc-ram-block-crc=1, check-static-block-id=0, n-data-sets=0, n-rom-blocks=0, ram-block-status-control=NV-RAM-MANAGER, readonly=0, reliability=ERROR-DETECTION, resistant-to-changed-sw=0, restore-at-start=1, store-at-shutdown=1, use-auto-validation-at-shut-down=0, use-crc-comp-mechanism=1, write-only-once=0, write-verification=0, writing-priority=HIGH
      bsw-service-dependency:
        symbolic name props PrimaryEvMemEntry08_Symbol: symbol=PrimaryEvMemEntry08
        service-needs:
          nv block needs DEM_PrimaryEvMemEntry08: calc-ram-block-crc=1, check-static-block-id=0, n-data-sets=0, n-rom-blocks=0, ram-block-status-control=NV-RAM-MANAGER, readonly=0, reliability=ERROR-DETECTION, resistant-to-changed-sw=0, restore-at-start=1, store-at-shutdown=1, use-auto-validation-at-shut-down=0, use-crc-comp-mechanism=1, write-only-once=0, write-verification=0, writing-priority=HIGH
      bsw-service-dependency:
        symbolic name props PrimaryEvMemEntry09_Symbol: symbol=PrimaryEvMemEntry09
        service-needs:
          nv block needs DEM_PrimaryEvMemEntry09: calc-ram-block-crc=1, check-static-block-id=0, n-data-sets=0, n-rom-blocks=0, ram-block-status-control=NV-RAM-MANAGER, readonly=0, reliability=ERROR-DETECTION, resistant-to-changed-sw=0, restore-at-start=1, store-at-shutdown=1, use-auto-validation-at-shut-down=0, use-crc-comp-mechanism=1, write-only-once=0, write-verification=0, writing-priority=HIGH
      bsw-service-dependency:
        symbolic name props PrimaryEvMemEntry10_Symbol: symbol=PrimaryEvMemEntry10
        service-needs:
          nv block needs DEM_PrimaryEvMemEntry10: calc-ram-block-crc=1, check-static-block-id=0, n-data-sets=0, n-rom-blocks=0, ram-block-status-control=NV-RAM-MANAGER, readonly=0, reliability=ERROR-DETECTION, resistant-to-changed-sw=0, restore-at-start=1, store-at-shutdown=1, use-auto-validation-at-shut-down=0, use-crc-comp-mechanism=1, write-only-once=0, write-verification=0, writing-priority=HIGH
  swc bsw mapping SwcBswMapping_Dem: bsw-behavior=BswBehavior_Dem, swc-bsw-runnable-mapping{bsw-entity=Dem_MainFunction, swc-runnable=MainFunction}, swc-behavior=IB_Dem
  bsw implementation BswImpl_Dem
    mc-parameter-instances:
      20 x mc data instance:
        EventAvailable: category=ARRAY, array-size=4, symbol=Events_EventAvailable
          4 x mc data instance, all with category=VALUE, symbol=[0]:
            DemEventParameter_EEP_EventAvailable: resulting-properties={base-type=uint8, sw-bit-representation={bit-position=0, number-of-bits=1}, sw-calibration-access=READ-WRITE, compu {0=FALSE, 1=TRUE}, data-constr=boolean}  # This element calibrates the availability of event DemEventParameter_EEP. An unavailable event is treated by Dem as if it does not exist. True: Event is available. False: Event is not available.
            DemEventParameter_CanSM_EventAvailable: resulting-properties={base-type=uint8, sw-bit-representation={bit-position=1, number-of-bits=1}, sw-calibration-access=READ-WRITE, compu {0=FALSE, 1=TRUE}, data-constr=boolean}  # This element calibrates the availability of event DemEventParameter_CanSM. An unavailable event is treated by Dem as if it does not exist. True: Event is available. False: Event is not available.
            DemEventParameter_22938_EventAvailable: resulting-properties={base-type=uint8, sw-bit-representation={bit-position=2, number-of-bits=1}, sw-calibration-access=READ-WRITE, compu {0=FALSE, 1=TRUE}, data-constr=boolean}  # This element calibrates the availability of event DemEventParameter_22938. An unavailable event is treated by Dem as if it does not exist. True: Event is available. False: Event is not available.
            DemEventParameter_22940_EventAvailable: resulting-properties={base-type=uint8, sw-bit-representation={bit-position=3, number-of-bits=1}, sw-calibration-access=READ-WRITE, compu {0=FALSE, 1=TRUE}, data-constr=boolean}  # This element calibrates the availability of event DemEventParameter_22940. An unavailable event is treated by Dem as if it does not exist. True: Event is available. False: Event is not available.
        UdsDtc: category=ARRAY, array-size=2, symbol=Dtcs_UdsDtc
          mc data instance DemDTC_22938_UdsDtc: category=VALUE, resulting-properties={base-type=uint32, sw-calibration-access=READ-WRITE, range raw 0..16777214}, symbol=[0]  # Unique Diagnostic Trouble Code value for UDS services. If set to 0, the DTC will not be visible in UDS services.
          mc data instance DemDTC_22940_UdsDtc: category=VALUE, resulting-properties={base-type=uint32, sw-calibration-access=READ-WRITE, range raw 0..16777214}, symbol=[1]  # Unique Diagnostic Trouble Code value for UDS services. If set to 0, the DTC will not be visible in UDS services.
        FunctionalUnit: category=ARRAY, array-size=2, symbol=Dtcs_FunctionalUnit
          mc data instance DemDTC_22938_FunctionalUnit: category=VALUE, resulting-properties={base-type=uint8, sw-calibration-access=READ-WRITE}, symbol=[0]  # Identifies the corresponding basic vehicle / system function which reports the DTC.
          mc data instance DemDTC_22940_FunctionalUnit: category=VALUE, resulting-properties={base-type=uint8, sw-calibration-access=READ-WRITE}, symbol=[1]  # Identifies the corresponding basic vehicle / system function which reports the DTC.
        Severity: category=ARRAY, array-size=2, symbol=Dtcs_Severity
          mc data instance DemDTC_22938_Severity: category=VALUE, resulting-properties={base-type=uint8, sw-calibration-access=READ-WRITE}, symbol=[0]  # DTC severity according to ISO 14229-1. This parameter depends on the automotive manufacturer.
          mc data instance DemDTC_22940_Severity: category=VALUE, resulting-properties={base-type=uint8, sw-calibration-access=READ-WRITE}, symbol=[1]  # DTC severity according to ISO 14229-1. This parameter depends on the automotive manufacturer.
        DebounceData: category=ARRAY, array-size=4, symbol=Events_DebounceData
          4 x mc data instance, all with category=VALUE, resulting-properties={base-type=uint8, sw-calibration-access=READ-WRITE, compu {0=DEM_DEBOUNCE_COUNTER_BASED_0}, range raw 0}:
            DemEventParameter_EEP_DebounceData: symbol=[0]  # Selection of counter based pre-debouncing parameters.
            DemEventParameter_CanSM_DebounceData: symbol=[1]  # Selection of counter based pre-debouncing parameters.
            DemEventParameter_22938_DebounceData: symbol=[2]  # Selection of counter based pre-debouncing parameters.
            DemEventParameter_22940_DebounceData: symbol=[3]  # Selection of counter based pre-debouncing parameters.
        EventAttributes: category=ARRAY, array-size=4, symbol=Events_EventAttributes
          4 x mc data instance, all with category=VALUE, resulting-properties={base-type=uint8, sw-calibration-access=READ-WRITE, compu {0=DEM_EVENT_ATTRIBUTES_0}, range raw 0}:
            DemEventParameter_EEP_EventAttributes: symbol=[0]  # Selection of various event related parameters.
            DemEventParameter_CanSM_EventAttributes: symbol=[1]  # Selection of various event related parameters.
            DemEventParameter_22938_EventAttributes: symbol=[2]  # Selection of various event related parameters.
            DemEventParameter_22940_EventAttributes: symbol=[3]  # Selection of various event related parameters.
        DTCAttributes: category=ARRAY, array-size=2, symbol=Dtcs_DTCAttributes
          mc data instance DemDTC_22938_DTCAttributes: category=VALUE, resulting-properties={base-type=uint8, sw-calibration-access=READ-WRITE, compu {0=DEM_DTC_ATTRIBUTES_0}, range raw 0}, symbol=[0]  # Selection of various DTC related parameters.
          mc data instance DemDTC_22940_DTCAttributes: category=VALUE, resulting-properties={base-type=uint8, sw-calibration-access=READ-WRITE, compu {0=DEM_DTC_ATTRIBUTES_0}, range raw 0}, symbol=[1]  # Selection of various DTC related parameters.
        FreezeFrame: category=ARRAY, array-size=2, symbol=Dtcs_FreezeFrame
          mc data instance DemDTC_22938_FreezeFrame: category=VALUE, resulting-properties={base-type=uint16, sw-calibration-access=READ-WRITE, compu {65535=DEM_FF_CLASS_INVALID}, range raw 0..65535}, symbol=[0]  # Selection of standard freeze frame configuration.
          mc data instance DemDTC_22940_FreezeFrame: category=VALUE, resulting-properties={base-type=uint16, sw-calibration-access=READ-WRITE, compu {65535=DEM_FF_CLASS_INVALID}, range raw 0..65535}, symbol=[1]  # Selection of standard freeze frame configuration.
        DebounceCounterBased: category=ARRAY, array-size=1, symbol=DbCounter
          mc data instance DebounceCounterBased0: category=STRUCTURE, symbol=[0]
            9 x mc data instance, all with category=VALUE:
              IncrStep: resulting-properties={base-type=sint16, sw-calibration-access=READ-WRITE, range raw 1..32767}, symbol=incr_step  # Step size for incrementation of the internal debounce counter (PREFAILED)
              DecrStep: resulting-properties={base-type=sint16, sw-calibration-access=READ-WRITE, range raw -32768..-1}, symbol=decr_step  # Step size for decrementation of the internal debounce counter (PREPASSED)
              FailedThreshold: resulting-properties={base-type=sint16, sw-calibration-access=READ-WRITE, range raw 1..32767}, symbol=failed_threshold  # Value of the internal debounce counter, which indicates the failed status.
              PassedThreshold: resulting-properties={base-type=sint16, sw-calibration-access=READ-WRITE, range raw -32768..-1}, symbol=passed_threshold  # Value of the internal debounce counter, which indicates the passed status.
              FdcThreshold: resulting-properties={base-type=sint16, sw-calibration-access=READ-WRITE, range raw 1..32767}, symbol=fdc_threshold  # Value of the internal debounce counter, which indicates the fdc threshold for allocation of event memory entry and freeze frame storage.
              JumpUpValue: resulting-properties={base-type=sint16, sw-calibration-access=READ-WRITE, range raw -32768..32767}, symbol=jump_up_value  # Jump-Up value of the internal debounce counter which is taken as initialization value for the counter when the respective step-up occurs.
              JumpDownValue: resulting-properties={base-type=sint16, sw-calibration-access=READ-WRITE, range raw -32768..32767}, symbol=jump_down_value  # Jump-Down value of the internal debounce counter which is taken as initialization value for the counter when the respective step-down occurs.
              JumpUp: resulting-properties={base-type=boolean, sw-calibration-access=READ-WRITE, compu {0=FALSE, 1=TRUE}, data-constr=boolean}, symbol=jump_up  # Switch for the activation of Jump-Up. True: Jump-Up activated, False: Jump-Up deactivated
              JumpDown: resulting-properties={base-type=boolean, sw-calibration-access=READ-WRITE, compu {0=FALSE, 1=TRUE}, data-constr=boolean}, symbol=jump_down  # Switch for the activation of Jump-Down. True: Jump-Down activated, False: Jump-Down deactivated
        EventAttributes_ConfirmedThreshold: category=ARRAY, array-size=1
          mc data instance EventAttributes0_ConfirmedThreshold: category=VALUE, resulting-properties={base-type=uint8, sw-calibration-access=READ-WRITE}, symbol=[0]  # Threshold for setting UDS status confirmedDTC bit.
        EventAttributes_OperationCycle: category=ARRAY, array-size=1
          mc data instance EventAttributes0_OperationCycle: category=VALUE, resulting-properties={base-type=uint8, sw-calibration-access=READ-WRITE, compu {0=DemOperationCycle}, range raw 0}, symbol=[0]  # Operation cycle for event.
        DTCAttributes_AgingCycle: category=ARRAY, array-size=1
          mc data instance DTCAttributes0_AgingCycle: category=VALUE, resulting-properties={base-type=uint8, sw-calibration-access=READ-WRITE, compu {0=DemOperationCycle}, range raw 0}, symbol=[0]  # Reference to the cycle which is triggering the aging of the event.
        DTCAttributes_MemoryDest: category=ARRAY, array-size=1
          mc data instance DTCAttributes0_MemoryDest: category=VALUE, resulting-properties={base-type=uint8, sw-calibration-access=READ-WRITE, compu {1=DEM_PRIMARY_MEMORY}, range raw 1}, symbol=[0]  # Assignment of event to a memory destination.
        DTCAttributes_Priority: category=ARRAY, array-size=1
          mc data instance DTCAttributes0_Priority: category=VALUE, resulting-properties={base-type=uint8, sw-calibration-access=READ-WRITE, range raw 1..255}, symbol=[0]  # Priority of event used for displacement.
        DTCAttributes_AgingThreshold: category=ARRAY, array-size=1
          mc data instance DTCAttributes0_AgingThreshold: category=VALUE, resulting-properties={base-type=uint8, sw-calibration-access=READ-WRITE, range raw 1..255}, symbol=[0]  # Number of cycles needed to age the event.
        DTCAttributes_AgingAllowed: category=ARRAY, array-size=1
          mc data instance DTCAttributes0_AgingAllowed: category=VALUE, resulting-properties={base-type=boolean, sw-calibration-access=READ-WRITE, compu {0=FALSE, 1=TRUE}, data-constr=boolean}, symbol=[0]  # Switch to allow aging of the event or not. True: Aging allowed, False: Aging not allowed
        DTCAttributes_InstantAging: category=ARRAY, array-size=1
          mc data instance DTCAttributes0_InstantAging: category=VALUE, resulting-properties={base-type=boolean, sw-calibration-access=READ-WRITE, compu {0=FALSE, 1=TRUE}, data-constr=boolean}, symbol=[0]  # Switch that defines whether the event shall be instantly aged upon first PASSED report independently of the values of aging- and warm-up cycle counters. True: Instant aging, False: Normal aging
        DTCAttributes_Significance: category=ARRAY, array-size=1
          mc data instance DTCAttributes0_Significance: category=VALUE, resulting-properties={base-type=uint8, sw-calibration-access=READ-WRITE}, symbol=[0]  # Significance of the event, which indicates additional information concerning fault classification and resolution. Value only used for off-board analysis. No influence on internal behaviour of Dem.
        DTCAttributes_ImmediateNvStorage: category=ARRAY, array-size=1
          mc data instance DTCAttributes0_ImmediateNvStorage: category=VALUE, resulting-properties={base-type=boolean, sw-calibration-access=READ-WRITE, compu {0=FALSE, 1=TRUE}, data-constr=boolean}, symbol=[0]  # Switch to enable immediate storage triggering of an event memory entry to NVRAM. True: Immediate non-volatile storage triggering enabled, False: Immediate non-volatile storage triggering disabled
        CommonFreezeFrameData: category=VALUE, resulting-properties={base-type=uint16, sw-calibration-access=READ-WRITE, compu {65535=DEM_FF_CLASS_INVALID}}  # Selection of the common part for the ordinary AUTOSAR freeze frame.
    mc-variable-instances:
      16 x mc data instance:
        Dem_NvAdmin: category=STRUCTURE
          6 x mc data instance:
            EventOccurrenceInfo: category=STRUCTURE, symbol=event_occurrence_info
              4 x mc data instance, all with category=VALUE, resulting-properties={sw-calibration-access=READ-ONLY, compu-method=EVENT_ID_CM, range raw 1..4, implementation-data-type=Dem_EventIdType}:
                MostRecentFailedEvent: display-identifier=EventOccurrenceInfo_MostRecentFailedEvent, symbol=most_recent_failed_event  # Event Id of the most recent failed event.
                MostRecentConfirmedEvent: display-identifier=EventOccurrenceInfo_MostRecentConfirmedEvent, symbol=most_recent_confirmed_event  # Event Id of the most recent confirmed event.
                FirstFailedEvent: display-identifier=EventOccurrenceInfo_FirstFailedEvent, symbol=first_failed_event  # Event Id of the first failed event.
                FirstConfirmedEvent: display-identifier=EventOccurrenceInfo_FirstConfirmedEvent, symbol=first_confirmed_event  # Event Id of the first confirmed event.
            EventMemoryOverflowIndication: category=VALUE, display-identifier=EventMemoryOverflowIndication, resulting-properties={base-type=uint8, sw-calibration-access=READ-ONLY, data-constr=uint8}, symbol=event_memory_overflow_ind  # Event memory overflow indication
            PrimaryEventMemory_FirstEntryIndex: category=VALUE, display-identifier=PrimaryEventMemory_FirstEntryIndex, resulting-properties={base-type=uint8, sw-calibration-access=READ-ONLY, compu-method=PrimaryEventMemoryEntry_CM, data-constr=uint8}, symbol=primary_first_ev_mem_entry  # Index pointing to first event entry in chronological order for the primary memory. A value of 0xFF indicates an invalid index.
            PrimaryEventMemory_LastEntryIndex: category=VALUE, display-identifier=PrimaryEventMemory_LastEntryIndex, resulting-properties={base-type=uint8, sw-calibration-access=READ-ONLY, compu-method=PrimaryEventMemoryEntry_CM, data-constr=uint8}, symbol=primary_last_ev_mem_entry  # Index pointing to last event entry in chronological order for the primary memory. A value of 0xFF indicates an invalid index.
            PrimaryEventMemory_NextEntryIndexes: category=ARRAY, array-size=10, display-identifier=PrimaryEventMemory_NextEntryIndexes, resulting-properties={base-type=uint8, sw-calibration-access=READ-ONLY, compu-method=PrimaryEventMemoryEntry_CM, data-constr=uint8}, symbol=primary_next_ev_mem_entry  # An array of indexes pointing to the next event entry in chronological order for the primary memory. A value of 0xFF indicates an invalid index.
            PrimaryEventMemory_PreviousEntryIndexes: category=ARRAY, array-size=10, display-identifier=PrimaryEventMemory_PreviousEntryIndexes, resulting-properties={base-type=uint8, sw-calibration-access=READ-ONLY, compu-method=PrimaryEventMemoryEntry_CM, data-constr=uint8}, symbol=primary_prev_ev_mem_entry  # An array of indexes pointing to the previous event entry in chronological order for the primary memory. A value of 0xFF indicates an invalid index.
        Dem_NvOpCycleState: category=ARRAY, array-size=1
          mc data instance DemOperationCycle_OpCycleState: category=VALUE, display-identifier=DemOperationCycle_OpCycleState, resulting-properties={sw-calibration-access=READ-ONLY, compu-method=Dem_OperationCycleStateType_Enum, range raw 0..1, implementation-data-type=Dem_OperationCycleStateType}, symbol=[0]  # DemOperationCycle operation cycle state.
        Dem_NvUdsStatus: category=ARRAY, array-size=4
          4 x mc data instance, all with category=VALUE, resulting-properties={sw-calibration-access=READ-ONLY, range raw 0..255, implementation-data-type=Dem_UdsStatusByteType}:
            DemEventParameter_EEP_UdsStatus: display-identifier=DemEventParameter_EEP_UdsStatus, symbol=[0]  # DemEventParameter_EEP UDS DTC status byte
            DemEventParameter_CanSM_UdsStatus: display-identifier=DemEventParameter_CanSM_UdsStatus, symbol=[1]  # DemEventParameter_CanSM UDS DTC status byte
            DemEventParameter_22938_UdsStatus: display-identifier=DemEventParameter_22938_UdsStatus, symbol=[2]  # DemEventParameter_22938 UDS DTC status byte
            DemEventParameter_22940_UdsStatus: display-identifier=DemEventParameter_22940_UdsStatus, symbol=[3]  # DemEventParameter_22940 UDS DTC status byte
        Dem_NvSi: category=STRUCTURE
          mc data instance FdcThresholdReached: category=ARRAY, array-size=4, symbol=fdcThresholdReached
            4 x mc data instance, all with category=VALUE, symbol=[0]:
              DemEventParameter_EEP_FdcThresholdReached: display-identifier=DemEventParameter_EEP_FdcThresholdReached, resulting-properties={base-type=uint8, sw-bit-representation={bit-position=0, number-of-bits=1}, sw-calibration-access=READ-ONLY, compu {0=FALSE, 1=TRUE}, data-constr=boolean}  # SI status bit 0 (FDC threshold reached).
              DemEventParameter_CanSM_FdcThresholdReached: display-identifier=DemEventParameter_CanSM_FdcThresholdReached, resulting-properties={base-type=uint8, sw-bit-representation={bit-position=1, number-of-bits=1}, sw-calibration-access=READ-ONLY, compu {0=FALSE, 1=TRUE}, data-constr=boolean}  # SI status bit 0 (FDC threshold reached).
              DemEventParameter_22938_FdcThresholdReached: display-identifier=DemEventParameter_22938_FdcThresholdReached, resulting-properties={base-type=uint8, sw-bit-representation={bit-position=2, number-of-bits=1}, sw-calibration-access=READ-ONLY, compu {0=FALSE, 1=TRUE}, data-constr=boolean}  # SI status bit 0 (FDC threshold reached).
              DemEventParameter_22940_FdcThresholdReached: display-identifier=DemEventParameter_22940_FdcThresholdReached, resulting-properties={base-type=uint8, sw-bit-representation={bit-position=3, number-of-bits=1}, sw-calibration-access=READ-ONLY, compu {0=FALSE, 1=TRUE}, data-constr=boolean}  # SI status bit 0 (FDC threshold reached).
          mc data instance FdcThresholdReachedTOC: category=ARRAY, array-size=4, symbol=fdcThresholdReachedTOC
            4 x mc data instance, all with category=VALUE, symbol=[0]:
              DemEventParameter_EEP_FdcThresholdReachedTOC: display-identifier=DemEventParameter_EEP_FdcThresholdReachedTOC, resulting-properties={base-type=uint8, sw-bit-representation={bit-position=0, number-of-bits=1}, sw-calibration-access=READ-ONLY, compu {0=FALSE, 1=TRUE}, data-constr=boolean}  # SI status bit 1 (FDC threshold reached this operation cycle).
              DemEventParameter_CanSM_FdcThresholdReachedTOC: display-identifier=DemEventParameter_CanSM_FdcThresholdReachedTOC, resulting-properties={base-type=uint8, sw-bit-representation={bit-position=1, number-of-bits=1}, sw-calibration-access=READ-ONLY, compu {0=FALSE, 1=TRUE}, data-constr=boolean}  # SI status bit 1 (FDC threshold reached this operation cycle).
              DemEventParameter_22938_FdcThresholdReachedTOC: display-identifier=DemEventParameter_22938_FdcThresholdReachedTOC, resulting-properties={base-type=uint8, sw-bit-representation={bit-position=2, number-of-bits=1}, sw-calibration-access=READ-ONLY, compu {0=FALSE, 1=TRUE}, data-constr=boolean}  # SI status bit 1 (FDC threshold reached this operation cycle).
              DemEventParameter_22940_FdcThresholdReachedTOC: display-identifier=DemEventParameter_22940_FdcThresholdReachedTOC, resulting-properties={base-type=uint8, sw-bit-representation={bit-position=3, number-of-bits=1}, sw-calibration-access=READ-ONLY, compu {0=FALSE, 1=TRUE}, data-constr=boolean}  # SI status bit 1 (FDC threshold reached this operation cycle).
        CounterDbCounter: category=ARRAY, array-size=4
          4 x mc data instance, all with category=VALUE, resulting-properties={base-type=sint16, sw-calibration-access=READ-ONLY, data-constr=sint16}:
            DemEventParameter_EEP_CounterDbCounter: display-identifier=DemEventParameter_EEP_CounterDbCounter, symbol=[0]  # DemEventParameter_EEP counter based debouncing counter.
            DemEventParameter_CanSM_CounterDbCounter: display-identifier=DemEventParameter_CanSM_CounterDbCounter, symbol=[1]  # DemEventParameter_CanSM counter based debouncing counter.
            DemEventParameter_22938_CounterDbCounter: display-identifier=DemEventParameter_22938_CounterDbCounter, symbol=[2]  # DemEventParameter_22938 counter based debouncing counter.
            DemEventParameter_22940_CounterDbCounter: display-identifier=DemEventParameter_22940_CounterDbCounter, symbol=[3]  # DemEventParameter_22940 counter based debouncing counter.
        PrimaryEventMemoryEntry01: category=STRUCTURE, symbol=Dem_NvPrimaryEvMemEntry01
          18 x mc data instance:
            EventId: category=VALUE, display-identifier=PrimaryEventMemoryEntry01_EventId, resulting-properties={sw-calibration-access=READ-ONLY, compu-method=EVENT_ID_CM, range raw 1..4, implementation-data-type=Dem_EventIdType}, symbol=event_id  # The stored event identifier. 0 if unused.
            ExtendedDataStorageIndex: category=VALUE, display-identifier=PrimaryEventMemoryEntry01_ExtendedDataStorageIndex, resulting-properties={base-type=uint16, sw-calibration-access=READ-ONLY, compu {texttable}, data-constr=uint16}, symbol=ed_storage_index  # Index of the extended data storage connected to this event. Only valid if PrimaryEventMemoryEntry01_ExtendedDataStored is TRUE.
            DevelopmentAFreezeFrameStorageIndex: category=VALUE, display-identifier=PrimaryEventMemoryEntry01_DevelopmentAFreezeFrameStorageIndex, resulting-properties={base-type=uint16, sw-calibration-access=READ-ONLY, compu {65535=FREEZEFRAME_DATA_INVALID}, data-constr=uint16}, symbol=dev_a_ff_index  # Index of the development A freeze frame storage connected to this event. The value 0xFFFF indicates that there is no freeze frame stored.
            DevelopmentBFreezeFrameStorageIndex: category=VALUE, display-identifier=PrimaryEventMemoryEntry01_DevelopmentBFreezeFrameStorageIndex, resulting-properties={base-type=uint16, sw-calibration-access=READ-ONLY, compu {65535=FREEZEFRAME_DATA_INVALID}, data-constr=uint16}, symbol=dev_b_ff_index  # Index of the development B freeze frame storage connected to this event. The value 0xFFFF indicates that there is no freeze frame stored.
            FreezeFrameIndexes: category=ARRAY, array-size=1, display-identifier=PrimaryEventMemoryEntry01_FreezeFrameIndexes, resulting-properties={base-type=uint16, sw-calibration-access=READ-ONLY, compu {65535=FREEZEFRAME_DATA_INVALID}, data-constr=uint16}, symbol=ff_index  # Array of indexes of the freeze frame storages connected to this event. Only valid if PrimaryEventMemoryEntry01_NumberOfStoredFreezeFrames is equal or higher than the index.
            RecordNumbers: category=ARRAY, array-size=1, display-identifier=PrimaryEventMemoryEntry01_RecordNumbers, resulting-properties={base-type=uint8, sw-calibration-access=READ-ONLY, data-constr=uint8}, symbol=record_numbers  # Array of record numbers of freeze frames (if stored).
            NumberOfStoredFreezeFrames: category=VALUE, display-identifier=PrimaryEventMemoryEntry01_NumberOfStoredFreezeFrames, resulting-properties={base-type=uint8, sw-calibration-access=READ-ONLY, data-constr=uint8}, symbol=num_stored_ff  # Number of standard freeze frames stored for this event.
            ExtendedDataStored: category=VALUE, display-identifier=PrimaryEventMemoryEntry01_ExtendedDataStored, resulting-properties={base-type=boolean, sw-calibration-access=READ-ONLY, compu {0=FALSE, 1=TRUE}, data-constr=boolean}, symbol=ed_stored  # Status variable that indicates if the event is connected to an external extended data storage area.
            UdsStatus: category=VALUE, display-identifier=PrimaryEventMemoryEntry01_UdsStatus, resulting-properties={base-type=uint8, sw-calibration-access=READ-ONLY, data-constr=uint8}, symbol=uds_status  # Copy of the status stored in {EventName}_UdsStatus.
            Si: category=VALUE, display-identifier=PrimaryEventMemoryEntry01_Si, resulting-properties={base-type=uint8, sw-calibration-access=READ-ONLY, data-constr=uint8}, symbol=si  # Copy of the status stored in {EventName}_FdcThresholdReached and {EventName}_FdcThresholdReachedTOC.
            OccurrenceCounter: category=VALUE, display-identifier=PrimaryEventMemoryEntry01_OccurrenceCounter, resulting-properties={base-type=uint8, sw-calibration-access=READ-ONLY, data-constr=uint8}, symbol=occurrence_counter  # Counter for number of event occurrences used for off board analysis.
            CyclesSinceLastFailed: category=VALUE, display-identifier=PrimaryEventMemoryEntry01_CyclesSinceLastFailed, resulting-properties={base-type=uint8, sw-calibration-access=READ-ONLY, data-constr=uint8}, symbol=cycles_since_last_failed  # Representing the number of operation cycles since the DTC fault detection counter last reached its maximum value of +127 (since DTC information was last cleared). All operation cycles, including those in which the test has not been completed shall be included.
            CyclesSinceFirstFailed: category=VALUE, display-identifier=PrimaryEventMemoryEntry01_CyclesSinceFirstFailed, resulting-properties={base-type=uint8, sw-calibration-access=READ-ONLY, data-constr=uint8}, symbol=cycles_since_first_failed  # Representing the number of operation cycles since the DTC fault detection counter first reached its maximum value of +127 (since DTC information was last cleared). All operation cycles, including those in which the test has not been completed shall be included.
            FailedCycles: category=VALUE, display-identifier=PrimaryEventMemoryEntry01_FailedCycles, resulting-properties={base-type=uint8, sw-calibration-access=READ-ONLY, data-constr=uint8}, symbol=failed_cycles  # Representing the number of operation cycles during which the DTC fault detection counter reached its maximum value of +127 (since DTC information was last cleared).
            AgingCounter: category=VALUE, display-identifier=PrimaryEventMemoryEntry01_AgingCounter, resulting-properties={base-type=uint8, sw-calibration-access=READ-ONLY, data-constr=uint8}, symbol=aging_counter  # Counter used for aging which is incremented at end of operation cycle. Additional conditions depends on the setting of configuration parameter DemAgingRequieresTestedCycle.
            WirBits: category=ARRAY, array-size=1, display-identifier=PrimaryEventMemoryEntry01_WirBits, resulting-properties={base-type=uint8, sw-calibration-access=READ-ONLY, data-constr=uint8}, symbol=wir_bits  # Bit-array of indicator specific WIR-bits.
            FailureCounter: category=ARRAY, array-size=1, display-identifier=PrimaryEventMemoryEntry01_FailureCounter, resulting-properties={base-type=uint8, sw-calibration-access=READ-ONLY, data-constr=uint8}, symbol=failure_counter  # The number of consecutive operation cycles (including the current operation cycle) during which the debouncing counter reached its maximum value (since DTC information was last cleared).
            HealingCounter: category=ARRAY, array-size=1, display-identifier=PrimaryEventMemoryEntry01_HealingCounter, resulting-properties={base-type=uint8, sw-calibration-access=READ-ONLY, data-constr=uint8}, symbol=healing_counter  # Counter used for healing which is incremented with one at end of operation cycle if UDS DTC status bit 2 (TestFailedThisOperationCycle) and bit 6 (TestNotCompletedThisOperationCycle) are not set.
        PrimaryEventMemoryEntry02: category=STRUCTURE, symbol=Dem_NvPrimaryEvMemEntry02
          18 x mc data instance:
            EventId: category=VALUE, display-identifier=PrimaryEventMemoryEntry02_EventId, resulting-properties={sw-calibration-access=READ-ONLY, compu-method=EVENT_ID_CM, range raw 1..4, implementation-data-type=Dem_EventIdType}, symbol=event_id  # The stored event identifier. 0 if unused.
            ExtendedDataStorageIndex: category=VALUE, display-identifier=PrimaryEventMemoryEntry02_ExtendedDataStorageIndex, resulting-properties={base-type=uint16, sw-calibration-access=READ-ONLY, compu {texttable}, data-constr=uint16}, symbol=ed_storage_index  # Index of the extended data storage connected to this event. Only valid if PrimaryEventMemoryEntry02_ExtendedDataStored is TRUE.
            DevelopmentAFreezeFrameStorageIndex: category=VALUE, display-identifier=PrimaryEventMemoryEntry02_DevelopmentAFreezeFrameStorageIndex, resulting-properties={base-type=uint16, sw-calibration-access=READ-ONLY, compu {65535=FREEZEFRAME_DATA_INVALID}, data-constr=uint16}, symbol=dev_a_ff_index  # Index of the development A freeze frame storage connected to this event. The value 0xFFFF indicates that there is no freeze frame stored.
            DevelopmentBFreezeFrameStorageIndex: category=VALUE, display-identifier=PrimaryEventMemoryEntry02_DevelopmentBFreezeFrameStorageIndex, resulting-properties={base-type=uint16, sw-calibration-access=READ-ONLY, compu {65535=FREEZEFRAME_DATA_INVALID}, data-constr=uint16}, symbol=dev_b_ff_index  # Index of the development B freeze frame storage connected to this event. The value 0xFFFF indicates that there is no freeze frame stored.
            FreezeFrameIndexes: category=ARRAY, array-size=1, display-identifier=PrimaryEventMemoryEntry02_FreezeFrameIndexes, resulting-properties={base-type=uint16, sw-calibration-access=READ-ONLY, compu {65535=FREEZEFRAME_DATA_INVALID}, data-constr=uint16}, symbol=ff_index  # Array of indexes of the freeze frame storages connected to this event. Only valid if PrimaryEventMemoryEntry02_NumberOfStoredFreezeFrames is equal or higher than the index.
            RecordNumbers: category=ARRAY, array-size=1, display-identifier=PrimaryEventMemoryEntry02_RecordNumbers, resulting-properties={base-type=uint8, sw-calibration-access=READ-ONLY, data-constr=uint8}, symbol=record_numbers  # Array of record numbers of freeze frames (if stored).
            NumberOfStoredFreezeFrames: category=VALUE, display-identifier=PrimaryEventMemoryEntry02_NumberOfStoredFreezeFrames, resulting-properties={base-type=uint8, sw-calibration-access=READ-ONLY, data-constr=uint8}, symbol=num_stored_ff  # Number of standard freeze frames stored for this event.
            ExtendedDataStored: category=VALUE, display-identifier=PrimaryEventMemoryEntry02_ExtendedDataStored, resulting-properties={base-type=boolean, sw-calibration-access=READ-ONLY, compu {0=FALSE, 1=TRUE}, data-constr=boolean}, symbol=ed_stored  # Status variable that indicates if the event is connected to an external extended data storage area.
            UdsStatus: category=VALUE, display-identifier=PrimaryEventMemoryEntry02_UdsStatus, resulting-properties={base-type=uint8, sw-calibration-access=READ-ONLY, data-constr=uint8}, symbol=uds_status  # Copy of the status stored in {EventName}_UdsStatus.
            Si: category=VALUE, display-identifier=PrimaryEventMemoryEntry02_Si, resulting-properties={base-type=uint8, sw-calibration-access=READ-ONLY, data-constr=uint8}, symbol=si  # Copy of the status stored in {EventName}_FdcThresholdReached and {EventName}_FdcThresholdReachedTOC.
            OccurrenceCounter: category=VALUE, display-identifier=PrimaryEventMemoryEntry02_OccurrenceCounter, resulting-properties={base-type=uint8, sw-calibration-access=READ-ONLY, data-constr=uint8}, symbol=occurrence_counter  # Counter for number of event occurrences used for off board analysis.
            CyclesSinceLastFailed: category=VALUE, display-identifier=PrimaryEventMemoryEntry02_CyclesSinceLastFailed, resulting-properties={base-type=uint8, sw-calibration-access=READ-ONLY, data-constr=uint8}, symbol=cycles_since_last_failed  # Representing the number of operation cycles since the DTC fault detection counter last reached its maximum value of +127 (since DTC information was last cleared). All operation cycles, including those in which the test has not been completed shall be included.
            CyclesSinceFirstFailed: category=VALUE, display-identifier=PrimaryEventMemoryEntry02_CyclesSinceFirstFailed, resulting-properties={base-type=uint8, sw-calibration-access=READ-ONLY, data-constr=uint8}, symbol=cycles_since_first_failed  # Representing the number of operation cycles since the DTC fault detection counter first reached its maximum value of +127 (since DTC information was last cleared). All operation cycles, including those in which the test has not been completed shall be included.
            FailedCycles: category=VALUE, display-identifier=PrimaryEventMemoryEntry02_FailedCycles, resulting-properties={base-type=uint8, sw-calibration-access=READ-ONLY, data-constr=uint8}, symbol=failed_cycles  # Representing the number of operation cycles during which the DTC fault detection counter reached its maximum value of +127 (since DTC information was last cleared).
            AgingCounter: category=VALUE, display-identifier=PrimaryEventMemoryEntry02_AgingCounter, resulting-properties={base-type=uint8, sw-calibration-access=READ-ONLY, data-constr=uint8}, symbol=aging_counter  # Counter used for aging which is incremented at end of operation cycle. Additional conditions depends on the setting of configuration parameter DemAgingRequieresTestedCycle.
            WirBits: category=ARRAY, array-size=1, display-identifier=PrimaryEventMemoryEntry02_WirBits, resulting-properties={base-type=uint8, sw-calibration-access=READ-ONLY, data-constr=uint8}, symbol=wir_bits  # Bit-array of indicator specific WIR-bits.
            FailureCounter: category=ARRAY, array-size=1, display-identifier=PrimaryEventMemoryEntry02_FailureCounter, resulting-properties={base-type=uint8, sw-calibration-access=READ-ONLY, data-constr=uint8}, symbol=failure_counter  # The number of consecutive operation cycles (including the current operation cycle) during which the debouncing counter reached its maximum value (since DTC information was last cleared).
            HealingCounter: category=ARRAY, array-size=1, display-identifier=PrimaryEventMemoryEntry02_HealingCounter, resulting-properties={base-type=uint8, sw-calibration-access=READ-ONLY, data-constr=uint8}, symbol=healing_counter  # Counter used for healing which is incremented with one at end of operation cycle if UDS DTC status bit 2 (TestFailedThisOperationCycle) and bit 6 (TestNotCompletedThisOperationCycle) are not set.
        PrimaryEventMemoryEntry03: category=STRUCTURE, symbol=Dem_NvPrimaryEvMemEntry03
          18 x mc data instance:
            EventId: category=VALUE, display-identifier=PrimaryEventMemoryEntry03_EventId, resulting-properties={sw-calibration-access=READ-ONLY, compu-method=EVENT_ID_CM, range raw 1..4, implementation-data-type=Dem_EventIdType}, symbol=event_id  # The stored event identifier. 0 if unused.
            ExtendedDataStorageIndex: category=VALUE, display-identifier=PrimaryEventMemoryEntry03_ExtendedDataStorageIndex, resulting-properties={base-type=uint16, sw-calibration-access=READ-ONLY, compu {texttable}, data-constr=uint16}, symbol=ed_storage_index  # Index of the extended data storage connected to this event. Only valid if PrimaryEventMemoryEntry03_ExtendedDataStored is TRUE.
            DevelopmentAFreezeFrameStorageIndex: category=VALUE, display-identifier=PrimaryEventMemoryEntry03_DevelopmentAFreezeFrameStorageIndex, resulting-properties={base-type=uint16, sw-calibration-access=READ-ONLY, compu {65535=FREEZEFRAME_DATA_INVALID}, data-constr=uint16}, symbol=dev_a_ff_index  # Index of the development A freeze frame storage connected to this event. The value 0xFFFF indicates that there is no freeze frame stored.
            DevelopmentBFreezeFrameStorageIndex: category=VALUE, display-identifier=PrimaryEventMemoryEntry03_DevelopmentBFreezeFrameStorageIndex, resulting-properties={base-type=uint16, sw-calibration-access=READ-ONLY, compu {65535=FREEZEFRAME_DATA_INVALID}, data-constr=uint16}, symbol=dev_b_ff_index  # Index of the development B freeze frame storage connected to this event. The value 0xFFFF indicates that there is no freeze frame stored.
            FreezeFrameIndexes: category=ARRAY, array-size=1, display-identifier=PrimaryEventMemoryEntry03_FreezeFrameIndexes, resulting-properties={base-type=uint16, sw-calibration-access=READ-ONLY, compu {65535=FREEZEFRAME_DATA_INVALID}, data-constr=uint16}, symbol=ff_index  # Array of indexes of the freeze frame storages connected to this event. Only valid if PrimaryEventMemoryEntry03_NumberOfStoredFreezeFrames is equal or higher than the index.
            RecordNumbers: category=ARRAY, array-size=1, display-identifier=PrimaryEventMemoryEntry03_RecordNumbers, resulting-properties={base-type=uint8, sw-calibration-access=READ-ONLY, data-constr=uint8}, symbol=record_numbers  # Array of record numbers of freeze frames (if stored).
            NumberOfStoredFreezeFrames: category=VALUE, display-identifier=PrimaryEventMemoryEntry03_NumberOfStoredFreezeFrames, resulting-properties={base-type=uint8, sw-calibration-access=READ-ONLY, data-constr=uint8}, symbol=num_stored_ff  # Number of standard freeze frames stored for this event.
            ExtendedDataStored: category=VALUE, display-identifier=PrimaryEventMemoryEntry03_ExtendedDataStored, resulting-properties={base-type=boolean, sw-calibration-access=READ-ONLY, compu {0=FALSE, 1=TRUE}, data-constr=boolean}, symbol=ed_stored  # Status variable that indicates if the event is connected to an external extended data storage area.
            UdsStatus: category=VALUE, display-identifier=PrimaryEventMemoryEntry03_UdsStatus, resulting-properties={base-type=uint8, sw-calibration-access=READ-ONLY, data-constr=uint8}, symbol=uds_status  # Copy of the status stored in {EventName}_UdsStatus.
            Si: category=VALUE, display-identifier=PrimaryEventMemoryEntry03_Si, resulting-properties={base-type=uint8, sw-calibration-access=READ-ONLY, data-constr=uint8}, symbol=si  # Copy of the status stored in {EventName}_FdcThresholdReached and {EventName}_FdcThresholdReachedTOC.
            OccurrenceCounter: category=VALUE, display-identifier=PrimaryEventMemoryEntry03_OccurrenceCounter, resulting-properties={base-type=uint8, sw-calibration-access=READ-ONLY, data-constr=uint8}, symbol=occurrence_counter  # Counter for number of event occurrences used for off board analysis.
            CyclesSinceLastFailed: category=VALUE, display-identifier=PrimaryEventMemoryEntry03_CyclesSinceLastFailed, resulting-properties={base-type=uint8, sw-calibration-access=READ-ONLY, data-constr=uint8}, symbol=cycles_since_last_failed  # Representing the number of operation cycles since the DTC fault detection counter last reached its maximum value of +127 (since DTC information was last cleared). All operation cycles, including those in which the test has not been completed shall be included.
            CyclesSinceFirstFailed: category=VALUE, display-identifier=PrimaryEventMemoryEntry03_CyclesSinceFirstFailed, resulting-properties={base-type=uint8, sw-calibration-access=READ-ONLY, data-constr=uint8}, symbol=cycles_since_first_failed  # Representing the number of operation cycles since the DTC fault detection counter first reached its maximum value of +127 (since DTC information was last cleared). All operation cycles, including those in which the test has not been completed shall be included.
            FailedCycles: category=VALUE, display-identifier=PrimaryEventMemoryEntry03_FailedCycles, resulting-properties={base-type=uint8, sw-calibration-access=READ-ONLY, data-constr=uint8}, symbol=failed_cycles  # Representing the number of operation cycles during which the DTC fault detection counter reached its maximum value of +127 (since DTC information was last cleared).
            AgingCounter: category=VALUE, display-identifier=PrimaryEventMemoryEntry03_AgingCounter, resulting-properties={base-type=uint8, sw-calibration-access=READ-ONLY, data-constr=uint8}, symbol=aging_counter  # Counter used for aging which is incremented at end of operation cycle. Additional conditions depends on the setting of configuration parameter DemAgingRequieresTestedCycle.
            WirBits: category=ARRAY, array-size=1, display-identifier=PrimaryEventMemoryEntry03_WirBits, resulting-properties={base-type=uint8, sw-calibration-access=READ-ONLY, data-constr=uint8}, symbol=wir_bits  # Bit-array of indicator specific WIR-bits.
            FailureCounter: category=ARRAY, array-size=1, display-identifier=PrimaryEventMemoryEntry03_FailureCounter, resulting-properties={base-type=uint8, sw-calibration-access=READ-ONLY, data-constr=uint8}, symbol=failure_counter  # The number of consecutive operation cycles (including the current operation cycle) during which the debouncing counter reached its maximum value (since DTC information was last cleared).
            HealingCounter: category=ARRAY, array-size=1, display-identifier=PrimaryEventMemoryEntry03_HealingCounter, resulting-properties={base-type=uint8, sw-calibration-access=READ-ONLY, data-constr=uint8}, symbol=healing_counter  # Counter used for healing which is incremented with one at end of operation cycle if UDS DTC status bit 2 (TestFailedThisOperationCycle) and bit 6 (TestNotCompletedThisOperationCycle) are not set.
        PrimaryEventMemoryEntry04: category=STRUCTURE, symbol=Dem_NvPrimaryEvMemEntry04
          18 x mc data instance:
            EventId: category=VALUE, display-identifier=PrimaryEventMemoryEntry04_EventId, resulting-properties={sw-calibration-access=READ-ONLY, compu-method=EVENT_ID_CM, range raw 1..4, implementation-data-type=Dem_EventIdType}, symbol=event_id  # The stored event identifier. 0 if unused.
            ExtendedDataStorageIndex: category=VALUE, display-identifier=PrimaryEventMemoryEntry04_ExtendedDataStorageIndex, resulting-properties={base-type=uint16, sw-calibration-access=READ-ONLY, compu {texttable}, data-constr=uint16}, symbol=ed_storage_index  # Index of the extended data storage connected to this event. Only valid if PrimaryEventMemoryEntry04_ExtendedDataStored is TRUE.
            DevelopmentAFreezeFrameStorageIndex: category=VALUE, display-identifier=PrimaryEventMemoryEntry04_DevelopmentAFreezeFrameStorageIndex, resulting-properties={base-type=uint16, sw-calibration-access=READ-ONLY, compu {65535=FREEZEFRAME_DATA_INVALID}, data-constr=uint16}, symbol=dev_a_ff_index  # Index of the development A freeze frame storage connected to this event. The value 0xFFFF indicates that there is no freeze frame stored.
            DevelopmentBFreezeFrameStorageIndex: category=VALUE, display-identifier=PrimaryEventMemoryEntry04_DevelopmentBFreezeFrameStorageIndex, resulting-properties={base-type=uint16, sw-calibration-access=READ-ONLY, compu {65535=FREEZEFRAME_DATA_INVALID}, data-constr=uint16}, symbol=dev_b_ff_index  # Index of the development B freeze frame storage connected to this event. The value 0xFFFF indicates that there is no freeze frame stored.
            FreezeFrameIndexes: category=ARRAY, array-size=1, display-identifier=PrimaryEventMemoryEntry04_FreezeFrameIndexes, resulting-properties={base-type=uint16, sw-calibration-access=READ-ONLY, compu {65535=FREEZEFRAME_DATA_INVALID}, data-constr=uint16}, symbol=ff_index  # Array of indexes of the freeze frame storages connected to this event. Only valid if PrimaryEventMemoryEntry04_NumberOfStoredFreezeFrames is equal or higher than the index.
            RecordNumbers: category=ARRAY, array-size=1, display-identifier=PrimaryEventMemoryEntry04_RecordNumbers, resulting-properties={base-type=uint8, sw-calibration-access=READ-ONLY, data-constr=uint8}, symbol=record_numbers  # Array of record numbers of freeze frames (if stored).
            NumberOfStoredFreezeFrames: category=VALUE, display-identifier=PrimaryEventMemoryEntry04_NumberOfStoredFreezeFrames, resulting-properties={base-type=uint8, sw-calibration-access=READ-ONLY, data-constr=uint8}, symbol=num_stored_ff  # Number of standard freeze frames stored for this event.
            ExtendedDataStored: category=VALUE, display-identifier=PrimaryEventMemoryEntry04_ExtendedDataStored, resulting-properties={base-type=boolean, sw-calibration-access=READ-ONLY, compu {0=FALSE, 1=TRUE}, data-constr=boolean}, symbol=ed_stored  # Status variable that indicates if the event is connected to an external extended data storage area.
            UdsStatus: category=VALUE, display-identifier=PrimaryEventMemoryEntry04_UdsStatus, resulting-properties={base-type=uint8, sw-calibration-access=READ-ONLY, data-constr=uint8}, symbol=uds_status  # Copy of the status stored in {EventName}_UdsStatus.
            Si: category=VALUE, display-identifier=PrimaryEventMemoryEntry04_Si, resulting-properties={base-type=uint8, sw-calibration-access=READ-ONLY, data-constr=uint8}, symbol=si  # Copy of the status stored in {EventName}_FdcThresholdReached and {EventName}_FdcThresholdReachedTOC.
            OccurrenceCounter: category=VALUE, display-identifier=PrimaryEventMemoryEntry04_OccurrenceCounter, resulting-properties={base-type=uint8, sw-calibration-access=READ-ONLY, data-constr=uint8}, symbol=occurrence_counter  # Counter for number of event occurrences used for off board analysis.
            CyclesSinceLastFailed: category=VALUE, display-identifier=PrimaryEventMemoryEntry04_CyclesSinceLastFailed, resulting-properties={base-type=uint8, sw-calibration-access=READ-ONLY, data-constr=uint8}, symbol=cycles_since_last_failed  # Representing the number of operation cycles since the DTC fault detection counter last reached its maximum value of +127 (since DTC information was last cleared). All operation cycles, including those in which the test has not been completed shall be included.
            CyclesSinceFirstFailed: category=VALUE, display-identifier=PrimaryEventMemoryEntry04_CyclesSinceFirstFailed, resulting-properties={base-type=uint8, sw-calibration-access=READ-ONLY, data-constr=uint8}, symbol=cycles_since_first_failed  # Representing the number of operation cycles since the DTC fault detection counter first reached its maximum value of +127 (since DTC information was last cleared). All operation cycles, including those in which the test has not been completed shall be included.
            FailedCycles: category=VALUE, display-identifier=PrimaryEventMemoryEntry04_FailedCycles, resulting-properties={base-type=uint8, sw-calibration-access=READ-ONLY, data-constr=uint8}, symbol=failed_cycles  # Representing the number of operation cycles during which the DTC fault detection counter reached its maximum value of +127 (since DTC information was last cleared).
            AgingCounter: category=VALUE, display-identifier=PrimaryEventMemoryEntry04_AgingCounter, resulting-properties={base-type=uint8, sw-calibration-access=READ-ONLY, data-constr=uint8}, symbol=aging_counter  # Counter used for aging which is incremented at end of operation cycle. Additional conditions depends on the setting of configuration parameter DemAgingRequieresTestedCycle.
            WirBits: category=ARRAY, array-size=1, display-identifier=PrimaryEventMemoryEntry04_WirBits, resulting-properties={base-type=uint8, sw-calibration-access=READ-ONLY, data-constr=uint8}, symbol=wir_bits  # Bit-array of indicator specific WIR-bits.
            FailureCounter: category=ARRAY, array-size=1, display-identifier=PrimaryEventMemoryEntry04_FailureCounter, resulting-properties={base-type=uint8, sw-calibration-access=READ-ONLY, data-constr=uint8}, symbol=failure_counter  # The number of consecutive operation cycles (including the current operation cycle) during which the debouncing counter reached its maximum value (since DTC information was last cleared).
            HealingCounter: category=ARRAY, array-size=1, display-identifier=PrimaryEventMemoryEntry04_HealingCounter, resulting-properties={base-type=uint8, sw-calibration-access=READ-ONLY, data-constr=uint8}, symbol=healing_counter  # Counter used for healing which is incremented with one at end of operation cycle if UDS DTC status bit 2 (TestFailedThisOperationCycle) and bit 6 (TestNotCompletedThisOperationCycle) are not set.
        PrimaryEventMemoryEntry05: category=STRUCTURE, symbol=Dem_NvPrimaryEvMemEntry05
          18 x mc data instance:
            EventId: category=VALUE, display-identifier=PrimaryEventMemoryEntry05_EventId, resulting-properties={sw-calibration-access=READ-ONLY, compu-method=EVENT_ID_CM, range raw 1..4, implementation-data-type=Dem_EventIdType}, symbol=event_id  # The stored event identifier. 0 if unused.
            ExtendedDataStorageIndex: category=VALUE, display-identifier=PrimaryEventMemoryEntry05_ExtendedDataStorageIndex, resulting-properties={base-type=uint16, sw-calibration-access=READ-ONLY, compu {texttable}, data-constr=uint16}, symbol=ed_storage_index  # Index of the extended data storage connected to this event. Only valid if PrimaryEventMemoryEntry05_ExtendedDataStored is TRUE.
            DevelopmentAFreezeFrameStorageIndex: category=VALUE, display-identifier=PrimaryEventMemoryEntry05_DevelopmentAFreezeFrameStorageIndex, resulting-properties={base-type=uint16, sw-calibration-access=READ-ONLY, compu {65535=FREEZEFRAME_DATA_INVALID}, data-constr=uint16}, symbol=dev_a_ff_index  # Index of the development A freeze frame storage connected to this event. The value 0xFFFF indicates that there is no freeze frame stored.
            DevelopmentBFreezeFrameStorageIndex: category=VALUE, display-identifier=PrimaryEventMemoryEntry05_DevelopmentBFreezeFrameStorageIndex, resulting-properties={base-type=uint16, sw-calibration-access=READ-ONLY, compu {65535=FREEZEFRAME_DATA_INVALID}, data-constr=uint16}, symbol=dev_b_ff_index  # Index of the development B freeze frame storage connected to this event. The value 0xFFFF indicates that there is no freeze frame stored.
            FreezeFrameIndexes: category=ARRAY, array-size=1, display-identifier=PrimaryEventMemoryEntry05_FreezeFrameIndexes, resulting-properties={base-type=uint16, sw-calibration-access=READ-ONLY, compu {65535=FREEZEFRAME_DATA_INVALID}, data-constr=uint16}, symbol=ff_index  # Array of indexes of the freeze frame storages connected to this event. Only valid if PrimaryEventMemoryEntry05_NumberOfStoredFreezeFrames is equal or higher than the index.
            RecordNumbers: category=ARRAY, array-size=1, display-identifier=PrimaryEventMemoryEntry05_RecordNumbers, resulting-properties={base-type=uint8, sw-calibration-access=READ-ONLY, data-constr=uint8}, symbol=record_numbers  # Array of record numbers of freeze frames (if stored).
            NumberOfStoredFreezeFrames: category=VALUE, display-identifier=PrimaryEventMemoryEntry05_NumberOfStoredFreezeFrames, resulting-properties={base-type=uint8, sw-calibration-access=READ-ONLY, data-constr=uint8}, symbol=num_stored_ff  # Number of standard freeze frames stored for this event.
            ExtendedDataStored: category=VALUE, display-identifier=PrimaryEventMemoryEntry05_ExtendedDataStored, resulting-properties={base-type=boolean, sw-calibration-access=READ-ONLY, compu {0=FALSE, 1=TRUE}, data-constr=boolean}, symbol=ed_stored  # Status variable that indicates if the event is connected to an external extended data storage area.
            UdsStatus: category=VALUE, display-identifier=PrimaryEventMemoryEntry05_UdsStatus, resulting-properties={base-type=uint8, sw-calibration-access=READ-ONLY, data-constr=uint8}, symbol=uds_status  # Copy of the status stored in {EventName}_UdsStatus.
            Si: category=VALUE, display-identifier=PrimaryEventMemoryEntry05_Si, resulting-properties={base-type=uint8, sw-calibration-access=READ-ONLY, data-constr=uint8}, symbol=si  # Copy of the status stored in {EventName}_FdcThresholdReached and {EventName}_FdcThresholdReachedTOC.
            OccurrenceCounter: category=VALUE, display-identifier=PrimaryEventMemoryEntry05_OccurrenceCounter, resulting-properties={base-type=uint8, sw-calibration-access=READ-ONLY, data-constr=uint8}, symbol=occurrence_counter  # Counter for number of event occurrences used for off board analysis.
            CyclesSinceLastFailed: category=VALUE, display-identifier=PrimaryEventMemoryEntry05_CyclesSinceLastFailed, resulting-properties={base-type=uint8, sw-calibration-access=READ-ONLY, data-constr=uint8}, symbol=cycles_since_last_failed  # Representing the number of operation cycles since the DTC fault detection counter last reached its maximum value of +127 (since DTC information was last cleared). All operation cycles, including those in which the test has not been completed shall be included.
            CyclesSinceFirstFailed: category=VALUE, display-identifier=PrimaryEventMemoryEntry05_CyclesSinceFirstFailed, resulting-properties={base-type=uint8, sw-calibration-access=READ-ONLY, data-constr=uint8}, symbol=cycles_since_first_failed  # Representing the number of operation cycles since the DTC fault detection counter first reached its maximum value of +127 (since DTC information was last cleared). All operation cycles, including those in which the test has not been completed shall be included.
            FailedCycles: category=VALUE, display-identifier=PrimaryEventMemoryEntry05_FailedCycles, resulting-properties={base-type=uint8, sw-calibration-access=READ-ONLY, data-constr=uint8}, symbol=failed_cycles  # Representing the number of operation cycles during which the DTC fault detection counter reached its maximum value of +127 (since DTC information was last cleared).
            AgingCounter: category=VALUE, display-identifier=PrimaryEventMemoryEntry05_AgingCounter, resulting-properties={base-type=uint8, sw-calibration-access=READ-ONLY, data-constr=uint8}, symbol=aging_counter  # Counter used for aging which is incremented at end of operation cycle. Additional conditions depends on the setting of configuration parameter DemAgingRequieresTestedCycle.
            WirBits: category=ARRAY, array-size=1, display-identifier=PrimaryEventMemoryEntry05_WirBits, resulting-properties={base-type=uint8, sw-calibration-access=READ-ONLY, data-constr=uint8}, symbol=wir_bits  # Bit-array of indicator specific WIR-bits.
            FailureCounter: category=ARRAY, array-size=1, display-identifier=PrimaryEventMemoryEntry05_FailureCounter, resulting-properties={base-type=uint8, sw-calibration-access=READ-ONLY, data-constr=uint8}, symbol=failure_counter  # The number of consecutive operation cycles (including the current operation cycle) during which the debouncing counter reached its maximum value (since DTC information was last cleared).
            HealingCounter: category=ARRAY, array-size=1, display-identifier=PrimaryEventMemoryEntry05_HealingCounter, resulting-properties={base-type=uint8, sw-calibration-access=READ-ONLY, data-constr=uint8}, symbol=healing_counter  # Counter used for healing which is incremented with one at end of operation cycle if UDS DTC status bit 2 (TestFailedThisOperationCycle) and bit 6 (TestNotCompletedThisOperationCycle) are not set.
        PrimaryEventMemoryEntry06: category=STRUCTURE, symbol=Dem_NvPrimaryEvMemEntry06
          18 x mc data instance:
            EventId: category=VALUE, display-identifier=PrimaryEventMemoryEntry06_EventId, resulting-properties={sw-calibration-access=READ-ONLY, compu-method=EVENT_ID_CM, range raw 1..4, implementation-data-type=Dem_EventIdType}, symbol=event_id  # The stored event identifier. 0 if unused.
            ExtendedDataStorageIndex: category=VALUE, display-identifier=PrimaryEventMemoryEntry06_ExtendedDataStorageIndex, resulting-properties={base-type=uint16, sw-calibration-access=READ-ONLY, compu {texttable}, data-constr=uint16}, symbol=ed_storage_index  # Index of the extended data storage connected to this event. Only valid if PrimaryEventMemoryEntry06_ExtendedDataStored is TRUE.
            DevelopmentAFreezeFrameStorageIndex: category=VALUE, display-identifier=PrimaryEventMemoryEntry06_DevelopmentAFreezeFrameStorageIndex, resulting-properties={base-type=uint16, sw-calibration-access=READ-ONLY, compu {65535=FREEZEFRAME_DATA_INVALID}, data-constr=uint16}, symbol=dev_a_ff_index  # Index of the development A freeze frame storage connected to this event. The value 0xFFFF indicates that there is no freeze frame stored.
            DevelopmentBFreezeFrameStorageIndex: category=VALUE, display-identifier=PrimaryEventMemoryEntry06_DevelopmentBFreezeFrameStorageIndex, resulting-properties={base-type=uint16, sw-calibration-access=READ-ONLY, compu {65535=FREEZEFRAME_DATA_INVALID}, data-constr=uint16}, symbol=dev_b_ff_index  # Index of the development B freeze frame storage connected to this event. The value 0xFFFF indicates that there is no freeze frame stored.
            FreezeFrameIndexes: category=ARRAY, array-size=1, display-identifier=PrimaryEventMemoryEntry06_FreezeFrameIndexes, resulting-properties={base-type=uint16, sw-calibration-access=READ-ONLY, compu {65535=FREEZEFRAME_DATA_INVALID}, data-constr=uint16}, symbol=ff_index  # Array of indexes of the freeze frame storages connected to this event. Only valid if PrimaryEventMemoryEntry06_NumberOfStoredFreezeFrames is equal or higher than the index.
            RecordNumbers: category=ARRAY, array-size=1, display-identifier=PrimaryEventMemoryEntry06_RecordNumbers, resulting-properties={base-type=uint8, sw-calibration-access=READ-ONLY, data-constr=uint8}, symbol=record_numbers  # Array of record numbers of freeze frames (if stored).
            NumberOfStoredFreezeFrames: category=VALUE, display-identifier=PrimaryEventMemoryEntry06_NumberOfStoredFreezeFrames, resulting-properties={base-type=uint8, sw-calibration-access=READ-ONLY, data-constr=uint8}, symbol=num_stored_ff  # Number of standard freeze frames stored for this event.
            ExtendedDataStored: category=VALUE, display-identifier=PrimaryEventMemoryEntry06_ExtendedDataStored, resulting-properties={base-type=boolean, sw-calibration-access=READ-ONLY, compu {0=FALSE, 1=TRUE}, data-constr=boolean}, symbol=ed_stored  # Status variable that indicates if the event is connected to an external extended data storage area.
            UdsStatus: category=VALUE, display-identifier=PrimaryEventMemoryEntry06_UdsStatus, resulting-properties={base-type=uint8, sw-calibration-access=READ-ONLY, data-constr=uint8}, symbol=uds_status  # Copy of the status stored in {EventName}_UdsStatus.
            Si: category=VALUE, display-identifier=PrimaryEventMemoryEntry06_Si, resulting-properties={base-type=uint8, sw-calibration-access=READ-ONLY, data-constr=uint8}, symbol=si  # Copy of the status stored in {EventName}_FdcThresholdReached and {EventName}_FdcThresholdReachedTOC.
            OccurrenceCounter: category=VALUE, display-identifier=PrimaryEventMemoryEntry06_OccurrenceCounter, resulting-properties={base-type=uint8, sw-calibration-access=READ-ONLY, data-constr=uint8}, symbol=occurrence_counter  # Counter for number of event occurrences used for off board analysis.
            CyclesSinceLastFailed: category=VALUE, display-identifier=PrimaryEventMemoryEntry06_CyclesSinceLastFailed, resulting-properties={base-type=uint8, sw-calibration-access=READ-ONLY, data-constr=uint8}, symbol=cycles_since_last_failed  # Representing the number of operation cycles since the DTC fault detection counter last reached its maximum value of +127 (since DTC information was last cleared). All operation cycles, including those in which the test has not been completed shall be included.
            CyclesSinceFirstFailed: category=VALUE, display-identifier=PrimaryEventMemoryEntry06_CyclesSinceFirstFailed, resulting-properties={base-type=uint8, sw-calibration-access=READ-ONLY, data-constr=uint8}, symbol=cycles_since_first_failed  # Representing the number of operation cycles since the DTC fault detection counter first reached its maximum value of +127 (since DTC information was last cleared). All operation cycles, including those in which the test has not been completed shall be included.
            FailedCycles: category=VALUE, display-identifier=PrimaryEventMemoryEntry06_FailedCycles, resulting-properties={base-type=uint8, sw-calibration-access=READ-ONLY, data-constr=uint8}, symbol=failed_cycles  # Representing the number of operation cycles during which the DTC fault detection counter reached its maximum value of +127 (since DTC information was last cleared).
            AgingCounter: category=VALUE, display-identifier=PrimaryEventMemoryEntry06_AgingCounter, resulting-properties={base-type=uint8, sw-calibration-access=READ-ONLY, data-constr=uint8}, symbol=aging_counter  # Counter used for aging which is incremented at end of operation cycle. Additional conditions depends on the setting of configuration parameter DemAgingRequieresTestedCycle.
            WirBits: category=ARRAY, array-size=1, display-identifier=PrimaryEventMemoryEntry06_WirBits, resulting-properties={base-type=uint8, sw-calibration-access=READ-ONLY, data-constr=uint8}, symbol=wir_bits  # Bit-array of indicator specific WIR-bits.
            FailureCounter: category=ARRAY, array-size=1, display-identifier=PrimaryEventMemoryEntry06_FailureCounter, resulting-properties={base-type=uint8, sw-calibration-access=READ-ONLY, data-constr=uint8}, symbol=failure_counter  # The number of consecutive operation cycles (including the current operation cycle) during which the debouncing counter reached its maximum value (since DTC information was last cleared).
            HealingCounter: category=ARRAY, array-size=1, display-identifier=PrimaryEventMemoryEntry06_HealingCounter, resulting-properties={base-type=uint8, sw-calibration-access=READ-ONLY, data-constr=uint8}, symbol=healing_counter  # Counter used for healing which is incremented with one at end of operation cycle if UDS DTC status bit 2 (TestFailedThisOperationCycle) and bit 6 (TestNotCompletedThisOperationCycle) are not set.
        PrimaryEventMemoryEntry07: category=STRUCTURE, symbol=Dem_NvPrimaryEvMemEntry07
          18 x mc data instance:
            EventId: category=VALUE, display-identifier=PrimaryEventMemoryEntry07_EventId, resulting-properties={sw-calibration-access=READ-ONLY, compu-method=EVENT_ID_CM, range raw 1..4, implementation-data-type=Dem_EventIdType}, symbol=event_id  # The stored event identifier. 0 if unused.
            ExtendedDataStorageIndex: category=VALUE, display-identifier=PrimaryEventMemoryEntry07_ExtendedDataStorageIndex, resulting-properties={base-type=uint16, sw-calibration-access=READ-ONLY, compu {texttable}, data-constr=uint16}, symbol=ed_storage_index  # Index of the extended data storage connected to this event. Only valid if PrimaryEventMemoryEntry07_ExtendedDataStored is TRUE.
            DevelopmentAFreezeFrameStorageIndex: category=VALUE, display-identifier=PrimaryEventMemoryEntry07_DevelopmentAFreezeFrameStorageIndex, resulting-properties={base-type=uint16, sw-calibration-access=READ-ONLY, compu {65535=FREEZEFRAME_DATA_INVALID}, data-constr=uint16}, symbol=dev_a_ff_index  # Index of the development A freeze frame storage connected to this event. The value 0xFFFF indicates that there is no freeze frame stored.
            DevelopmentBFreezeFrameStorageIndex: category=VALUE, display-identifier=PrimaryEventMemoryEntry07_DevelopmentBFreezeFrameStorageIndex, resulting-properties={base-type=uint16, sw-calibration-access=READ-ONLY, compu {65535=FREEZEFRAME_DATA_INVALID}, data-constr=uint16}, symbol=dev_b_ff_index  # Index of the development B freeze frame storage connected to this event. The value 0xFFFF indicates that there is no freeze frame stored.
            FreezeFrameIndexes: category=ARRAY, array-size=1, display-identifier=PrimaryEventMemoryEntry07_FreezeFrameIndexes, resulting-properties={base-type=uint16, sw-calibration-access=READ-ONLY, compu {65535=FREEZEFRAME_DATA_INVALID}, data-constr=uint16}, symbol=ff_index  # Array of indexes of the freeze frame storages connected to this event. Only valid if PrimaryEventMemoryEntry07_NumberOfStoredFreezeFrames is equal or higher than the index.
            RecordNumbers: category=ARRAY, array-size=1, display-identifier=PrimaryEventMemoryEntry07_RecordNumbers, resulting-properties={base-type=uint8, sw-calibration-access=READ-ONLY, data-constr=uint8}, symbol=record_numbers  # Array of record numbers of freeze frames (if stored).
            NumberOfStoredFreezeFrames: category=VALUE, display-identifier=PrimaryEventMemoryEntry07_NumberOfStoredFreezeFrames, resulting-properties={base-type=uint8, sw-calibration-access=READ-ONLY, data-constr=uint8}, symbol=num_stored_ff  # Number of standard freeze frames stored for this event.
            ExtendedDataStored: category=VALUE, display-identifier=PrimaryEventMemoryEntry07_ExtendedDataStored, resulting-properties={base-type=boolean, sw-calibration-access=READ-ONLY, compu {0=FALSE, 1=TRUE}, data-constr=boolean}, symbol=ed_stored  # Status variable that indicates if the event is connected to an external extended data storage area.
            UdsStatus: category=VALUE, display-identifier=PrimaryEventMemoryEntry07_UdsStatus, resulting-properties={base-type=uint8, sw-calibration-access=READ-ONLY, data-constr=uint8}, symbol=uds_status  # Copy of the status stored in {EventName}_UdsStatus.
            Si: category=VALUE, display-identifier=PrimaryEventMemoryEntry07_Si, resulting-properties={base-type=uint8, sw-calibration-access=READ-ONLY, data-constr=uint8}, symbol=si  # Copy of the status stored in {EventName}_FdcThresholdReached and {EventName}_FdcThresholdReachedTOC.
            OccurrenceCounter: category=VALUE, display-identifier=PrimaryEventMemoryEntry07_OccurrenceCounter, resulting-properties={base-type=uint8, sw-calibration-access=READ-ONLY, data-constr=uint8}, symbol=occurrence_counter  # Counter for number of event occurrences used for off board analysis.
            CyclesSinceLastFailed: category=VALUE, display-identifier=PrimaryEventMemoryEntry07_CyclesSinceLastFailed, resulting-properties={base-type=uint8, sw-calibration-access=READ-ONLY, data-constr=uint8}, symbol=cycles_since_last_failed  # Representing the number of operation cycles since the DTC fault detection counter last reached its maximum value of +127 (since DTC information was last cleared). All operation cycles, including those in which the test has not been completed shall be included.
            CyclesSinceFirstFailed: category=VALUE, display-identifier=PrimaryEventMemoryEntry07_CyclesSinceFirstFailed, resulting-properties={base-type=uint8, sw-calibration-access=READ-ONLY, data-constr=uint8}, symbol=cycles_since_first_failed  # Representing the number of operation cycles since the DTC fault detection counter first reached its maximum value of +127 (since DTC information was last cleared). All operation cycles, including those in which the test has not been completed shall be included.
            FailedCycles: category=VALUE, display-identifier=PrimaryEventMemoryEntry07_FailedCycles, resulting-properties={base-type=uint8, sw-calibration-access=READ-ONLY, data-constr=uint8}, symbol=failed_cycles  # Representing the number of operation cycles during which the DTC fault detection counter reached its maximum value of +127 (since DTC information was last cleared).
            AgingCounter: category=VALUE, display-identifier=PrimaryEventMemoryEntry07_AgingCounter, resulting-properties={base-type=uint8, sw-calibration-access=READ-ONLY, data-constr=uint8}, symbol=aging_counter  # Counter used for aging which is incremented at end of operation cycle. Additional conditions depends on the setting of configuration parameter DemAgingRequieresTestedCycle.
            WirBits: category=ARRAY, array-size=1, display-identifier=PrimaryEventMemoryEntry07_WirBits, resulting-properties={base-type=uint8, sw-calibration-access=READ-ONLY, data-constr=uint8}, symbol=wir_bits  # Bit-array of indicator specific WIR-bits.
            FailureCounter: category=ARRAY, array-size=1, display-identifier=PrimaryEventMemoryEntry07_FailureCounter, resulting-properties={base-type=uint8, sw-calibration-access=READ-ONLY, data-constr=uint8}, symbol=failure_counter  # The number of consecutive operation cycles (including the current operation cycle) during which the debouncing counter reached its maximum value (since DTC information was last cleared).
            HealingCounter: category=ARRAY, array-size=1, display-identifier=PrimaryEventMemoryEntry07_HealingCounter, resulting-properties={base-type=uint8, sw-calibration-access=READ-ONLY, data-constr=uint8}, symbol=healing_counter  # Counter used for healing which is incremented with one at end of operation cycle if UDS DTC status bit 2 (TestFailedThisOperationCycle) and bit 6 (TestNotCompletedThisOperationCycle) are not set.
        PrimaryEventMemoryEntry08: category=STRUCTURE, symbol=Dem_NvPrimaryEvMemEntry08
          18 x mc data instance:
            EventId: category=VALUE, display-identifier=PrimaryEventMemoryEntry08_EventId, resulting-properties={sw-calibration-access=READ-ONLY, compu-method=EVENT_ID_CM, range raw 1..4, implementation-data-type=Dem_EventIdType}, symbol=event_id  # The stored event identifier. 0 if unused.
            ExtendedDataStorageIndex: category=VALUE, display-identifier=PrimaryEventMemoryEntry08_ExtendedDataStorageIndex, resulting-properties={base-type=uint16, sw-calibration-access=READ-ONLY, compu {texttable}, data-constr=uint16}, symbol=ed_storage_index  # Index of the extended data storage connected to this event. Only valid if PrimaryEventMemoryEntry08_ExtendedDataStored is TRUE.
            DevelopmentAFreezeFrameStorageIndex: category=VALUE, display-identifier=PrimaryEventMemoryEntry08_DevelopmentAFreezeFrameStorageIndex, resulting-properties={base-type=uint16, sw-calibration-access=READ-ONLY, compu {65535=FREEZEFRAME_DATA_INVALID}, data-constr=uint16}, symbol=dev_a_ff_index  # Index of the development A freeze frame storage connected to this event. The value 0xFFFF indicates that there is no freeze frame stored.
            DevelopmentBFreezeFrameStorageIndex: category=VALUE, display-identifier=PrimaryEventMemoryEntry08_DevelopmentBFreezeFrameStorageIndex, resulting-properties={base-type=uint16, sw-calibration-access=READ-ONLY, compu {65535=FREEZEFRAME_DATA_INVALID}, data-constr=uint16}, symbol=dev_b_ff_index  # Index of the development B freeze frame storage connected to this event. The value 0xFFFF indicates that there is no freeze frame stored.
            FreezeFrameIndexes: category=ARRAY, array-size=1, display-identifier=PrimaryEventMemoryEntry08_FreezeFrameIndexes, resulting-properties={base-type=uint16, sw-calibration-access=READ-ONLY, compu {65535=FREEZEFRAME_DATA_INVALID}, data-constr=uint16}, symbol=ff_index  # Array of indexes of the freeze frame storages connected to this event. Only valid if PrimaryEventMemoryEntry08_NumberOfStoredFreezeFrames is equal or higher than the index.
            RecordNumbers: category=ARRAY, array-size=1, display-identifier=PrimaryEventMemoryEntry08_RecordNumbers, resulting-properties={base-type=uint8, sw-calibration-access=READ-ONLY, data-constr=uint8}, symbol=record_numbers  # Array of record numbers of freeze frames (if stored).
            NumberOfStoredFreezeFrames: category=VALUE, display-identifier=PrimaryEventMemoryEntry08_NumberOfStoredFreezeFrames, resulting-properties={base-type=uint8, sw-calibration-access=READ-ONLY, data-constr=uint8}, symbol=num_stored_ff  # Number of standard freeze frames stored for this event.
            ExtendedDataStored: category=VALUE, display-identifier=PrimaryEventMemoryEntry08_ExtendedDataStored, resulting-properties={base-type=boolean, sw-calibration-access=READ-ONLY, compu {0=FALSE, 1=TRUE}, data-constr=boolean}, symbol=ed_stored  # Status variable that indicates if the event is connected to an external extended data storage area.
            UdsStatus: category=VALUE, display-identifier=PrimaryEventMemoryEntry08_UdsStatus, resulting-properties={base-type=uint8, sw-calibration-access=READ-ONLY, data-constr=uint8}, symbol=uds_status  # Copy of the status stored in {EventName}_UdsStatus.
            Si: category=VALUE, display-identifier=PrimaryEventMemoryEntry08_Si, resulting-properties={base-type=uint8, sw-calibration-access=READ-ONLY, data-constr=uint8}, symbol=si  # Copy of the status stored in {EventName}_FdcThresholdReached and {EventName}_FdcThresholdReachedTOC.
            OccurrenceCounter: category=VALUE, display-identifier=PrimaryEventMemoryEntry08_OccurrenceCounter, resulting-properties={base-type=uint8, sw-calibration-access=READ-ONLY, data-constr=uint8}, symbol=occurrence_counter  # Counter for number of event occurrences used for off board analysis.
            CyclesSinceLastFailed: category=VALUE, display-identifier=PrimaryEventMemoryEntry08_CyclesSinceLastFailed, resulting-properties={base-type=uint8, sw-calibration-access=READ-ONLY, data-constr=uint8}, symbol=cycles_since_last_failed  # Representing the number of operation cycles since the DTC fault detection counter last reached its maximum value of +127 (since DTC information was last cleared). All operation cycles, including those in which the test has not been completed shall be included.
            CyclesSinceFirstFailed: category=VALUE, display-identifier=PrimaryEventMemoryEntry08_CyclesSinceFirstFailed, resulting-properties={base-type=uint8, sw-calibration-access=READ-ONLY, data-constr=uint8}, symbol=cycles_since_first_failed  # Representing the number of operation cycles since the DTC fault detection counter first reached its maximum value of +127 (since DTC information was last cleared). All operation cycles, including those in which the test has not been completed shall be included.
            FailedCycles: category=VALUE, display-identifier=PrimaryEventMemoryEntry08_FailedCycles, resulting-properties={base-type=uint8, sw-calibration-access=READ-ONLY, data-constr=uint8}, symbol=failed_cycles  # Representing the number of operation cycles during which the DTC fault detection counter reached its maximum value of +127 (since DTC information was last cleared).
            AgingCounter: category=VALUE, display-identifier=PrimaryEventMemoryEntry08_AgingCounter, resulting-properties={base-type=uint8, sw-calibration-access=READ-ONLY, data-constr=uint8}, symbol=aging_counter  # Counter used for aging which is incremented at end of operation cycle. Additional conditions depends on the setting of configuration parameter DemAgingRequieresTestedCycle.
            WirBits: category=ARRAY, array-size=1, display-identifier=PrimaryEventMemoryEntry08_WirBits, resulting-properties={base-type=uint8, sw-calibration-access=READ-ONLY, data-constr=uint8}, symbol=wir_bits  # Bit-array of indicator specific WIR-bits.
            FailureCounter: category=ARRAY, array-size=1, display-identifier=PrimaryEventMemoryEntry08_FailureCounter, resulting-properties={base-type=uint8, sw-calibration-access=READ-ONLY, data-constr=uint8}, symbol=failure_counter  # The number of consecutive operation cycles (including the current operation cycle) during which the debouncing counter reached its maximum value (since DTC information was last cleared).
            HealingCounter: category=ARRAY, array-size=1, display-identifier=PrimaryEventMemoryEntry08_HealingCounter, resulting-properties={base-type=uint8, sw-calibration-access=READ-ONLY, data-constr=uint8}, symbol=healing_counter  # Counter used for healing which is incremented with one at end of operation cycle if UDS DTC status bit 2 (TestFailedThisOperationCycle) and bit 6 (TestNotCompletedThisOperationCycle) are not set.
        PrimaryEventMemoryEntry09: category=STRUCTURE, symbol=Dem_NvPrimaryEvMemEntry09
          18 x mc data instance:
            EventId: category=VALUE, display-identifier=PrimaryEventMemoryEntry09_EventId, resulting-properties={sw-calibration-access=READ-ONLY, compu-method=EVENT_ID_CM, range raw 1..4, implementation-data-type=Dem_EventIdType}, symbol=event_id  # The stored event identifier. 0 if unused.
            ExtendedDataStorageIndex: category=VALUE, display-identifier=PrimaryEventMemoryEntry09_ExtendedDataStorageIndex, resulting-properties={base-type=uint16, sw-calibration-access=READ-ONLY, compu {texttable}, data-constr=uint16}, symbol=ed_storage_index  # Index of the extended data storage connected to this event. Only valid if PrimaryEventMemoryEntry09_ExtendedDataStored is TRUE.
            DevelopmentAFreezeFrameStorageIndex: category=VALUE, display-identifier=PrimaryEventMemoryEntry09_DevelopmentAFreezeFrameStorageIndex, resulting-properties={base-type=uint16, sw-calibration-access=READ-ONLY, compu {65535=FREEZEFRAME_DATA_INVALID}, data-constr=uint16}, symbol=dev_a_ff_index  # Index of the development A freeze frame storage connected to this event. The value 0xFFFF indicates that there is no freeze frame stored.
            DevelopmentBFreezeFrameStorageIndex: category=VALUE, display-identifier=PrimaryEventMemoryEntry09_DevelopmentBFreezeFrameStorageIndex, resulting-properties={base-type=uint16, sw-calibration-access=READ-ONLY, compu {65535=FREEZEFRAME_DATA_INVALID}, data-constr=uint16}, symbol=dev_b_ff_index  # Index of the development B freeze frame storage connected to this event. The value 0xFFFF indicates that there is no freeze frame stored.
            FreezeFrameIndexes: category=ARRAY, array-size=1, display-identifier=PrimaryEventMemoryEntry09_FreezeFrameIndexes, resulting-properties={base-type=uint16, sw-calibration-access=READ-ONLY, compu {65535=FREEZEFRAME_DATA_INVALID}, data-constr=uint16}, symbol=ff_index  # Array of indexes of the freeze frame storages connected to this event. Only valid if PrimaryEventMemoryEntry09_NumberOfStoredFreezeFrames is equal or higher than the index.
            RecordNumbers: category=ARRAY, array-size=1, display-identifier=PrimaryEventMemoryEntry09_RecordNumbers, resulting-properties={base-type=uint8, sw-calibration-access=READ-ONLY, data-constr=uint8}, symbol=record_numbers  # Array of record numbers of freeze frames (if stored).
            NumberOfStoredFreezeFrames: category=VALUE, display-identifier=PrimaryEventMemoryEntry09_NumberOfStoredFreezeFrames, resulting-properties={base-type=uint8, sw-calibration-access=READ-ONLY, data-constr=uint8}, symbol=num_stored_ff  # Number of standard freeze frames stored for this event.
            ExtendedDataStored: category=VALUE, display-identifier=PrimaryEventMemoryEntry09_ExtendedDataStored, resulting-properties={base-type=boolean, sw-calibration-access=READ-ONLY, compu {0=FALSE, 1=TRUE}, data-constr=boolean}, symbol=ed_stored  # Status variable that indicates if the event is connected to an external extended data storage area.
            UdsStatus: category=VALUE, display-identifier=PrimaryEventMemoryEntry09_UdsStatus, resulting-properties={base-type=uint8, sw-calibration-access=READ-ONLY, data-constr=uint8}, symbol=uds_status  # Copy of the status stored in {EventName}_UdsStatus.
            Si: category=VALUE, display-identifier=PrimaryEventMemoryEntry09_Si, resulting-properties={base-type=uint8, sw-calibration-access=READ-ONLY, data-constr=uint8}, symbol=si  # Copy of the status stored in {EventName}_FdcThresholdReached and {EventName}_FdcThresholdReachedTOC.
            OccurrenceCounter: category=VALUE, display-identifier=PrimaryEventMemoryEntry09_OccurrenceCounter, resulting-properties={base-type=uint8, sw-calibration-access=READ-ONLY, data-constr=uint8}, symbol=occurrence_counter  # Counter for number of event occurrences used for off board analysis.
            CyclesSinceLastFailed: category=VALUE, display-identifier=PrimaryEventMemoryEntry09_CyclesSinceLastFailed, resulting-properties={base-type=uint8, sw-calibration-access=READ-ONLY, data-constr=uint8}, symbol=cycles_since_last_failed  # Representing the number of operation cycles since the DTC fault detection counter last reached its maximum value of +127 (since DTC information was last cleared). All operation cycles, including those in which the test has not been completed shall be included.
            CyclesSinceFirstFailed: category=VALUE, display-identifier=PrimaryEventMemoryEntry09_CyclesSinceFirstFailed, resulting-properties={base-type=uint8, sw-calibration-access=READ-ONLY, data-constr=uint8}, symbol=cycles_since_first_failed  # Representing the number of operation cycles since the DTC fault detection counter first reached its maximum value of +127 (since DTC information was last cleared). All operation cycles, including those in which the test has not been completed shall be included.
            FailedCycles: category=VALUE, display-identifier=PrimaryEventMemoryEntry09_FailedCycles, resulting-properties={base-type=uint8, sw-calibration-access=READ-ONLY, data-constr=uint8}, symbol=failed_cycles  # Representing the number of operation cycles during which the DTC fault detection counter reached its maximum value of +127 (since DTC information was last cleared).
            AgingCounter: category=VALUE, display-identifier=PrimaryEventMemoryEntry09_AgingCounter, resulting-properties={base-type=uint8, sw-calibration-access=READ-ONLY, data-constr=uint8}, symbol=aging_counter  # Counter used for aging which is incremented at end of operation cycle. Additional conditions depends on the setting of configuration parameter DemAgingRequieresTestedCycle.
            WirBits: category=ARRAY, array-size=1, display-identifier=PrimaryEventMemoryEntry09_WirBits, resulting-properties={base-type=uint8, sw-calibration-access=READ-ONLY, data-constr=uint8}, symbol=wir_bits  # Bit-array of indicator specific WIR-bits.
            FailureCounter: category=ARRAY, array-size=1, display-identifier=PrimaryEventMemoryEntry09_FailureCounter, resulting-properties={base-type=uint8, sw-calibration-access=READ-ONLY, data-constr=uint8}, symbol=failure_counter  # The number of consecutive operation cycles (including the current operation cycle) during which the debouncing counter reached its maximum value (since DTC information was last cleared).
            HealingCounter: category=ARRAY, array-size=1, display-identifier=PrimaryEventMemoryEntry09_HealingCounter, resulting-properties={base-type=uint8, sw-calibration-access=READ-ONLY, data-constr=uint8}, symbol=healing_counter  # Counter used for healing which is incremented with one at end of operation cycle if UDS DTC status bit 2 (TestFailedThisOperationCycle) and bit 6 (TestNotCompletedThisOperationCycle) are not set.
        PrimaryEventMemoryEntry10: category=STRUCTURE, symbol=Dem_NvPrimaryEvMemEntry10
          18 x mc data instance:
            EventId: category=VALUE, display-identifier=PrimaryEventMemoryEntry10_EventId, resulting-properties={sw-calibration-access=READ-ONLY, compu-method=EVENT_ID_CM, range raw 1..4, implementation-data-type=Dem_EventIdType}, symbol=event_id  # The stored event identifier. 0 if unused.
            ExtendedDataStorageIndex: category=VALUE, display-identifier=PrimaryEventMemoryEntry10_ExtendedDataStorageIndex, resulting-properties={base-type=uint16, sw-calibration-access=READ-ONLY, compu {texttable}, data-constr=uint16}, symbol=ed_storage_index  # Index of the extended data storage connected to this event. Only valid if PrimaryEventMemoryEntry10_ExtendedDataStored is TRUE.
            DevelopmentAFreezeFrameStorageIndex: category=VALUE, display-identifier=PrimaryEventMemoryEntry10_DevelopmentAFreezeFrameStorageIndex, resulting-properties={base-type=uint16, sw-calibration-access=READ-ONLY, compu {65535=FREEZEFRAME_DATA_INVALID}, data-constr=uint16}, symbol=dev_a_ff_index  # Index of the development A freeze frame storage connected to this event. The value 0xFFFF indicates that there is no freeze frame stored.
            DevelopmentBFreezeFrameStorageIndex: category=VALUE, display-identifier=PrimaryEventMemoryEntry10_DevelopmentBFreezeFrameStorageIndex, resulting-properties={base-type=uint16, sw-calibration-access=READ-ONLY, compu {65535=FREEZEFRAME_DATA_INVALID}, data-constr=uint16}, symbol=dev_b_ff_index  # Index of the development B freeze frame storage connected to this event. The value 0xFFFF indicates that there is no freeze frame stored.
            FreezeFrameIndexes: category=ARRAY, array-size=1, display-identifier=PrimaryEventMemoryEntry10_FreezeFrameIndexes, resulting-properties={base-type=uint16, sw-calibration-access=READ-ONLY, compu {65535=FREEZEFRAME_DATA_INVALID}, data-constr=uint16}, symbol=ff_index  # Array of indexes of the freeze frame storages connected to this event. Only valid if PrimaryEventMemoryEntry10_NumberOfStoredFreezeFrames is equal or higher than the index.
            RecordNumbers: category=ARRAY, array-size=1, display-identifier=PrimaryEventMemoryEntry10_RecordNumbers, resulting-properties={base-type=uint8, sw-calibration-access=READ-ONLY, data-constr=uint8}, symbol=record_numbers  # Array of record numbers of freeze frames (if stored).
            NumberOfStoredFreezeFrames: category=VALUE, display-identifier=PrimaryEventMemoryEntry10_NumberOfStoredFreezeFrames, resulting-properties={base-type=uint8, sw-calibration-access=READ-ONLY, data-constr=uint8}, symbol=num_stored_ff  # Number of standard freeze frames stored for this event.
            ExtendedDataStored: category=VALUE, display-identifier=PrimaryEventMemoryEntry10_ExtendedDataStored, resulting-properties={base-type=boolean, sw-calibration-access=READ-ONLY, compu {0=FALSE, 1=TRUE}, data-constr=boolean}, symbol=ed_stored  # Status variable that indicates if the event is connected to an external extended data storage area.
            UdsStatus: category=VALUE, display-identifier=PrimaryEventMemoryEntry10_UdsStatus, resulting-properties={base-type=uint8, sw-calibration-access=READ-ONLY, data-constr=uint8}, symbol=uds_status  # Copy of the status stored in {EventName}_UdsStatus.
            Si: category=VALUE, display-identifier=PrimaryEventMemoryEntry10_Si, resulting-properties={base-type=uint8, sw-calibration-access=READ-ONLY, data-constr=uint8}, symbol=si  # Copy of the status stored in {EventName}_FdcThresholdReached and {EventName}_FdcThresholdReachedTOC.
            OccurrenceCounter: category=VALUE, display-identifier=PrimaryEventMemoryEntry10_OccurrenceCounter, resulting-properties={base-type=uint8, sw-calibration-access=READ-ONLY, data-constr=uint8}, symbol=occurrence_counter  # Counter for number of event occurrences used for off board analysis.
            CyclesSinceLastFailed: category=VALUE, display-identifier=PrimaryEventMemoryEntry10_CyclesSinceLastFailed, resulting-properties={base-type=uint8, sw-calibration-access=READ-ONLY, data-constr=uint8}, symbol=cycles_since_last_failed  # Representing the number of operation cycles since the DTC fault detection counter last reached its maximum value of +127 (since DTC information was last cleared). All operation cycles, including those in which the test has not been completed shall be included.
            CyclesSinceFirstFailed: category=VALUE, display-identifier=PrimaryEventMemoryEntry10_CyclesSinceFirstFailed, resulting-properties={base-type=uint8, sw-calibration-access=READ-ONLY, data-constr=uint8}, symbol=cycles_since_first_failed  # Representing the number of operation cycles since the DTC fault detection counter first reached its maximum value of +127 (since DTC information was last cleared). All operation cycles, including those in which the test has not been completed shall be included.
            FailedCycles: category=VALUE, display-identifier=PrimaryEventMemoryEntry10_FailedCycles, resulting-properties={base-type=uint8, sw-calibration-access=READ-ONLY, data-constr=uint8}, symbol=failed_cycles  # Representing the number of operation cycles during which the DTC fault detection counter reached its maximum value of +127 (since DTC information was last cleared).
            AgingCounter: category=VALUE, display-identifier=PrimaryEventMemoryEntry10_AgingCounter, resulting-properties={base-type=uint8, sw-calibration-access=READ-ONLY, data-constr=uint8}, symbol=aging_counter  # Counter used for aging which is incremented at end of operation cycle. Additional conditions depends on the setting of configuration parameter DemAgingRequieresTestedCycle.
            WirBits: category=ARRAY, array-size=1, display-identifier=PrimaryEventMemoryEntry10_WirBits, resulting-properties={base-type=uint8, sw-calibration-access=READ-ONLY, data-constr=uint8}, symbol=wir_bits  # Bit-array of indicator specific WIR-bits.
            FailureCounter: category=ARRAY, array-size=1, display-identifier=PrimaryEventMemoryEntry10_FailureCounter, resulting-properties={base-type=uint8, sw-calibration-access=READ-ONLY, data-constr=uint8}, symbol=failure_counter  # The number of consecutive operation cycles (including the current operation cycle) during which the debouncing counter reached its maximum value (since DTC information was last cleared).
            HealingCounter: category=ARRAY, array-size=1, display-identifier=PrimaryEventMemoryEntry10_HealingCounter, resulting-properties={base-type=uint8, sw-calibration-access=READ-ONLY, data-constr=uint8}, symbol=healing_counter  # Counter used for healing which is incremented with one at end of operation cycle if UDS DTC status bit 2 (TestFailedThisOperationCycle) and bit 6 (TestNotCompletedThisOperationCycle) are not set.
        DtcStorage: category=ARRAY, array-size=1
          mc data instance DEM_DTC_GROUP_ALL_DTCS_StorageEnabled: category=VALUE, display-identifier=DEM_DTC_GROUP_ALL_DTCS_StorageEnabled, resulting-properties={base-type=boolean, sw-calibration-access=READ-ONLY, compu {0=FALSE, 1=TRUE}, data-constr=boolean}, symbol=[0]  # TRUE if the storage is enabled for the DTC group DEM_DTC_GROUP_ALL_DTCS, otherwise FALSE.
    resource consumption RC_Dem
      23 x memory section:
        CALIB_16: alignment=16, sw-addrmethod=CALIB
        CALIB_32: alignment=32, sw-addrmethod=CALIB
        CALIB_8: alignment=8, sw-addrmethod=CALIB
        CALIB_BOOLEAN: alignment=BOOLEAN, sw-addrmethod=CALIB
        CALIB_UNSPECIFIED: alignment=UNSPECIFIED, sw-addrmethod=CALIB
        CALIB_GENERAL_16: alignment=16, sw-addrmethod=CALIB
        CALIB_GENERAL_8: alignment=8, sw-addrmethod=CALIB
        CALIB_GENERAL_BOOLEAN: alignment=BOOLEAN, sw-addrmethod=CALIB
        CODE: alignment=UNSPECIFIED, sw-addrmethod=CODE
        CONST_16: alignment=16, sw-addrmethod=CONST
        CONST_32: alignment=32, sw-addrmethod=CONST
        CONST_UNSPECIFIED: alignment=UNSPECIFIED, sw-addrmethod=CONST
        POSTBUILD_CONST_16: alignment=16, sw-addrmethod=CONFIG_DATA
        POSTBUILD_CONST_32: alignment=32, sw-addrmethod=CONFIG_DATA
        POSTBUILD_CONST_8: alignment=8, sw-addrmethod=CONFIG_DATA
        POSTBUILD_CONST_UNSPECIFIED: alignment=UNSPECIFIED, sw-addrmethod=CONFIG_DATA
        VAR_NO_INIT_16: alignment=16, sw-addrmethod=VAR_NO_INIT
        VAR_NO_INIT_8: alignment=8, sw-addrmethod=VAR_NO_INIT
        VAR_NO_INIT_BOOLEAN: alignment=BOOLEAN, sw-addrmethod=VAR_NO_INIT
        VAR_NO_INIT_UNSPECIFIED: alignment=UNSPECIFIED, sw-addrmethod=VAR_NO_INIT
        VAR_SAVED_ZONE_COMMON_8: alignment=8, sw-addrmethod=VAR_NO_INIT
        VAR_SAVED_ZONE_COMMON_UNSPECIFIED: alignment=UNSPECIFIED, sw-addrmethod=VAR_NO_INIT
        VAR_SAVED_ZONE_DATA_UNSPECIFIED: alignment=UNSPECIFIED, sw-addrmethod=VAR_NO_INIT
package /AUTOSAR_Dem/BswModuleEntrys
  22 x bsw module entry, all with execution-context=TASK, sw-service-impl-policy=STANDARD:
    Dem_ClearDTC: service-id=35, is-reentrant=false, is-synchronous=false, call-type=REGULAR
    Dem_DcmClearDTC: service-id=34, is-reentrant=false, is-synchronous=false, call-type=REGULAR
    Dem_DcmReadDataOfPID21: service-id=100, is-reentrant=true, is-synchronous=true, call-type=REGULAR
    Dem_DcmReadDataOfPID31: service-id=102, is-reentrant=true, is-synchronous=true, call-type=REGULAR
    Dem_DcmReadDataOfPID4D: service-id=104, is-reentrant=true, is-synchronous=true, call-type=REGULAR
    Dem_DcmReadDataOfPID4E: service-id=105, is-reentrant=true, is-synchronous=true, call-type=REGULAR
    Dem_Init: service-id=2, is-reentrant=false, is-synchronous=true, call-type=REGULAR
    Dem_MainFunction: service-id=55, is-reentrant=false, is-synchronous=true, call-type=SCHEDULED
    Dem_ReportErrorStatus: service-id=15, is-reentrant=true, is-synchronous=false, call-type=REGULAR
    Dem_ResetEventStatus: service-id=5, is-reentrant=true, is-synchronous=true, call-type=REGULAR
    Dem_SetAgingCycleState: service-id=17, is-reentrant=true, is-synchronous=true, call-type=REGULAR
    Dem_SetEventStatus: service-id=4, is-reentrant=true, is-synchronous=false, call-type=REGULAR
    Dem_SetOperationCycleState: service-id=8, is-reentrant=true, is-synchronous=true, call-type=REGULAR
    Dem_PrestoreFreezeFrame: service-id=6, is-reentrant=true, is-synchronous=true, call-type=REGULAR
    Dem_GetFaultDetectionCounter: service-id=62, is-reentrant=false, is-synchronous=true, call-type=REGULAR
    Dem_DcmGetExtendedDataRecordByDTC: service-id=32, is-reentrant=false, is-synchronous=false, call-type=REGULAR
    Dem_DcmGetNextFilteredDTCAndFDC: service-id=59, is-reentrant=false, is-synchronous=false, call-type=REGULAR
    Dem_GetEventExtendedDataRecord: service-id=48, is-reentrant=true, is-synchronous=true, call-type=REGULAR
    Dem_DltGetAllExtendedDataRecords: service-id=64, is-reentrant=false, is-synchronous=true, call-type=REGULAR
    Dem_SetStorageCondition: service-id=56, is-reentrant=true, is-synchronous=true, call-type=REGULAR
    Dem_SetEventDisabled: service-id=81, is-reentrant=true, is-synchronous=true, call-type=REGULAR
    Dem_SetPermClearCondFulfilled: service-id=203, is-reentrant=true, is-synchronous=true, call-type=REGULAR
package /VSTAR_Dem/CompuMethods
  compu method EVENT_ID_CM: 0=EVENT_ID_INVALID, 1=DemEventParameter_EEP, 2=DemEventParameter_CanSM, 3=DemEventParameter_22938, 4=DemEventParameter_22940
  compu method PrimaryEventMemoryEntry_CM: 0..9=PrimaryEventMemoryEntry01..PrimaryEventMemoryEntry10, 255=EVENT_MEMORY_ENTRY_INVALID
  compu method SecondaryExtendedData_CM: texttable
  compu method SecondaryFreezeFrameData_CM: 65535=FREEZEFRAME_DATA_INVALID
  compu method ObdFreezeFrameData_CM: 65535=FREEZEFRAME_DATA_INVALID
package /VSTAR_Dem/DataConstrs
  range Dem_IndicatorStatusType_DC: raw 0..7
