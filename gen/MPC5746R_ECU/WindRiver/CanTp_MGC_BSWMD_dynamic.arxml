AUTOSAR XML (schema 4-2-2)
# Copyright 2016 Mentor Graphics Corporation
# All Rights Reserved
# THIS WORK CONTAINS TRADE SECRET
# AND PROPRIETARY INFORMATION WHICH IS THE
# PROPERTY OF MENTOR GRAPHICS
# CORPORATION OR ITS LICENSORS AND IS
# SUBJECT TO LICENSE TERMS.
package /VSTAR/BswMd
  bsw module description CanTp: module-id=35
    bsw internal behavior BswBehavior_CanTp
      exclusive area Area_0
      exclusive area Area_1
      bsw schedulable entity CanTp_MainFunction: can-enter-exclusive-area=[Area_0, Area_1], implemented-entry=CanTp_MainFunction
      10 x bsw called entity:
        CanTp_Init: can-enter-exclusive-area=[Area_0, Area_1], implemented-entry=CanTp_Init
        CanTp_GetVersionInfo: implemented-entry=CanTp_GetVersionInfo
        CanTp_Shutdown: can-enter-exclusive-area=[Area_0, Area_1], implemented-entry=CanTp_Shutdown
        CanTp_Transmit: can-enter-exclusive-area=[Area_0, Area_1], implemented-entry=CanTp_Transmit
        CanTp_CancelTransmit: can-enter-exclusive-area=[Area_0, Area_1], implemented-entry=CanTp_CancelTransmit
        CanTp_RxIndication: can-enter-exclusive-area=[Area_0, Area_1], implemented-entry=CanTp_RxIndication
        CanTp_TxConfirmation: can-enter-exclusive-area=[Area_0, Area_1], implemented-entry=CanTp_TxConfirmation
        CanTp_CancelReceive: can-enter-exclusive-area=[Area_0, Area_1], implemented-entry=CanTp_CancelReceive
        CanTp_ChangeParameter: can-enter-exclusive-area=[Area_0, Area_1], implemented-entry=CanTp_ChangeParameter
        CanTp_ReadParameter: can-enter-exclusive-area=[Area_0, Area_1], implemented-entry=CanTp_ReadParameter
      bsw timing event Evt_CanTp_MainFunction: starts-on-event=CanTp_MainFunction, period=0.01
package /AUTOSAR_CanTp/BswModuleEntrys
  11 x bsw module entry, all with sw-service-impl-policy=STANDARD:
    CanTp_Init: service-id=1, is-reentrant=false, is-synchronous=true, call-type=REGULAR, execution-context=TASK
    CanTp_GetVersionInfo: service-id=7, is-reentrant=true, is-synchronous=true, call-type=REGULAR, execution-context=TASK
    CanTp_Shutdown: service-id=2, is-reentrant=false, is-synchronous=true, call-type=REGULAR, execution-context=TASK
    CanTp_Transmit: service-id=3, is-reentrant=true, is-synchronous=false, call-type=REGULAR, execution-context=TASK
    CanTp_CancelTransmit: service-id=8, is-reentrant=false, is-synchronous=true, call-type=REGULAR, execution-context=TASK
    CanTp_MainFunction: service-id=6, is-reentrant=false, is-synchronous=true, call-type=SCHEDULED, execution-context=TASK
    CanTp_RxIndication: service-id=66, is-reentrant=true, is-synchronous=true, call-type=CALLBACK, execution-context=INTERRUPT-CAT-1
    CanTp_TxConfirmation: service-id=64, is-reentrant=true, is-synchronous=true, call-type=CALLBACK, execution-context=INTERRUPT-CAT-1
    CanTp_CancelReceive: service-id=9, is-reentrant=false, is-synchronous=true, call-type=REGULAR, execution-context=TASK
    CanTp_ChangeParameter: service-id=10, is-reentrant=false, is-synchronous=true, call-type=REGULAR, execution-context=TASK
    CanTp_ReadParameter: service-id=11, is-reentrant=false, is-synchronous=true, call-type=REGULAR, execution-context=TASK
