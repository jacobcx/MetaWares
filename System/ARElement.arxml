AUTOSAR XML (schema 4-2-2)
standard types defined: uint8, uint16, uint32
package /DataType/DataTypeSemantics
  compu method CVM10_V14: phys=raw*0.01-1.25 for raw 0..250; unit V
  compu method CNT_HCUValve_CMD: phys=raw for raw 0..1
  compu method CVM9_V23: phys=raw*0.01-1.25 for raw 0..250; unit V
  compu method CVM2_V03: phys=raw*0.01-1.25 for raw 0..250; unit V
  compu method CVM2_Var: phys=raw for raw 0..65535
  compu method T_DIOut: phys=raw*0.1-40 for raw 0..2500; unit ℃
  compu method CMP_FailureGrade: phys=raw for raw 0..3
  compu method CVM8_Var: phys=raw for raw 0..65535
  compu method CVM5_V01: phys=raw*0.01-1.25 for raw 0..250; unit V
  compu method T_CMPWout: phys=raw-40 for raw 0..250; unit ℃
  compu method CVM4_V20: phys=raw*0.01-1.25 for raw 0..250; unit V
  compu method CVM1_V22: phys=raw*0.01-1.25 for raw 0..250; unit V
  compu method CVM7_V06: phys=raw*0.01-1.25 for raw 0..250; unit V
  compu method CVM12_V06: phys=raw*0.01-1.25 for raw 0..250; unit V
  compu method CVM12_VMin: phys=raw*0.01-1.25 for raw 0..250; unit V
  compu method Q_HRBSet_Manual: phys=raw*0.001 for raw 0..64225; unit kgPerh
  compu method CVM5_Var: phys=raw for raw 0..65535
  compu method CVM3_V13: phys=raw*0.01-1.25 for raw 0..250; unit V
  compu method T_HRBAir: phys=raw-40 for raw 0..250; unit ℃
  compu method Time_HInPurge: phys=raw for raw 0..2000; unit s
  compu method CVM10_V04: phys=raw*0.01-1.25 for raw 0..250; unit V
  compu method CVM4_V08: phys=raw*0.01-1.25 for raw 0..250; unit V
  compu method CNT_DCFOutput_CMD: phys=raw for raw 0..1
  compu method CVM5_V18: phys=raw*0.01-1.25 for raw 0..250; unit V
  compu method CVM3_V10: phys=raw*0.01-1.25 for raw 0..250; unit V
  compu method CVM2_V17: phys=raw*0.01-1.25 for raw 0..250; unit V
  compu method CVM5_V15: phys=raw*0.01-1.25 for raw 0..250; unit V
  compu method FCU_DevCtl: phys=raw for raw 0..65535
  compu method CVM10_VMinCH: phys=raw for raw 1..24
  compu method CVM7_V03: phys=raw*0.01-1.25 for raw 0..250; unit V
  compu method CVM10_V24: phys=raw*0.01-1.25 for raw 0..250; unit V
  compu method CVM8_V13: phys=raw*0.01-1.25 for raw 0..250; unit V
  compu method CVM12_Var: phys=raw for raw 0..65535
  compu method T_HTank2: phys=raw-40 for raw 0..250; unit ℃
  compu method HRBStatus_MAFErr: phys=raw for raw 0..1
  compu method DCF_OutputOverCurrentWarning: phys=raw for raw 0..1
  compu method P_PCVSet: phys=raw for raw 0..500; unit kPa.a
  compu method CVM8_V16: phys=raw*0.01-1.25 for raw 0..250; unit V
  compu method CVM3_V24: phys=raw*0.01-1.25 for raw 0..250; unit V
  compu method CNT_HRB_CMD: phys=raw for raw 0..1
  compu method CVM2_V06: phys=raw*0.01-1.25 for raw 0..250; unit V
  compu method P_HOut: phys=raw for raw 0..500; unit kPa.a
  compu method SOV_HM_CMD: phys=raw for raw 0..1
  compu method C_HEZ: phys=raw*0.02 for raw 0..250; unit Percent
  compu method CVM11_V07: phys=raw*0.01-1.25 for raw 0..250; unit V
  compu method DCF_ErrorStatus: phys=raw for raw 0..1
  compu method CVM5_V04: phys=raw*0.01-1.25 for raw 0..250; unit V
  compu method CVM7_V17: phys=raw*0.01-1.25 for raw 0..250; unit V
  compu method CVM1_V07: phys=raw*0.01-1.25 for raw 0..250; unit V
  compu method CVM6_VMax: phys=raw*0.01-1.25 for raw 0..250; unit V
  compu method IIn_DCF: phys=raw*0.1-300 for raw 0..13000; unit A
  compu method C_HC2: phys=raw*0.02 for raw 0..250; unit Percent
  compu method CVM7_V09: phys=raw*0.01-1.25 for raw 0..250; unit V
  compu method CVM8_V02: phys=raw*0.01-1.25 for raw 0..250; unit V
  compu method T_DCF: phys=raw-40 for raw 0..190; unit ℃
  compu method CVM4_V05: phys=raw*0.01-1.25 for raw 0..250; unit V
  compu method CMP_DriveRotatorError: phys=raw for raw 0..1
  compu method DCF_OverTemperatureProtect: phys=raw for raw 0..1
  compu method CVM4_VMin: phys=raw*0.01-1.25 for raw 0..250; unit V
  compu method C_HPZ: phys=raw*0.02 for raw 0..250; unit Percent
  compu method FCU_Mode: phys=raw for raw 0..255
  compu method FC_OutputPower_Manual: phys=raw*0.5 for raw 0..200; unit kW
  compu method CVM1_V04: phys=raw*0.01-1.25 for raw 0..250; unit V
  compu method CVM4_V23: phys=raw*0.01-1.25 for raw 0..250; unit V
  compu method HRBStatus_OverCurrent: phys=raw for raw 0..1
  compu method CVM12_V02: phys=raw*0.01-1.25 for raw 0..250; unit V
  compu method CVM7_V21: phys=raw*0.01-1.25 for raw 0..250; unit V
  compu method CVM7_V24: phys=raw*0.01-1.25 for raw 0..250; unit V
  compu method IOut_DCF: phys=raw*0.1-300 for raw 0..13000; unit A
  compu method CVM11_V17: phys=raw*0.01-1.25 for raw 0..250; unit V
  compu method CVM4_V19: phys=raw*0.01-1.25 for raw 0..250; unit V
  compu method CVM1_V11: phys=raw*0.01-1.25 for raw 0..250; unit V
  compu method CVM12_V11: phys=raw*0.01-1.25 for raw 0..250; unit V
  compu method T_CMPInv: phys=raw-40 for raw 0..160; unit ℃
  compu method CVM7_V14: phys=raw*0.01-1.25 for raw 0..250; unit V
  compu method SOV_HInPurge_FB: phys=raw for raw 0..1
  compu method CVM10_V08: phys=raw*0.01-1.25 for raw 0..250; unit V
  compu method CVM5_V07: phys=raw*0.01-1.25 for raw 0..250; unit V
  compu method HCU_Mode_Manual: phys=raw for raw 0..255
  compu method CVM7_V10: phys=raw*0.01-1.25 for raw 0..250; unit V
  compu method CVM12_V12: phys=raw*0.01-1.25 for raw 0..250; unit V
  compu method CVM10_V09: phys=raw*0.01-1.25 for raw 0..250; unit V
  compu method CVM12_V01: phys=raw*0.01-1.25 for raw 0..250; unit V
  compu method CVM11_V22: phys=raw*0.01-1.25 for raw 0..250; unit V
  compu method CVM5_V22: phys=raw*0.01-1.25 for raw 0..250; unit V
  compu method CVM5_Total: phys=raw*0.01-60 for raw 0..12000; unit V
  compu method CVM12_Total: phys=raw*0.01-60 for raw 0..12000; unit V
  compu method CVM6_V17: phys=raw*0.01-1.25 for raw 0..250; unit V
  compu method CVM10_V10: phys=raw*0.01-1.25 for raw 0..250; unit V
  compu method CVM11_Var: phys=raw for raw 0..65535
  compu method FCU_ErrCode: phys=raw for raw 0..65535
  compu method CVM9_VMaxCH: phys=raw for raw 1..24
  compu method T_AIn: phys=raw-40 for raw 0..250; unit ℃
  compu method C_HC1: phys=raw*0.02 for raw 0..250; unit Percent
  compu method CVM11_V23: phys=raw*0.01-1.25 for raw 0..250; unit V
  compu method CVM5_V12: phys=raw*0.01-1.25 for raw 0..250; unit V
  compu method DCF_Reset_Manual: phys=raw for raw 0..1
  compu method Spd_CMPSet_Manual: phys=raw*50 for raw 0..300; unit rpm
  compu method FAN3_FB: phys=raw for raw 0..1
  compu method CVM6_V22: phys=raw*0.01-1.25 for raw 0..250; unit V
  compu method CVM11_V02: phys=raw*0.01-1.25 for raw 0..250; unit V
  compu method FAN1_FB: phys=raw for raw 0..1
  compu method CNT_FC_CMD: phys=raw for raw 0..1
  compu method CMP_Init: phys=raw for raw 0..1
  compu method CVM3_VMin: phys=raw*0.01-1.25 for raw 0..250; unit V
  compu method CVM4_Total: phys=raw*0.01-60 for raw 0..12000; unit V
  compu method CVM_Mode_Manual: phys=raw for raw 0..255
  compu method CVM6_V14: phys=raw*0.01-1.25 for raw 0..250; unit V
  compu method CVM5_V23: phys=raw*0.01-1.25 for raw 0..250; unit V
  compu method CVM6_V18: phys=raw*0.01-1.25 for raw 0..250; unit V
  compu method CVM1_VMax: phys=raw*0.01-1.25 for raw 0..250; unit V
  compu method CVM5_V20: phys=raw*0.01-1.25 for raw 0..250; unit V
  compu method CVM5_VMax: phys=raw*0.01-1.25 for raw 0..250; unit V
  compu method CVM12_V15: phys=raw*0.01-1.25 for raw 0..250; unit V
  compu method CVM6_V11: phys=raw*0.01-1.25 for raw 0..250; unit V
  compu method CMP_CommunicationTimeOut: phys=raw for raw 0..1
  compu method CVM11_V03: phys=raw*0.01-1.25 for raw 0..250; unit V
  compu method CVM6_V03: phys=raw*0.01-1.25 for raw 0..250; unit V
  compu method Pos_BPCV: phys=raw for raw 0..100; unit Percent
  compu method CVM6_V06: phys=raw*0.01-1.25 for raw 0..250; unit V
  compu method CVM6_V07: phys=raw*0.01-1.25 for raw 0..250; unit V
  compu method CVM12_V16: phys=raw*0.01-1.25 for raw 0..250; unit V
  compu method CVM6_V01: phys=raw*0.01-1.25 for raw 0..250; unit V
  compu method CVM6_V04: phys=raw*0.01-1.25 for raw 0..250; unit V
  compu method CVM5_V05: phys=raw*0.01-1.25 for raw 0..250; unit V
  compu method SOV_AHB_CMD: phys=raw for raw 0..1
  compu method FCU_DevFB: phys=raw for raw 0..65535
  compu method CNT_Baterry_FB: phys=raw for raw 0..1
  compu method CVM3_VMinCH: phys=raw for raw 1..24
  compu method CVM6_V21: phys=raw*0.01-1.25 for raw 0..250; unit V
  compu method HRBStatus_PlausibilityError: phys=raw for raw 0..1
  compu method Q_A: phys=raw for raw 0..10000; unit slpm
  compu method CNT_HCUValve_FB: phys=raw for raw 0..1
  compu method Time_HPurge: phys=raw for raw 0..300; unit s
  compu method CVM2_VMax: phys=raw*0.01-1.25 for raw 0..250; unit V
  compu method CVM2_V13: phys=raw*0.01-1.25 for raw 0..250; unit V
  compu method CVM4_V04: phys=raw*0.01-1.25 for raw 0..250; unit V
  compu method VIn2_DCF: phys=raw*0.1-300 for raw 0..13000; unit V
  compu method CVM10_V15: phys=raw*0.01-1.25 for raw 0..250; unit V
  compu method DCF_ISet_Manual: phys=raw*0.1 for raw 0..3000; unit A
  compu method DCF_OutputOverCurrentProtect: phys=raw for raw 0..1
  compu method CVM8_V03: phys=raw*0.01-1.25 for raw 0..250; unit V
  compu method CVM10_Total: phys=raw*0.01-60 for raw 0..12000; unit V
  compu method CVM12_VMinCH: phys=raw for raw 1..24
  compu method CVM8_VMaxCH: phys=raw for raw 1..24
  compu method T_HTank1: phys=raw-40 for raw 0..250; unit ℃
  compu method HCU_StateMachine: phys=raw for raw 0..15
  compu method CVM7_V02: phys=raw*0.01-1.25 for raw 0..250; unit V
  compu method Spd_HRB: phys=raw*40 for raw 0..255; unit UPermin
  compu method CVM8_V12: phys=raw*0.01-1.25 for raw 0..250; unit V
  compu method CVM5_V14: phys=raw*0.01-1.25 for raw 0..250; unit V
  compu method CVM12_V05: phys=raw*0.01-1.25 for raw 0..250; unit V
  compu method CVM3_V23: phys=raw*0.01-1.25 for raw 0..250; unit V
  compu method DCF_RunningStatus: phys=raw for raw 0..1
  compu method CVM7_V13: phys=raw*0.01-1.25 for raw 0..250; unit V
  compu method CVM4_V13: phys=raw*0.01-1.25 for raw 0..250; unit V
  compu method CVM2_V04: phys=raw*0.01-1.25 for raw 0..250; unit V
  compu method CVM4_V15: phys=raw*0.01-1.25 for raw 0..250; unit V
  compu method CVM2_VMinCH: phys=raw for raw 1..24
  compu method Spd_CMP: phys=raw for raw 0..15000; unit rpm
  compu method CVM12_V03: phys=raw*0.01-1.25 for raw 0..250; unit V
  compu method CVM11_V24: phys=raw*0.01-1.25 for raw 0..250; unit V
  compu method CVM7_V11: phys=raw*0.01-1.25 for raw 0..250; unit V
  compu method CVM12_V20: phys=raw*0.01-1.25 for raw 0..250; unit V
  compu method CVM6_VMin: phys=raw*0.01-1.25 for raw 0..250; unit V
  compu method CVM7_V19: phys=raw*0.01-1.25 for raw 0..250; unit V
  compu method CVM1_V09: phys=raw*0.01-1.25 for raw 0..250; unit V
  compu method CVM10_V23: phys=raw*0.01-1.25 for raw 0..250; unit V
  compu method CVM1_V21: phys=raw*0.01-1.25 for raw 0..250; unit V
  compu method FCU_ExtendedState: phys=raw for raw 0..15
  compu method TimeOn_HPurge: phys=raw*10 for raw 0..500; unit ms
  compu method CVM11_VMin: phys=raw*0.01-1.25 for raw 0..250; unit V
  compu method V_CMP: phys=raw*0.1 for raw 0..10000; unit V
  compu method P_HIn: phys=raw for raw 0..500; unit kPa.a
  compu method CVM9_Var: phys=raw for raw 0..65535
  compu method CVM1_V23: phys=raw*0.01-1.25 for raw 0..250; unit V
  compu method CVM11_Total: phys=raw*0.01-60 for raw 0..12000; unit V
  compu method HTank3_SOV_Manual: phys=raw for raw 0..1
  compu method CVM10_V21: phys=raw*0.01-1.25 for raw 0..250; unit V
  compu method CVM1_V01: phys=raw*0.01-1.25 for raw 0..250; unit V
  compu method HCU_ErrGrade: phys=raw for raw 0..15
  compu method CVM4_Var: phys=raw for raw 0..65535
  compu method CVM1_V03: phys=raw*0.01-1.25 for raw 0..250; unit V
  compu method CVM4_V24: phys=raw*0.01-1.25 for raw 0..250; unit V
  compu method HRBStatus_WrongVol: phys=raw for raw 0..1
  compu method CVM10_V13: phys=raw*0.01-1.25 for raw 0..250; unit V
  compu method CVM7_V22: phys=raw*0.01-1.25 for raw 0..250; unit V
  compu method T_DIIn: phys=raw*0.1-40 for raw 0..2500; unit ℃
  compu method CVM1_V18: phys=raw*0.01-1.25 for raw 0..250; unit V
  compu method CVM1_V12: phys=raw*0.01-1.25 for raw 0..250; unit V
  compu method CVM7_V20: phys=raw*0.01-1.25 for raw 0..250; unit V
  compu method P_AOut: phys=raw for raw 0..500; unit kPa.a
  compu method C_DI: phys=raw*0.1 for raw 0..250; unit usPercm
  compu method CVM8_V05: phys=raw*0.01-1.25 for raw 0..250; unit V
  compu method CVM7_VMax: phys=raw*0.01-1.25 for raw 0..250; unit V
  compu method CVM1_V14: phys=raw*0.01-1.25 for raw 0..250; unit V
  compu method CVM10_V19: phys=raw*0.01-1.25 for raw 0..250; unit V
  compu method CVM9_V19: phys=raw*0.01-1.25 for raw 0..250; unit V
  compu method CVM2_V11: phys=raw*0.01-1.25 for raw 0..250; unit V
  compu method DCF_InputOverVoltageProtect: phys=raw for raw 0..1
  compu method P_AMB: phys=raw for raw 0..500; unit kPa.a
  compu method CVM8_V09: phys=raw*0.01-1.25 for raw 0..250; unit V
  compu method DCF_MainCntStatus: phys=raw for raw 0..1
  compu method CVM11_V11: phys=raw*0.01-1.25 for raw 0..250; unit V
  compu method CVM4_V06: phys=raw*0.01-1.25 for raw 0..250; unit V
  compu method C_HAE: phys=raw*0.02 for raw 0..250; unit Percent
  compu method CVM8_V01: phys=raw*0.01-1.25 for raw 0..250; unit V
  compu method CVM8_V18: phys=raw*0.01-1.25 for raw 0..250; unit V
  compu method CVM2_V19: phys=raw*0.01-1.25 for raw 0..250; unit V
  compu method CVM4_V02: phys=raw*0.01-1.25 for raw 0..250; unit V
  compu method VOut_DCF: phys=raw*0.1-300 for raw 0..13000; unit V
  compu method CVM3_V12: phys=raw*0.01-1.25 for raw 0..250; unit V
  compu method CVM8_V21: phys=raw*0.01-1.25 for raw 0..250; unit V
  compu method CVM2_V15: phys=raw*0.01-1.25 for raw 0..250; unit V
  compu method CVM12_V09: phys=raw*0.01-1.25 for raw 0..250; unit V
  compu method CVM11_VMinCH: phys=raw for raw 1..24
  compu method CMP_DrivePowerSupplyError: phys=raw for raw 0..1
  compu method DCU_ErrCode: phys=raw for raw 0..65535
  compu method CVM3_V21: phys=raw*0.01-1.25 for raw 0..250; unit V
  compu method CVM2_V02: phys=raw*0.01-1.25 for raw 0..250; unit V
  compu method LV_DI: phys=raw for raw 0..1
  compu method CVM8_V10: phys=raw*0.01-1.25 for raw 0..250; unit V
  compu method CVM2_V08: phys=raw*0.01-1.25 for raw 0..250; unit V
  compu method CVM8_V14: phys=raw*0.01-1.25 for raw 0..250; unit V
  compu method CVM9_VMin: phys=raw*0.01-1.25 for raw 0..250; unit V
  compu method SOV_HInPurge_CMD: phys=raw for raw 0..1
  compu method CVM12_V22: phys=raw*0.01-1.25 for raw 0..250; unit V
  compu method CVM9_V24: phys=raw*0.01-1.25 for raw 0..250; unit V
  compu method CNT_Baterry_CMD: phys=raw for raw 0..1
  compu method CVM9_V22: phys=raw*0.01-1.25 for raw 0..250; unit V
  compu method FAN2_FB: phys=raw for raw 0..1
  compu method HRB_MFGEn_Manual: phys=raw for raw 0..1
  compu method CVM11_V13: phys=raw*0.01-1.25 for raw 0..250; unit V
  compu method CVM3_V18: phys=raw*0.01-1.25 for raw 0..250; unit V
  compu method CVM9_V20: phys=raw*0.01-1.25 for raw 0..250; unit V
  compu method CVM3_V14: phys=raw*0.01-1.25 for raw 0..250; unit V
  compu method Q_ASet: phys=raw for raw 0..10000; unit slpm
  compu method CVM8_V23: phys=raw*0.01-1.25 for raw 0..250; unit V
  compu method CVM3_V16: phys=raw*0.01-1.25 for raw 0..250; unit V
  compu method CVM10_V17: phys=raw*0.01-1.25 for raw 0..250; unit V
  compu method CVM3_V09: phys=raw*0.01-1.25 for raw 0..250; unit V
  compu method CVM2_V20: phys=raw*0.01-1.25 for raw 0..250; unit V
  compu method CVM9_V11: phys=raw*0.01-1.25 for raw 0..250; unit V
  compu method CMP_ExtendedState: phys=raw for raw 0..7
  compu method CVM9_V08: phys=raw*0.01-1.25 for raw 0..250; unit V
  compu method CVM12_V07: phys=raw*0.01-1.25 for raw 0..250; unit V
  compu method CVM9_V13: phys=raw*0.01-1.25 for raw 0..250; unit V
  compu method CVM9_V06: phys=raw*0.01-1.25 for raw 0..250; unit V
  compu method CVM3_V05: phys=raw*0.01-1.25 for raw 0..250; unit V
  compu method CVM12_V24: phys=raw*0.01-1.25 for raw 0..250; unit V
  compu method CVM3_V07: phys=raw*0.01-1.25 for raw 0..250; unit V
  compu method CVM2_V22: phys=raw*0.01-1.25 for raw 0..250; unit V
  compu method CVM9_V15: phys=raw*0.01-1.25 for raw 0..250; unit V
  compu method CVM9_Total: phys=raw*0.01-60 for raw 0..12000; unit V
  compu method CVM2_V24: phys=raw*0.01-1.25 for raw 0..250; unit V
  compu method CVM3_V03: phys=raw*0.01-1.25 for raw 0..250; unit V
  compu method CVM9_V02: phys=raw*0.01-1.25 for raw 0..250; unit V
  compu method CVM9_V04: phys=raw*0.01-1.25 for raw 0..250; unit V
  compu method CMP_DriveHallError: phys=raw for raw 0..1
  compu method CNT_FC_FB: phys=raw for raw 0..1
  compu method CVM3_V01: phys=raw*0.01-1.25 for raw 0..250; unit V
  compu method C_HC3: phys=raw*0.02 for raw 0..250; unit Percent
  compu method HMid_SOV_Manual: phys=raw for raw 0..1
  compu method CVM11_V15: phys=raw*0.01-1.25 for raw 0..250; unit V
  compu method CVM1_V16: phys=raw*0.01-1.25 for raw 0..250; unit V
  compu method CVM7_Total: phys=raw*0.01-60 for raw 0..12000; unit V
  compu method CVM4_V14: phys=raw*0.01-1.25 for raw 0..250; unit V
  compu method P_HMid: phys=raw*0.01 for raw 0..2000; unit bar
  compu method CVM7_V12: phys=raw*0.01-1.25 for raw 0..250; unit V
  compu method CVM11_VMax: phys=raw*0.01-1.25 for raw 0..250; unit V
  compu method CVM5_V09: phys=raw*0.01-1.25 for raw 0..250; unit V
  compu method CVM7_VMinCH: phys=raw for raw 1..24
  compu method DCU_ErrGrade: phys=raw for raw 0..15
  compu method CVM9_V17: phys=raw*0.01-1.25 for raw 0..250; unit V
  compu method CVM5_V24: phys=raw*0.01-1.25 for raw 0..250; unit V
  compu method CNT_CMPLowVoltage_FB: phys=raw for raw 0..1
  compu method CVM8_V07: phys=raw*0.01-1.25 for raw 0..250; unit V
  compu method CVM7_VMin: phys=raw*0.01-1.25 for raw 0..250; unit V
  compu method CVM11_V05: phys=raw*0.01-1.25 for raw 0..250; unit V
  compu method CVM6_V19: phys=raw*0.01-1.25 for raw 0..250; unit V
  compu method T_AOut: phys=raw-40 for raw 0..250; unit ℃
  compu method CVM12_V04: phys=raw*0.01-1.25 for raw 0..250; unit V
  compu method CVM4_VMaxCH: phys=raw for raw 1..24
  compu method CVM9_VMax: phys=raw*0.01-1.25 for raw 0..250; unit V
  compu method CVM12_V18: phys=raw*0.01-1.25 for raw 0..250; unit V
  compu method CVM8_V22: phys=raw*0.01-1.25 for raw 0..250; unit V
  compu method FCS_GenEnergy: phys=raw*0.1 for raw 0..5000000; unit kWh
  compu method CMP_DriveEEPROMError: phys=raw for raw 0..1
  compu method HRB_PumpEn_Manual: phys=raw for raw 0..1
  compu method CVM10_V02: phys=raw*0.01-1.25 for raw 0..250; unit V
  compu method HTank1_SOV_Manual: phys=raw for raw 0..1
  compu method CVM10_V16: phys=raw*0.01-1.25 for raw 0..250; unit V
  compu method CVM1_VMin: phys=raw*0.01-1.25 for raw 0..250; unit V
  compu method Q_HRB: phys=raw*0.002-60 for raw 0..64255; unit kgPerh
  compu method DCU_Mode_Manual: phys=raw for raw 0..255
  compu method CVM5_V10: phys=raw*0.01-1.25 for raw 0..250; unit V
  compu method CVM8_V04: phys=raw*0.01-1.25 for raw 0..250; unit V
  compu method CVM7_V15: phys=raw*0.01-1.25 for raw 0..250; unit V
  compu method CMP_MotorOverTemp: phys=raw for raw 0..1
  compu method CVM4_V11: phys=raw*0.01-1.25 for raw 0..250; unit V
  compu method FCU_BaseState: phys=raw for raw 0..15
  compu method CVM6_VMinCH: phys=raw for raw 1..24
  compu method CVM8_VMinCH: phys=raw for raw 1..24
  compu method CVM5_V06: phys=raw*0.01-1.25 for raw 0..250; unit V
  compu method CVM10_V12: phys=raw*0.01-1.25 for raw 0..250; unit V
  compu method CVM1_V05: phys=raw*0.01-1.25 for raw 0..250; unit V
  compu method DCF_PeriodCmd_Manual: phys=raw for raw 0..255
  compu method CVM10_V06: phys=raw*0.01-1.25 for raw 0..250; unit V
  compu method CVM4_V03: phys=raw*0.01-1.25 for raw 0..250; unit V
  compu method P_HTank: phys=raw*0.01 for raw 0..50000; unit bar
  compu method CMP_DriveOverTemp: phys=raw for raw 0..1
  compu method I_HRB: phys=raw*0.5 for raw 0..250; unit A
  compu method CVM1_V02: phys=raw*0.01-1.25 for raw 0..250; unit V
  compu method TimeOn_HInPurge: phys=raw for raw 0..2000; unit s
  compu method CVM2_Total: phys=raw*0.01-60 for raw 0..12000; unit V
  compu method CVM4_VMax: phys=raw*0.01-1.25 for raw 0..250; unit V
  compu method CVM11_V09: phys=raw*0.01-1.25 for raw 0..250; unit V
  compu method CVM7_V23: phys=raw*0.01-1.25 for raw 0..250; unit V
  compu method CVM1_V19: phys=raw*0.01-1.25 for raw 0..250; unit V
  compu method CVM10_V22: phys=raw*0.01-1.25 for raw 0..250; unit V
  compu method CVM4_V17: phys=raw*0.01-1.25 for raw 0..250; unit V
  compu method CVM1_V13: phys=raw*0.01-1.25 for raw 0..250; unit V
  compu method CVM1_V10: phys=raw*0.01-1.25 for raw 0..250; unit V
  compu method P_HM: phys=raw*0.01 for raw 0..2000; unit bar
  compu method CNT_DCF_Manual: phys=raw for raw 0..1
  compu method CVM6_V23: phys=raw*0.01-1.25 for raw 0..250; unit V
  compu method CVM11_V21: phys=raw*0.01-1.25 for raw 0..250; unit V
  compu method CVM2_VMin: phys=raw*0.01-1.25 for raw 0..250; unit V
  compu method CMP_EEPROM: phys=raw for raw 0..1
  compu method CNT_HRB_FB: phys=raw for raw 0..1
  compu method CVM5_V03: phys=raw*0.01-1.25 for raw 0..250; unit V
  compu method CVM7_V18: phys=raw*0.01-1.25 for raw 0..250; unit V
  compu method CNT_HCU_CMD: phys=raw for raw 0..1
  compu method CVM4_V22: phys=raw*0.01-1.25 for raw 0..250; unit V
  compu method HCU_ErrCode: phys=raw for raw 0..65535
  compu method CVM1_V08: phys=raw*0.01-1.25 for raw 0..250; unit V
  compu method CVM7_V08: phys=raw*0.01-1.25 for raw 0..250; unit V
  compu method HTank2_SOV_Manual: phys=raw for raw 0..1
  compu method P_DI: phys=raw for raw 0..500; unit kPa.a
  compu method CVM6_V13: phys=raw*0.01-1.25 for raw 0..250; unit V
  compu method CVM7_V01: phys=raw*0.01-1.25 for raw 0..250; unit V
  compu method DCF_MainPreCntStatus: phys=raw for raw 0..1
  compu method CVM5_VMaxCH: phys=raw for raw 1..24
  compu method DCU_StateMachine: phys=raw for raw 0..15
  compu method CVM7_V04: phys=raw*0.01-1.25 for raw 0..250; unit V
  compu method FCU_ErrGrade: phys=raw for raw 0..255
  compu method CVM5_V16: phys=raw*0.01-1.25 for raw 0..250; unit V
  compu method CNT_DCFOutputPreCharge_FB: phys=raw for raw 0..1
  compu method CVM8_VMin: phys=raw*0.01-1.25 for raw 0..250; unit V
  compu method CVM5_V17: phys=raw*0.01-1.25 for raw 0..250; unit V
  compu method CVM10_V07: phys=raw*0.01-1.25 for raw 0..250; unit V
  compu method CVM7_V05: phys=raw*0.01-1.25 for raw 0..250; unit V
  compu method CVM11_V19: phys=raw*0.01-1.25 for raw 0..250; unit V
  compu method CVM12_V13: phys=raw*0.01-1.25 for raw 0..250; unit V
  compu method SOV_HPurge_CMD: phys=raw for raw 0..1
  compu method CVM11_V01: phys=raw*0.01-1.25 for raw 0..250; unit V
  compu method CVM5_V13: phys=raw*0.01-1.25 for raw 0..250; unit V
  compu method I_CMP: phys=raw*0.2 for raw 0..250; unit A
  compu method T_FCSet_Manual: phys=raw-40 for raw 0..250; unit ℃
  compu method CVM10_V11: phys=raw*0.01-1.25 for raw 0..250; unit V
  compu method CVM6_V24: phys=raw*0.01-1.25 for raw 0..250; unit V
  compu method HRBStatus_PowerOn: phys=raw for raw 0..1
  compu method V_HRB: phys=raw*0.2 for raw 0..250; unit V
  compu method CVM12_VMaxCH: phys=raw for raw 1..24
  compu method CVM6_V20: phys=raw*0.01-1.25 for raw 0..250; unit V
  compu method P_DIOut: phys=raw for raw 0..500; unit kPa.a
  compu method CVM12_V14: phys=raw*0.01-1.25 for raw 0..250; unit V
  compu method CVM10_VMaxCH: phys=raw for raw 1..24
  compu method CVM6_V16: phys=raw*0.01-1.25 for raw 0..250; unit V
  compu method CVM6_Var: phys=raw for raw 0..65535
  compu method DCF_MainVersion: phys=raw for raw 0..15
  compu method FCU_StepCtl: phys=raw for raw 0..65535
  compu method CVM5_V21: phys=raw*0.01-1.25 for raw 0..250; unit V
  compu method CVM3_VMaxCH: phys=raw for raw 1..24
  compu method CVM1_VMaxCH: phys=raw for raw 1..24
  compu method VIn1_DCF: phys=raw*0.1-300 for raw 0..13000; unit V
  compu method CVM7_Var: phys=raw for raw 0..65535
  compu method CVM6_V09: phys=raw*0.01-1.25 for raw 0..250; unit V
  compu method CVM6_V08: phys=raw*0.01-1.25 for raw 0..250; unit V
  compu method CVM6_V12: phys=raw*0.01-1.25 for raw 0..250; unit V
  compu method P_AIn: phys=raw for raw 0..500; unit kPa.a
  compu method CVM6_V10: phys=raw*0.01-1.25 for raw 0..250; unit V
  compu method CVM11_V20: phys=raw*0.01-1.25 for raw 0..250; unit V
  compu method HRBStatus_TemperatureLimit: phys=raw for raw 0..1
  compu method CNT_DCFOutput_FB: phys=raw for raw 0..1
  compu method CVM6_V02: phys=raw*0.01-1.25 for raw 0..250; unit V
  compu method CVM6_V05: phys=raw*0.01-1.25 for raw 0..250; unit V
  compu method CNT_DCFOutputPreCharge_CMD: phys=raw for raw 0..1
  compu method CNT_HCU_FB: phys=raw for raw 0..1
  compu method CVM11_V04: phys=raw*0.01-1.25 for raw 0..250; unit V
  compu method CVM10_V03: phys=raw*0.01-1.25 for raw 0..250; unit V
  compu method CVM_ChSelect_Manual: phys=raw for raw 0..255
  compu method HRBStatus_MFGEn: phys=raw for raw 0..1
  compu method CMP_HVIL: phys=raw for raw 0..1
  compu method CVM7_V16: phys=raw*0.01-1.25 for raw 0..250; unit V
  compu method WP_Set_Manual: phys=raw for raw 0..100; unit Percent
  compu method FAN3_Set_Manual: phys=raw for raw 0..100; unit Percent
  compu method CVM3_V17: phys=raw*0.01-1.25 for raw 0..250; unit V
  compu method CMP_DriveOverVoltage: phys=raw for raw 0..1
  compu method CVM1_V06: phys=raw*0.01-1.25 for raw 0..250; unit V
  compu method CVM6_V15: phys=raw*0.01-1.25 for raw 0..250; unit V
  compu method CVM12_V17: phys=raw*0.01-1.25 for raw 0..250; unit V
  compu method CVM11_V16: phys=raw*0.01-1.25 for raw 0..250; unit V
  compu method CVM4_V01: phys=raw*0.01-1.25 for raw 0..250; unit V
  compu method T_HRBElec: phys=raw-40 for raw 0..250; unit ℃
  compu method CVM11_V14: phys=raw*0.01-1.25 for raw 0..250; unit V
  compu method CVM3_Total: phys=raw*0.01-60 for raw 0..12000; unit V
  compu method CVM7_VMaxCH: phys=raw for raw 1..24
  compu method CVM2_V16: phys=raw*0.01-1.25 for raw 0..250; unit V
  compu method CVM_Triggered_Manual: phys=raw for raw 0..1
  compu method CMP_DriveLowVoltage: phys=raw for raw 0..1
  compu method CNT_CMPLowVoltage_CMD: phys=raw for raw 0..1
  compu method Spd_HRBSet_Manual: phys=raw for raw 0..64255; unit UPermin
  compu method CVM5_V19: phys=raw*0.01-1.25 for raw 0..250; unit V
  compu method CVM8_VMax: phys=raw*0.01-1.25 for raw 0..250; unit V
  compu method CVM5_V11: phys=raw*0.01-1.25 for raw 0..250; unit V
  compu method CVM11_V06: phys=raw*0.01-1.25 for raw 0..250; unit V
  compu method CVM10_VMax: phys=raw*0.01-1.25 for raw 0..250; unit V
  compu method CVM2_V07: phys=raw*0.01-1.25 for raw 0..250; unit V
  compu method CVM8_V17: phys=raw*0.01-1.25 for raw 0..250; unit V
  compu method CVM3_V20: phys=raw*0.01-1.25 for raw 0..250; unit V
  compu method CVM11_V18: phys=raw*0.01-1.25 for raw 0..250; unit V
  compu method CVM1_V15: phys=raw*0.01-1.25 for raw 0..250; unit V
  compu method CVM8_V06: phys=raw*0.01-1.25 for raw 0..250; unit V
  compu method T_DCFWout: phys=raw-40 for raw 0..250; unit ℃
  compu method CVM1_V17: phys=raw*0.01-1.25 for raw 0..250; unit V
  compu method CVM5_V02: phys=raw*0.01-1.25 for raw 0..250; unit V
  compu method CVM4_VMinCH: phys=raw for raw 1..24
  compu method CVM5_V08: phys=raw*0.01-1.25 for raw 0..250; unit V
  compu method CVM12_V19: phys=raw*0.01-1.25 for raw 0..250; unit V
  compu method TDiff_FCSet_Manual: phys=raw*0.1 for raw 0..250; unit ℃
  compu method CVM4_V21: phys=raw*0.01-1.25 for raw 0..250; unit V
  compu method CVM12_VMax: phys=raw*0.01-1.25 for raw 0..250; unit V
  compu method CVM10_Var: phys=raw for raw 0..65535
  compu method CVM7_V07: phys=raw*0.01-1.25 for raw 0..250; unit V
  compu method DCF_OutputOverVoltageProtect: phys=raw for raw 0..1
  compu method P_AInSet: phys=raw for raw 0..500; unit kPa.a
  compu method CVM8_V08: phys=raw*0.01-1.25 for raw 0..250; unit V
  compu method CVM6_Total: phys=raw*0.01-60 for raw 0..12000; unit V
  compu method CVM4_V09: phys=raw*0.01-1.25 for raw 0..250; unit V
  compu method T_HTank3: phys=raw-40 for raw 0..250; unit ℃
  compu method CVM4_V07: phys=raw*0.01-1.25 for raw 0..250; unit V
  compu method CVM12_V10: phys=raw*0.01-1.25 for raw 0..250; unit V
  compu method CVM11_V08: phys=raw*0.01-1.25 for raw 0..250; unit V
  compu method CVM4_V10: phys=raw*0.01-1.25 for raw 0..250; unit V
  compu method CVM4_V18: phys=raw*0.01-1.25 for raw 0..250; unit V
  compu method CVM10_V05: phys=raw*0.01-1.25 for raw 0..250; unit V
  compu method CMP_DriveOverCurrent: phys=raw for raw 0..1
  compu method CVM2_V05: phys=raw*0.01-1.25 for raw 0..250; unit V
  compu method CVM11_V10: phys=raw*0.01-1.25 for raw 0..250; unit V
  compu method CVM4_V16: phys=raw*0.01-1.25 for raw 0..250; unit V
  compu method CVM1_VMinCH: phys=raw for raw 1..24
  compu method CVM10_V20: phys=raw*0.01-1.25 for raw 0..250; unit V
  compu method CVM9_V21: phys=raw*0.01-1.25 for raw 0..250; unit V
  compu method CVM4_V12: phys=raw*0.01-1.25 for raw 0..250; unit V
  compu method SOV_HPurge_FB: phys=raw for raw 0..1
  compu method CVM5_VMinCH: phys=raw for raw 1..24
  compu method CVM3_V19: phys=raw*0.01-1.25 for raw 0..250; unit V
  compu method DCF_MinorVersion: phys=raw for raw 0..15
  compu method CVM9_VMinCH: phys=raw for raw 1..24
  compu method CVM8_V24: phys=raw*0.01-1.25 for raw 0..250; unit V
  compu method CVM12_V23: phys=raw*0.01-1.25 for raw 0..250; unit V
  compu method SOC_H: phys=raw*0.1 for raw 0..1200; unit Percent
  compu method CVM3_V15: phys=raw*0.01-1.25 for raw 0..250; unit V
  compu method CVM1_V20: phys=raw*0.01-1.25 for raw 0..250; unit V
  compu method DCF_OtherHardwareFailure: phys=raw for raw 0..1
  compu method CVM2_VMaxCH: phys=raw for raw 1..24
  compu method CVM1_V24: phys=raw*0.01-1.25 for raw 0..250; unit V
  compu method CVM8_V20: phys=raw*0.01-1.25 for raw 0..250; unit V
  compu method CVM6_VMaxCH: phys=raw for raw 1..24
  compu method CVM2_V18: phys=raw*0.01-1.25 for raw 0..250; unit V
  compu method CVM8_V19: phys=raw*0.01-1.25 for raw 0..250; unit V
  compu method CVM10_VMin: phys=raw*0.01-1.25 for raw 0..250; unit V
  compu method SOV_HM_FB: phys=raw for raw 0..1
  compu method CVM3_V11: phys=raw*0.01-1.25 for raw 0..250; unit V
  compu method CVM12_V21: phys=raw*0.01-1.25 for raw 0..250; unit V
  compu method T_HIn: phys=raw-40 for raw 0..250; unit ℃
  compu method CMP_Ready: phys=raw for raw 0..1
  compu method T_HEXWout: phys=raw-40 for raw 0..250; unit ℃
  compu method FAN1_Set_Manual: phys=raw for raw 0..100; unit Percent
  compu method CVM1_Total: phys=raw*0.01-60 for raw 0..12000; unit V
  compu method CVM8_V11: phys=raw*0.01-1.25 for raw 0..250; unit V
  compu method CVM2_V01: phys=raw*0.01-1.25 for raw 0..250; unit V
  compu method CVM3_Var: phys=raw for raw 0..65535
  compu method CVM8_V15: phys=raw*0.01-1.25 for raw 0..250; unit V
  compu method T_CMPMot: phys=raw-40 for raw 0..190; unit ℃
  compu method CVM3_V22: phys=raw*0.01-1.25 for raw 0..250; unit V
  compu method CVM2_V09: phys=raw*0.01-1.25 for raw 0..250; unit V
  compu method DCF_En_Manual: phys=raw for raw 0..255
  compu method CVM3_VMax: phys=raw*0.01-1.25 for raw 0..250; unit V
  compu method FAN4_FB: phys=raw for raw 0..1
  compu method CMP_En_Manual: phys=raw for raw 0..2
  compu method TV_DI_Manual: phys=raw for raw 0..1
  compu method CMP_BaseState: phys=raw for raw 0..7
  compu method CVM2_V10: phys=raw*0.01-1.25 for raw 0..250; unit V
  compu method CVM9_V18: phys=raw*0.01-1.25 for raw 0..250; unit V
  compu method CVM11_VMaxCH: phys=raw for raw 1..24
  compu method CVM9_V01: phys=raw*0.01-1.25 for raw 0..250; unit V
  compu method CVM12_V08: phys=raw*0.01-1.25 for raw 0..250; unit V
  compu method CVM9_V16: phys=raw*0.01-1.25 for raw 0..250; unit V
  compu method CVM8_Total: phys=raw*0.01-60 for raw 0..12000; unit V
  compu method CVM2_V12: phys=raw*0.01-1.25 for raw 0..250; unit V
  compu method CVM2_V14: phys=raw*0.01-1.25 for raw 0..250; unit V
  compu method CVM10_V01: phys=raw*0.01-1.25 for raw 0..250; unit V
  compu method T_AMB_Manual: phys=raw-40 for raw 0..250; unit ℃
  compu method DCF_PeriodResp: phys=raw for raw 0..255
  compu method SOV_AHB_FB: phys=raw for raw 0..1
  compu method T_AMB: phys=raw-40 for raw 0..250; unit ℃
  compu method FAN2_Set_Manual: phys=raw for raw 0..100; unit Percent
  compu method CVM9_V09: phys=raw*0.01-1.25 for raw 0..250; unit V
  compu method CVM10_V18: phys=raw*0.01-1.25 for raw 0..250; unit V
  compu method CVM9_V10: phys=raw*0.01-1.25 for raw 0..250; unit V
  compu method CVM9_V07: phys=raw*0.01-1.25 for raw 0..250; unit V
  compu method CVM1_Var: phys=raw for raw 0..65535
  compu method CVM3_V06: phys=raw*0.01-1.25 for raw 0..250; unit V
  compu method CVM2_V23: phys=raw*0.01-1.25 for raw 0..250; unit V
  compu method CVM9_V05: phys=raw*0.01-1.25 for raw 0..250; unit V
  compu method DCF_InputLowVoltageProtect: phys=raw for raw 0..1
  compu method CVM9_V12: phys=raw*0.01-1.25 for raw 0..250; unit V
  compu method CVM2_V21: phys=raw*0.01-1.25 for raw 0..250; unit V
  compu method CVM9_V14: phys=raw*0.01-1.25 for raw 0..250; unit V
  compu method CVM3_V08: phys=raw*0.01-1.25 for raw 0..250; unit V
  compu method CVM9_V03: phys=raw*0.01-1.25 for raw 0..250; unit V
  compu method CVM3_V04: phys=raw*0.01-1.25 for raw 0..250; unit V
  compu method Pos_BPCVSet: phys=raw for raw 0..100; unit Percent
  compu method CVM3_V02: phys=raw*0.01-1.25 for raw 0..250; unit V
  compu method CVM11_V12: phys=raw*0.01-1.25 for raw 0..250; unit V
  compu method CVM5_VMin: phys=raw*0.01-1.25 for raw 0..250; unit V
  compu method FAN4_Set_Manual: phys=raw for raw 0..100; unit Percent
  compu method HRBStatus_PumpEn: phys=raw for raw 0..1
package /DataType/DataTypeUnits
  unit V: physical-dimension=VPD
  physical dimension VPD
  unit ℃: physical-dimension=℃PD
  physical dimension ℃PD
  unit kgPerh: physical-dimension=kgPerhPD
  physical dimension kgPerhPD
  unit s: physical-dimension=sPD
  physical dimension sPD
  unit kPa.a: physical-dimension=kPa.aPD
  physical dimension kPa.aPD
  unit Percent: physical-dimension=PercentPD
  physical dimension PercentPD
  unit A: physical-dimension=APD
  physical dimension APD
  unit kW: physical-dimension=kWPD
  physical dimension kWPD
  unit rpm: physical-dimension=rpmPD
  physical dimension rpmPD
  unit slpm: physical-dimension=slpmPD
  physical dimension slpmPD
  unit UPermin: physical-dimension=UPerminPD
  physical dimension UPerminPD
  unit ms: physical-dimension=msPD
  physical dimension msPD
  unit usPercm: physical-dimension=usPercmPD
  physical dimension usPercmPD
  unit bar: physical-dimension=barPD
  physical dimension barPD
  unit kWh: physical-dimension=kWhPD
  physical dimension kWhPD
package /Signal
  530 x system signal:
    syssigCVM10_V14
    syssigCNT_HCUValve_CMD
    syssigCVM9_V23
    syssigCVM2_V03
    syssigCVM2_Var
    syssigT_DIOut
    syssigCMP_FailureGrade
    syssigCVM8_Var
    syssigCVM5_V01
    syssigT_CMPWout
    syssigCVM4_V20
    syssigCVM1_V22
    syssigCVM7_V06
    syssigCVM12_V06
    syssigCVM12_VMin
    syssigQ_HRBSet_Manual
    syssigCVM5_Var
    syssigCVM3_V13
    syssigT_HRBAir
    syssigTime_HInPurge
    syssigCVM10_V04
    syssigCVM4_V08
    syssigCNT_DCFOutput_CMD
    syssigCVM5_V18
    syssigCVM3_V10
    syssigCVM2_V17
    syssigCVM5_V15
    syssigFCU_DevCtl
    syssigCVM10_VMinCH
    syssigCVM7_V03
    syssigCVM10_V24
    syssigCVM8_V13
    syssigCVM12_Var
    syssigT_HTank2
    syssigHRBStatus_MAFErr
    syssigDCF_OutputOverCurrentWarning
    syssigP_PCVSet
    syssigCVM8_V16
    syssigCVM3_V24
    syssigCNT_HRB_CMD
    syssigCVM2_V06
    syssigP_HOut
    syssigSOV_HM_CMD
    syssigC_HEZ
    syssigCVM11_V07
    syssigDCF_ErrorStatus
    syssigCVM5_V04
    syssigCVM7_V17
    syssigCVM1_V07
    syssigCVM6_VMax
    syssigIIn_DCF
    syssigC_HC2
    syssigCVM7_V09
    syssigCVM8_V02
    syssigT_DCF
    syssigCVM4_V05
    syssigCMP_DriveRotatorError
    syssigDCF_OverTemperatureProtect
    syssigCVM4_VMin
    syssigC_HPZ
    syssigFCU_Mode
    syssigFC_OutputPower_Manual
    syssigCVM1_V04
    syssigCVM4_V23
    syssigHRBStatus_OverCurrent
    syssigCVM12_V02
    syssigCVM7_V21
    syssigCVM7_V24
    syssigIOut_DCF
    syssigCVM11_V17
    syssigCVM4_V19
    syssigCVM1_V11
    syssigCVM12_V11
    syssigT_CMPInv
    syssigCVM7_V14
    syssigSOV_HInPurge_FB
    syssigCVM10_V08
    syssigCVM5_V07
    syssigHCU_Mode_Manual
    syssigCVM7_V10
    syssigCVM12_V12
    syssigCVM10_V09
    syssigCVM12_V01
    syssigCVM11_V22
    syssigCVM5_V22
    syssigCVM5_Total
    syssigCVM12_Total
    syssigCVM6_V17
    syssigCVM10_V10
    syssigCVM11_Var
    syssigFCU_ErrCode
    syssigCVM9_VMaxCH
    syssigT_AIn
    syssigC_HC1
    syssigCVM11_V23
    syssigCVM5_V12
    syssigDCF_Reset_Manual
    syssigSpd_CMPSet_Manual
    syssigFAN3_FB
    syssigCVM6_V22
    syssigCVM11_V02
    syssigFAN1_FB
    syssigCNT_FC_CMD
    syssigCMP_Init
    syssigCVM3_VMin
    syssigCVM4_Total
    syssigCVM_Mode_Manual
    syssigCVM6_V14
    syssigCVM5_V23
    syssigCVM6_V18
    syssigCVM1_VMax
    syssigCVM5_V20
    syssigCVM5_VMax
    syssigCVM12_V15
    syssigCVM6_V11
    syssigCMP_CommunicationTimeOut
    syssigCVM11_V03
    syssigCVM6_V03
    syssigPos_BPCV
    syssigCVM6_V06
    syssigCVM6_V07
    syssigCVM12_V16
    syssigCVM6_V01
    syssigCVM6_V04
    syssigCVM5_V05
    syssigSOV_AHB_CMD
    syssigFCU_DevFB
    syssigCNT_Baterry_FB
    syssigCVM3_VMinCH
    syssigCVM6_V21
    syssigHRBStatus_PlausibilityError
    syssigQ_A
    syssigCNT_HCUValve_FB
    syssigTime_HPurge
    syssigCVM2_VMax
    syssigCVM2_V13
    syssigCVM4_V04
    syssigVIn2_DCF
    syssigCVM10_V15
    syssigDCF_ISet_Manual
    syssigDCF_OutputOverCurrentProtect
    syssigCVM8_V03
    syssigCVM10_Total
    syssigCVM12_VMinCH
    syssigCVM8_VMaxCH
    syssigT_HTank1
    syssigHCU_StateMachine
    syssigCVM7_V02
    syssigSpd_HRB
    syssigCVM8_V12
    syssigCVM5_V14
    syssigCVM12_V05
    syssigCVM3_V23
    syssigDCF_RunningStatus
    syssigCVM7_V13
    syssigCVM4_V13
    syssigCVM2_V04
    syssigCVM4_V15
    syssigCVM2_VMinCH
    syssigSpd_CMP
    syssigCVM12_V03
    syssigCVM11_V24
    syssigCVM7_V11
    syssigCVM12_V20
    syssigCVM6_VMin
    syssigCVM7_V19
    syssigCVM1_V09
    syssigCVM10_V23
    syssigCVM1_V21
    syssigFCU_ExtendedState
    syssigTimeOn_HPurge
    syssigCVM11_VMin
    syssigV_CMP
    syssigP_HIn
    syssigCVM9_Var
    syssigCVM1_V23
    syssigCVM11_Total
    syssigHTank3_SOV_Manual
    syssigCVM10_V21
    syssigCVM1_V01
    syssigHCU_ErrGrade
    syssigCVM4_Var
    syssigCVM1_V03
    syssigCVM4_V24
    syssigHRBStatus_WrongVol
    syssigCVM10_V13
    syssigCVM7_V22
    syssigT_DIIn
    syssigCVM1_V18
    syssigCVM1_V12
    syssigCVM7_V20
    syssigP_AOut
    syssigC_DI
    syssigCVM8_V05
    syssigCVM7_VMax
    syssigCVM1_V14
    syssigCVM10_V19
    syssigCVM9_V19
    syssigCVM2_V11
    syssigDCF_InputOverVoltageProtect
    syssigP_AMB
    syssigCVM8_V09
    syssigDCF_MainCntStatus
    syssigCVM11_V11
    syssigCVM4_V06
    syssigC_HAE
    syssigCVM8_V01
    syssigCVM8_V18
    syssigCVM2_V19
    syssigCVM4_V02
    syssigVOut_DCF
    syssigCVM3_V12
    syssigCVM8_V21
    syssigCVM2_V15
    syssigCVM12_V09
    syssigCVM11_VMinCH
    syssigCMP_DrivePowerSupplyError
    syssigDCU_ErrCode
    syssigCVM3_V21
    syssigCVM2_V02
    syssigLV_DI
    syssigCVM8_V10
    syssigCVM2_V08
    syssigCVM8_V14
    syssigCVM9_VMin
    syssigSOV_HInPurge_CMD
    syssigCVM12_V22
    syssigCVM9_V24
    syssigCNT_Baterry_CMD
    syssigCVM9_V22
    syssigFAN2_FB
    syssigHRB_MFGEn_Manual
    syssigCVM11_V13
    syssigCVM3_V18
    syssigCVM9_V20
    syssigCVM3_V14
    syssigQ_ASet
    syssigCVM8_V23
    syssigCVM3_V16
    syssigCVM10_V17
    syssigCVM3_V09
    syssigCVM2_V20
    syssigCVM9_V11
    syssigCMP_ExtendedState
    syssigCVM9_V08
    syssigCVM12_V07
    syssigCVM9_V13
    syssigCVM9_V06
    syssigCVM3_V05
    syssigCVM12_V24
    syssigCVM3_V07
    syssigCVM2_V22
    syssigCVM9_V15
    syssigCVM9_Total
    syssigCVM2_V24
    syssigCVM3_V03
    syssigCVM9_V02
    syssigCVM9_V04
    syssigCMP_DriveHallError
    syssigCNT_FC_FB
    syssigCVM3_V01
    syssigC_HC3
    syssigHMid_SOV_Manual
    syssigCVM11_V15
    syssigCVM1_V16
    syssigCVM7_Total
    syssigCVM4_V14
    syssigP_HMid
    syssigCVM7_V12
    syssigCVM11_VMax
    syssigCVM5_V09
    syssigCVM7_VMinCH
    syssigDCU_ErrGrade
    syssigCVM9_V17
    syssigCVM5_V24
    syssigCNT_CMPLowVoltage_FB
    syssigCVM8_V07
    syssigCVM7_VMin
    syssigCVM11_V05
    syssigCVM6_V19
    syssigT_AOut
    syssigCVM12_V04
    syssigCVM4_VMaxCH
    syssigCVM9_VMax
    syssigCVM12_V18
    syssigCVM8_V22
    syssigFCS_GenEnergy
    syssigCMP_DriveEEPROMError
    syssigHRB_PumpEn_Manual
    syssigCVM10_V02
    syssigHTank1_SOV_Manual
    syssigCVM10_V16
    syssigCVM1_VMin
    syssigQ_HRB
    syssigDCU_Mode_Manual
    syssigCVM5_V10
    syssigCVM8_V04
    syssigCVM7_V15
    syssigCMP_MotorOverTemp
    syssigCVM4_V11
    syssigFCU_BaseState
    syssigCVM6_VMinCH
    syssigCVM8_VMinCH
    syssigCVM5_V06
    syssigCVM10_V12
    syssigCVM1_V05
    syssigDCF_PeriodCmd_Manual
    syssigCVM10_V06
    syssigCVM4_V03
    syssigP_HTank
    syssigCMP_DriveOverTemp
    syssigI_HRB
    syssigCVM1_V02
    syssigTimeOn_HInPurge
    syssigCVM2_Total
    syssigCVM4_VMax
    syssigCVM11_V09
    syssigCVM7_V23
    syssigCVM1_V19
    syssigCVM10_V22
    syssigCVM4_V17
    syssigCVM1_V13
    syssigCVM1_V10
    syssigP_HM
    syssigCNT_DCF_Manual
    syssigCVM6_V23
    syssigCVM11_V21
    syssigCVM2_VMin
    syssigCMP_EEPROM
    syssigCNT_HRB_FB
    syssigCVM5_V03
    syssigCVM7_V18
    syssigCNT_HCU_CMD
    syssigCVM4_V22
    syssigHCU_ErrCode
    syssigCVM1_V08
    syssigCVM7_V08
    syssigHTank2_SOV_Manual
    syssigP_DI
    syssigCVM6_V13
    syssigCVM7_V01
    syssigDCF_MainPreCntStatus
    syssigCVM5_VMaxCH
    syssigDCU_StateMachine
    syssigCVM7_V04
    syssigFCU_ErrGrade
    syssigCVM5_V16
    syssigCNT_DCFOutputPreCharge_FB
    syssigCVM8_VMin
    syssigCVM5_V17
    syssigCVM10_V07
    syssigCVM7_V05
    syssigCVM11_V19
    syssigCVM12_V13
    syssigSOV_HPurge_CMD
    syssigCVM11_V01
    syssigCVM5_V13
    syssigI_CMP
    syssigT_FCSet_Manual
    syssigCVM10_V11
    syssigCVM6_V24
    syssigHRBStatus_PowerOn
    syssigV_HRB
    syssigCVM12_VMaxCH
    syssigCVM6_V20
    syssigP_DIOut
    syssigCVM12_V14
    syssigCVM10_VMaxCH
    syssigCVM6_V16
    syssigCVM6_Var
    syssigDCF_MainVersion
    syssigFCU_StepCtl
    syssigCVM5_V21
    syssigCVM3_VMaxCH
    syssigCVM1_VMaxCH
    syssigVIn1_DCF
    syssigCVM7_Var
    syssigCVM6_V09
    syssigCVM6_V08
    syssigCVM6_V12
    syssigP_AIn
    syssigCVM6_V10
    syssigCVM11_V20
    syssigHRBStatus_TemperatureLimit
    syssigCNT_DCFOutput_FB
    syssigCVM6_V02
    syssigCVM6_V05
    syssigCNT_DCFOutputPreCharge_CMD
    syssigCNT_HCU_FB
    syssigCVM11_V04
    syssigCVM10_V03
    syssigCVM_ChSelect_Manual
    syssigHRBStatus_MFGEn
    syssigCMP_HVIL
    syssigCVM7_V16
    syssigWP_Set_Manual
    syssigFAN3_Set_Manual
    syssigCVM3_V17
    syssigCMP_DriveOverVoltage
    syssigCVM1_V06
    syssigCVM6_V15
    syssigCVM12_V17
    syssigCVM11_V16
    syssigCVM4_V01
    syssigT_HRBElec
    syssigCVM11_V14
    syssigCVM3_Total
    syssigCVM7_VMaxCH
    syssigCVM2_V16
    syssigCVM_Triggered_Manual
    syssigCMP_DriveLowVoltage
    syssigCNT_CMPLowVoltage_CMD
    syssigSpd_HRBSet_Manual
    syssigCVM5_V19
    syssigCVM8_VMax
    syssigCVM5_V11
    syssigCVM11_V06
    syssigCVM10_VMax
    syssigCVM2_V07
    syssigCVM8_V17
    syssigCVM3_V20
    syssigCVM11_V18
    syssigCVM1_V15
    syssigCVM8_V06
    syssigT_DCFWout
    syssigCVM1_V17
    syssigCVM5_V02
    syssigCVM4_VMinCH
    syssigCVM5_V08
    syssigCVM12_V19
    syssigTDiff_FCSet_Manual
    syssigCVM4_V21
    syssigCVM12_VMax
    syssigCVM10_Var
    syssigCVM7_V07
    syssigDCF_OutputOverVoltageProtect
    syssigP_AInSet
    syssigCVM8_V08
    syssigCVM6_Total
    syssigCVM4_V09
    syssigT_HTank3
    syssigCVM4_V07
    syssigCVM12_V10
    syssigCVM11_V08
    syssigCVM4_V10
    syssigCVM4_V18
    syssigCVM10_V05
    syssigCMP_DriveOverCurrent
    syssigCVM2_V05
    syssigCVM11_V10
    syssigCVM4_V16
    syssigCVM1_VMinCH
    syssigCVM10_V20
    syssigCVM9_V21
    syssigCVM4_V12
    syssigSOV_HPurge_FB
    syssigCVM5_VMinCH
    syssigCVM3_V19
    syssigDCF_MinorVersion
    syssigCVM9_VMinCH
    syssigCVM8_V24
    syssigCVM12_V23
    syssigSOC_H
    syssigCVM3_V15
    syssigCVM1_V20
    syssigDCF_OtherHardwareFailure
    syssigCVM2_VMaxCH
    syssigCVM1_V24
    syssigCVM8_V20
    syssigCVM6_VMaxCH
    syssigCVM2_V18
    syssigCVM8_V19
    syssigCVM10_VMin
    syssigSOV_HM_FB
    syssigCVM3_V11
    syssigCVM12_V21
    syssigT_HIn
    syssigCMP_Ready
    syssigT_HEXWout
    syssigFAN1_Set_Manual
    syssigCVM1_Total
    syssigCVM8_V11
    syssigCVM2_V01
    syssigCVM3_Var
    syssigCVM8_V15
    syssigT_CMPMot
    syssigCVM3_V22
    syssigCVM2_V09
    syssigDCF_En_Manual
    syssigCVM3_VMax
    syssigFAN4_FB
    syssigCMP_En_Manual
    syssigTV_DI_Manual
    syssigCMP_BaseState
    syssigCVM2_V10
    syssigCVM9_V18
    syssigCVM11_VMaxCH
    syssigCVM9_V01
    syssigCVM12_V08
    syssigCVM9_V16
    syssigCVM8_Total
    syssigCVM2_V12
    syssigCVM2_V14
    syssigCVM10_V01
    syssigT_AMB_Manual
    syssigDCF_PeriodResp
    syssigSOV_AHB_FB
    syssigT_AMB
    syssigFAN2_Set_Manual
    syssigCVM9_V09
    syssigCVM10_V18
    syssigCVM9_V10
    syssigCVM9_V07
    syssigCVM1_Var
    syssigCVM3_V06
    syssigCVM2_V23
    syssigCVM9_V05
    syssigDCF_InputLowVoltageProtect
    syssigCVM9_V12
    syssigCVM2_V21
    syssigCVM9_V14
    syssigCVM3_V08
    syssigCVM9_V03
    syssigCVM3_V04
    syssigPos_BPCVSet
    syssigCVM3_V02
    syssigCVM11_V12
    syssigCVM5_VMin
    syssigFAN4_Set_Manual
    syssigHRBStatus_PumpEn
