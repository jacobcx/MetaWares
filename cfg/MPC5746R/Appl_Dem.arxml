AUTOSAR XML (schema 4-2-1)
package /Dem
  module config Dem: ecuc-def-edition=1.0.0, implementation-config-variant=VARIANT-POST-BUILD, module-description=BswImpl_Dem
    DemConfigSet
      DemEventParameter_EEP (DemEventParameter):
        DemEventAvailable = 1
        DemEventFailureCycleCounterThreshold = 0
        DemEventId = 1
        DemEventKind = DEM_EVENT_KIND_SWC
        DemFFPrestorageSupported = 0
        DemOperationCycleRef = DemOperationCycle
        DemDebounceAlgorithmClass
          DemDebounceCounterBased: DemDebounceCounterBasedClassRef=DemDebounceCounterBasedClass
      DemEventParameter_CanSM (DemEventParameter):
        DemEventAvailable = 1
        DemEventFailureCycleCounterThreshold = 0
        DemEventId = 2
        DemEventKind = DEM_EVENT_KIND_BSW
        DemFFPrestorageSupported = 0
        DemOperationCycleRef = DemOperationCycle
        DemDebounceAlgorithmClass
          DemDebounceCounterBased: DemDebounceCounterBasedClassRef=DemDebounceCounterBasedClass
      DemDTC_22938 (DemDTC): DemDtcValue=22938, DemDTCFunctionalUnit=0, DemDTCSeverity=DEM_SEVERITY_NO_SEVERITY, DemDTCAttributesRef=DemDTCAttributes
      DemDTCAttributes:
        DemAgingAllowed = 1
        DemDTCPriority = 1
        DemImmediateNvStorage = 0
        DemAgingCycleCounterThreshold = 100
        DemAgingCycleRef = DemOperationCycle
        DemMemoryDestinationRef = DemPrimaryMemory
        DemFreezeFrameClassRef = DemFreezeFrameClass
        DemFreezeFrameRecNumClassRef = DemFreezeFrameRecNumClass
      DemEventParameter_22938 (DemEventParameter):
        DemEventAvailable = 1
        DemEventFailureCycleCounterThreshold = 0
        DemEventId = 3
        DemEventKind = DEM_EVENT_KIND_BSW
        DemFFPrestorageSupported = 0
        DemOperationCycleRef = DemOperationCycle
        DemDTCRef = DemDTC_22938
        DemStorageConditionGroupRef = DemStorageConditionGroup
        DemDebounceAlgorithmClass
          DemDebounceCounterBased: DemDebounceCounterBasedClassRef=DemDebounceCounterBasedClass
      DemDebounceCounterBasedClass:
        DemDebounceCounterDecrementStepSize = 1
        DemDebounceCounterFailedThreshold = 127
        DemDebounceCounterIncrementStepSize = 1
        DemDebounceCounterJumpDown = 0
        DemDebounceCounterJumpDownValue = 0
        DemDebounceCounterJumpUp = 0
        DemDebounceCounterJumpUpValue = 0
        DemDebounceCounterPassedThreshold = -128
      DemDTC_22940 (DemDTC): DemDtcValue=22940, DemDTCFunctionalUnit=0, DemDTCSeverity=DEM_SEVERITY_NO_SEVERITY, DemDTCAttributesRef=DemDTCAttributes
      DemEventParameter_22940 (DemEventParameter):
        DemEventAvailable = 1
        DemEventFailureCycleCounterThreshold = 0
        DemEventId = 4
        DemEventKind = DEM_EVENT_KIND_BSW
        DemFFPrestorageSupported = 0
        DemOperationCycleRef = DemOperationCycle
        DemDTCRef = DemDTC_22940
        DemDebounceAlgorithmClass
          DemDebounceCounterBased: DemDebounceCounterBasedClassRef=DemDebounceCounterBasedClass
    DemGeneral:
      DemAgingRequieresTestedCycle = 1
      DemAvailabilitySupport = DEM_NO_AVAILABILITY
      DemClearDTCBehavior = DEM_CLRRESP_VOLATILE
      DemDataElementDefaultEndianness = LITTLE_ENDIAN
      DemDebounceCounterBasedSupport = 1
      DemDebounceTimeBasedSupport = 0
      DemDevErrorDetect = 1
      DemDtcStatusAvailabilityMask = 255
      DemEventCombinationSupport = DEM_EVCOMB_DISABLED
      DemEventDisplacementStrategy = DEM_DISPLACEMENT_NONE
      DemEventMemoryEntryStorageTrigger = DEM_TRIGGER_ON_TEST_FAILED
      DemGeneralInterfaceSupport = 0
      DemMaxNumberEventEntryPermanent = 3
      DemMaxNumberPrestoredFF = 0
      DemOBDSupport = DEM_OBD_NO_OBD_SUPPORT
      DemOccurrenceCounterProcessing = DEM_PROCESS_OCCCTR_TF
      DemOperationCycleStatusStorage = 1
      DemPTOSupport = 0
      DemResetConfirmedBitOnOverflow = 0
      DemStatusBitHandlingTestFailedSinceLastClear = DEM_STATUS_BIT_NORMAL
      DemStatusBitStorageTestFailed = 1
      DemSuppressionSupport = DEM_NO_SUPPRESSION
      DemTaskTime = 0.02
      DemTriggerDcmReports = 0
      DemTriggerDltReports = 0
      DemTriggerFiMReports = 0
      DemTriggerMonitorInitBeforeClearOk = 1
      DemTypeOfDTCSupported = DEM_DTC_TRANSLATION_ISO14229_1
      DemTypeOfFreezeFrameRecordNumeration = DEM_FF_RECNUM_CONFIGURED
      DemVersionInfoApi = 1
      DemFreezeFrameBufferLength = 1
      DemNumberOfExtendedDataEntries = 10
      DemNvMSupport = 1
      DemOperationCycle: DemOperationCycleId=0, DemOperationCycleType=DEM_OPCYC_OBD_DCY, DemOpCycleDefaultInitValue=DEM_CYCLE_STATE_START
      DemPrimaryMemory: DemMaxNumberEventEntryPrimary=10, DemNumberOfFreezeFrameEntriesPrimary=2
      DemStorageCondition: DemStorageConditionStatus=1, DemStorageConditionId=0, DemStorageConditionReplacementEventRef=DemEventParameter_22938
      DemStorageConditionGroup: DemStorageConditionRef=DemStorageCondition
      DemFreezeFrameClass: DemDidClassRef=DemDidClass
      DemFreezeFrameRecNumClass: DemFreezeFrameRecordClassRef=DemFreezeFrameRecordClass
      DemFreezeFrameRecordClass: DemFreezeFrameRecordNumber=1, DemFreezeFrameRecordTrigger=DEM_TRIGGER_ON_TEST_FAILED, DemFreezeFrameRecordUpdate=DEM_UPDATE_RECORD_NO
      DemDidClass: DemDidIdentifier=0, DemDidDataElementClassRef=DemDataElementClass
      DemDataElementClass
        DemDataElementClass_DemExternalCSDataElementClass (DemExternalCSDataElementClass): DemDataElementUsePort=1, DemDataElementDataSize=1, DemDataElementReadFnc=ReadDataElement
