AUTOSAR XML (schema 4-2-1)
package /Wdg
  module config Wdg: ecuc-def-edition=1.0.0, implementation-config-variant=VARIANT-POST-BUILD, module-description=BswImplementation_0
    WdgGeneral:
      WdgDevErrorDetect = 0
      WdgDisableAllowed = 1
      WdgIndex = 0
      WdgIndex1 = 1
      WdgIndex3 = 3
      WdgInitialTimeout = 5.0
      WdgMaxTimeout = 50.0
      WdgRunArea = ROM
      WdgTriggerLocation = NULL_PTR
      WdgCallbackNotification0 = NULL_PTR
      WdgCallbackNotification1 = NULL_PTR
      WdgCallbackNotification3 = NULL_PTR
      WdgVersionInfoApi = 1
      NonAutosar: WdgDisableDemReportErrorStatus=0
    WdgClockReferencePoint: WdgClockReference=McuClockReferencePoint_PBRIDGEx
    WdgSettingsConfig: WdgInstance=SWT1, WdgDefaultMode=WDGIF_SLOW_MODE, WdgExternalTriggerCounterRef=GptChannel_Wdg
      WdgSettingsFast:
        WdgClockValue = 50000
        WdgMasterAccessProtectionforMaster{0..7} = 1
        WdgKeyedService = 0
        WdgServiceKeyValue = 0
        WdgSoftLockConfiguration = 0
        WdgHardLockConfiguration = 0
        WdgRunsInStopMode = 1
        WdgRunsInDebugMode = 0
        WdgOperationMode = ResetOnTimeOut
        WdgResetOnInvalidAccess = SystemReset
        WdgClockSelection = OscillatorClock
        WdgTimeoutPeriod = 1.0
        WdgWindowMode = 0
        WdgWindowPeriod = 0.0
        WdgClkSrcRef = WdgClockReferencePoint
      WdgSettingsOff: WdgSoftLockConfiguration=0, WdgHardLockConfiguration=0
      WdgSettingsSlow:
        WdgClockValue = 50000
        WdgMasterAccessProtectionforMaster{0..7} = 1
        WdgKeyedService = 0
        WdgServiceKeyValue = 0
        WdgSoftLockConfiguration = 0
        WdgHardLockConfiguration = 0
        WdgRunsInStopMode = 1
        WdgRunsInDebugMode = 0
        WdgOperationMode = ResetOnTimeOut
        WdgResetOnInvalidAccess = SystemReset
        WdgClockSelection = OscillatorClock
        WdgTimeoutPeriod = 5.0
        WdgWindowMode = 0
        WdgWindowPeriod = 0.0
        WdgClkSrcRef = WdgClockReferencePoint
    WdgPublishedInformation: WdgTriggerMode=WDG_TOGGLE
    CommonPublishedInformation:
      ArReleaseMajorVersion = 4
      ArReleaseMinorVersion = 0
      ArReleaseRevisionVersion = 3
      ModuleId = 102
      SwMajorVersion = 1
      SwMinorVersion = 0
      SwPatchVersion = 2
      VendorId = 43
  module config WdgM: ecuc-def-edition=1.0.0, implementation-config-variant=VARIANT-POST-BUILD, module-description=BswImpl_WdgM
    WdgMConfigSet: WdgMInitialMode=WdgMMode
      WdgMMode: WdgMExpiredSupervisionCycleTol=2, WdgMModeId=0, WdgMSupervisionCycle=0.01
        WdgMTrigger: WdgMTriggerConditionValue=2000, WdgMWatchdogMode=WDGIF_SLOW_MODE, WdgMTriggerWatchdogRef=WdgMWatchdog
    WdgMGeneral: WdgMDefensiveBehavior=0, WdgMDemStoppedSupervisionReport=1, WdgMDevErrorDetect=1, WdgMImmediateReset=0, WdgMOffModeEnabled=1, WdgMVersionInfoApi=1
      WdgMWatchdog: WdgMWatchdogName=Wdg0, WdgMWatchdogDeviceRef=WdgIfDevice
  module config WdgIf: ecuc-def-edition=1.0.0, implementation-config-variant=VARIANT-LINK-TIME, module-description=BswImpl_WdgIf
    WdgIfDevice: WdgIfDeviceIndex=0, WdgIfDriverRef=WdgGeneral
    WdgIfGeneral: WdgIfDevErrorDetect=0, WdgIfVersionInfoApi=1
