AUTOSAR XML (schema 4-2-1)
package /Port
  module config Port: ecuc-def-edition=1.0.0, implementation-config-variant=VARIANT-POST-BUILD, module-description=BswImplementation_0
    PortConfigSet
      NotUsedPortPin: PortPinWpde=0, PortPinWpue=0, PortPinDirection=PORT_PIN_IN, PortPinLevelValue=PORT_PIN_LEVEL_LOW
      8 x PortContainer:
        PortContainer_K: PortNumberOfPortPins=6
          6 x PortPin, all with PortPinWpde=0, PortPinWpue=0, PortPinSafeMode=0, PortPinWithReadBack=0, PortPinHysteresisControl=0, PortPinDirectionChangeable=1, PortPinModeChangeable=1, PortPinDirection=PORT_PIN_OUT, PortPinInputLevelSelection=AUTOMOTIVE, PortPinOutputDriveControl=PORT_PUSH_PULL, PortPinOutputEdgeRateControl=WEAK_DRIVE, PortPinInitialMode=PORT_GPIO_MODE, PortPinMode=GPIO:
            PortPin_PK0: PortPinId=1, PortPinPcr=160, PortPinLevelValue=PORT_PIN_LEVEL_LOW
            PortPin_PK1: PortPinId=2, PortPinPcr=161, PortPinLevelValue=PORT_PIN_LEVEL_LOW
            PortPin_PK2: PortPinId=3, PortPinPcr=162, PortPinLevelValue=PORT_PIN_LEVEL_LOW
            PortPin_PK5: PortPinId=4, PortPinPcr=165, PortPinLevelValue=PORT_PIN_LEVEL_LOW
            PortPin_EEP_WRI_EN: PortPinId=24, PortPinPcr=171, PortPinLevelValue=PORT_PIN_LEVEL_HIGH
            PortPin_EEP_HOLD: PortPinId=25, PortPinPcr=169, PortPinLevelValue=PORT_PIN_LEVEL_HIGH
        PortContainer_D: PortNumberOfPortPins=8
          8 x PortPin, all with PortPinWpde=0, PortPinWpue=0, PortPinSafeMode=0, PortPinWithReadBack=0, PortPinHysteresisControl=0, PortPinDirectionChangeable=1, PortPinModeChangeable=1, PortPinInputLevelSelection=AUTOMOTIVE, PortPinOutputEdgeRateControl=WEAK_DRIVE, PortPinInitialMode=PORT_GPIO_MODE, PortPinLevelValue=PORT_PIN_LEVEL_LOW:
            PortPin_CANC_RxD: PortPinId=5, PortPinPcr=48, PortPinDirection=PORT_PIN_IN, PortPinOutputDriveControl=PORT_OUTPUT_BUFFER_DISABLED, PortPinMode=FlexCAN_1_RX
            PortPin_CANC_TxD: PortPinId=6, PortPinPcr=49, PortPinDirection=PORT_PIN_OUT, PortPinOutputDriveControl=PORT_PUSH_PULL, PortPinMode=FlexCAN_1_TX
            PortPin_MOSI_2: PortPinId=8, PortPinPcr=60, PortPinDirection=PORT_PIN_OUT, PortPinOutputDriveControl=PORT_PUSH_PULL, PortPinMode=DSPI_4_SOUT
            PortPin_MISO_2: PortPinId=9, PortPinPcr=63, PortPinDirection=PORT_PIN_IN, PortPinOutputDriveControl=PORT_OUTPUT_BUFFER_DISABLED, PortPinMode=DSPI_4_SIN
            PortPin_SBC_CS: PortPinId=10, PortPinPcr=58, PortPinDirection=PORT_PIN_OUT, PortPinOutputDriveControl=PORT_PUSH_PULL, PortPinMode=DSPI_4_CS1
            PortPin_LIN_RxD: PortPinId=11, PortPinPcr=50, PortPinDirection=PORT_PIN_IN, PortPinOutputDriveControl=PORT_OUTPUT_BUFFER_DISABLED, PortPinMode=LINFlex_3_RX
            PortPin_LIN_TxD: PortPinId=12, PortPinPcr=51, PortPinDirection=PORT_PIN_OUT, PortPinOutputDriveControl=PORT_PUSH_PULL, PortPinMode=LINFlex_3_TX
            PortPin_EEP_CS: PortPinId=23, PortPinPcr=57, PortPinDirection=PORT_PIN_OUT, PortPinOutputDriveControl=PORT_PUSH_PULL, PortPinMode=DSPI_4_CS2
        PortContainer_E: PortNumberOfPortPins=1
          PortPin_SCK_2 (PortPin):
            PortPinWpde = 0
            PortPinWpue = 0
            PortPinSafeMode = 0
            PortPinWithReadBack = 0
            PortPinHysteresisControl = 0
            PortPinDirectionChangeable = 1
            PortPinModeChangeable = 1
            PortPinId = 7
            PortPinPcr = 64
            PortPinDirection = PORT_PIN_OUT
            PortPinInputLevelSelection = AUTOMOTIVE
            PortPinOutputDriveControl = PORT_PUSH_PULL
            PortPinOutputEdgeRateControl = WEAK_DRIVE
            PortPinInitialMode = PORT_GPIO_MODE
            PortPinMode = DSPI_4_SCLK_OUT
            PortPinLevelValue = PORT_PIN_LEVEL_LOW
        PortContainer_C: PortNumberOfPortPins=7
          7 x PortPin, all with PortPinWpde=0, PortPinWpue=0, PortPinSafeMode=0, PortPinWithReadBack=0, PortPinHysteresisControl=0, PortPinDirectionChangeable=1, PortPinModeChangeable=1, PortPinInputLevelSelection=AUTOMOTIVE, PortPinOutputEdgeRateControl=WEAK_DRIVE, PortPinInitialMode=PORT_GPIO_MODE, PortPinLevelValue=PORT_PIN_LEVEL_LOW:
            PortPin_CANA_CS: PortPinId=13, PortPinPcr=37, PortPinDirection=PORT_PIN_OUT, PortPinOutputDriveControl=PORT_PUSH_PULL, PortPinMode=DSPI_3_CS5
            PortPin_CANA_RxD: PortPinId=14, PortPinPcr=38, PortPinDirection=PORT_PIN_IN, PortPinOutputDriveControl=PORT_OUTPUT_BUFFER_DISABLED, PortPinMode=FlexCAN_2_RX
            PortPin_CANA_TxD: PortPinId=15, PortPinPcr=39, PortPinDirection=PORT_PIN_OUT, PortPinOutputDriveControl=PORT_PUSH_PULL, PortPinMode=FlexCAN_2_TX
            PortPin_SPI_MOSI_1: PortPinId=16, PortPinPcr=42, PortPinDirection=PORT_PIN_OUT, PortPinOutputDriveControl=PORT_PUSH_PULL, PortPinMode=DSPI_3_SOUT
            PortPin_SPI_MISO_1: PortPinId=17, PortPinPcr=43, PortPinDirection=PORT_PIN_IN, PortPinOutputDriveControl=PORT_OUTPUT_BUFFER_DISABLED, PortPinMode=DSPI_3_SIN
            PortPin_SPI_CLK_1: PortPinId=18, PortPinPcr=44, PortPinDirection=PORT_PIN_OUT, PortPinOutputDriveControl=PORT_PUSH_PULL, PortPinMode=DSPI_3_SCLK
            PortPin_CAND_CS: PortPinId=21, PortPinPcr=34, PortPinDirection=PORT_PIN_OUT, PortPinOutputDriveControl=PORT_PUSH_PULL, PortPinMode=DSPI_3_CS2
        PortContainer_I: PortNumberOfPortPins=2
          PortPin_CAND_RxD (PortPin):
            PortPinWpde = 0
            PortPinWpue = 0
            PortPinSafeMode = 0
            PortPinWithReadBack = 0
            PortPinHysteresisControl = 0
            PortPinDirectionChangeable = 1
            PortPinModeChangeable = 1
            PortPinId = 19
            PortPinPcr = 128
            PortPinDirection = PORT_PIN_IN
            PortPinInputLevelSelection = AUTOMOTIVE
            PortPinOutputDriveControl = PORT_OUTPUT_BUFFER_DISABLED
            PortPinOutputEdgeRateControl = WEAK_DRIVE
            PortPinInitialMode = PORT_GPIO_MODE
            PortPinMode = FlexCAN_3_RX
            PortPinLevelValue = PORT_PIN_LEVEL_LOW
          PortPin_CAND_TxD (PortPin):
            PortPinWpde = 0
            PortPinWpue = 0
            PortPinSafeMode = 0
            PortPinWithReadBack = 0
            PortPinHysteresisControl = 0
            PortPinDirectionChangeable = 1
            PortPinModeChangeable = 1
            PortPinId = 20
            PortPinPcr = 129
            PortPinDirection = PORT_PIN_OUT
            PortPinInputLevelSelection = AUTOMOTIVE
            PortPinOutputDriveControl = PORT_PUSH_PULL
            PortPinOutputEdgeRateControl = WEAK_DRIVE
            PortPinInitialMode = PORT_GPIO_MODE
            PortPinMode = FlexCAN_3_TX
            PortPinLevelValue = PORT_PIN_LEVEL_LOW
        PortContainer_G: PortNumberOfPortPins=2
          PortPin_6V2_EN (PortPin):
            PortPinWpde = 0
            PortPinWpue = 0
            PortPinSafeMode = 0
            PortPinWithReadBack = 0
            PortPinHysteresisControl = 0
            PortPinDirectionChangeable = 1
            PortPinModeChangeable = 1
            PortPinId = 22
            PortPinPcr = 110
            PortPinDirection = PORT_PIN_OUT
            PortPinInputLevelSelection = AUTOMOTIVE
            PortPinOutputDriveControl = PORT_PUSH_PULL
            PortPinOutputEdgeRateControl = STRONG_DRIVE
            PortPinInitialMode = PORT_GPIO_MODE
            PortPinMode = GPIO
            PortPinLevelValue = PORT_PIN_LEVEL_HIGH
          PortPin_LS_DRI_IN1 (PortPin):
            PortPinWpde = 0
            PortPinWpue = 0
            PortPinSafeMode = 0
            PortPinWithReadBack = 0
            PortPinHysteresisControl = 0
            PortPinDirectionChangeable = 1
            PortPinModeChangeable = 1
            PortPinId = 27
            PortPinPcr = 101
            PortPinDirection = PORT_PIN_OUT
            PortPinInputLevelSelection = AUTOMOTIVE
            PortPinOutputDriveControl = PORT_PUSH_PULL
            PortPinOutputEdgeRateControl = WEAK_DRIVE
            PortPinInitialMode = PORT_GPIO_MODE
            PortPinMode = eMIOS_0_12_OUT
            PortPinLevelValue = PORT_PIN_LEVEL_LOW
        PortContainer_X: PortNumberOfPortPins=1
          PortPin_ADC_MUXuC1 (PortPin):
            PortPinWpde = 0
            PortPinWpue = 0
            PortPinSafeMode = 0
            PortPinWithReadBack = 0
            PortPinHysteresisControl = 0
            PortPinDirectionChangeable = 1
            PortPinModeChangeable = 1
            PortPinId = 26
            PortPinPcr = 214
            PortPinDirection = PORT_PIN_IN
            PortPinInputLevelSelection = AUTOMOTIVE
            PortPinOutputDriveControl = PORT_OUTPUT_BUFFER_DISABLED
            PortPinOutputEdgeRateControl = WEAK_DRIVE
            PortPinInitialMode = PORT_GPIO_MODE
            PortPinMode = SAR_ADC_1_18
            PortPinLevelValue = PORT_PIN_LEVEL_LOW
        PortContainer_Z: PortNumberOfPortPins=1
          PortPin_ADC_uC1 (PortPin):
            PortPinWpde = 0
            PortPinWpue = 0
            PortPinSafeMode = 0
            PortPinWithReadBack = 0
            PortPinHysteresisControl = 0
            PortPinDirectionChangeable = 1
            PortPinModeChangeable = 1
            PortPinId = 28
            PortPinPcr = 240
            PortPinDirection = PORT_PIN_IN
            PortPinInputLevelSelection = AUTOMOTIVE
            PortPinOutputDriveControl = PORT_OUTPUT_BUFFER_DISABLED
            PortPinOutputEdgeRateControl = WEAK_DRIVE
            PortPinInitialMode = PORT_GPIO_MODE
            PortPinMode = SAR_ADC_0_0
            PortPinLevelValue = PORT_PIN_LEVEL_LOW
    PortGeneral:
      PortDevErrorDetect = 0
      PortSetPinDirectionApi = 1
      PortSetPinModeApi = 1
      PortVersionInfoApi = 1
      PortSetPinModeDoesNotTouchGpioLevel = 0
      PortEnableUserModeSupport = 0
    CommonPublishedInformation:
      ArReleaseMajorVersion = 4
      ArReleaseMinorVersion = 0
      ArReleaseRevisionVersion = 3
      ModuleId = 124
      SwMajorVersion = 1
      SwMinorVersion = 0
      SwPatchVersion = 2
      VendorId = 43
