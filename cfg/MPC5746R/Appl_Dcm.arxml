AUTOSAR XML (schema 4-2-1)
package /Dcm
  module config Dcm: ecuc-def-edition=1.0.0, implementation-config-variant=VARIANT-POST-BUILD, module-description=BswImpl_Dcm
    DcmConfigSet
      DcmDsd: DcmDsdRequestManufacturerNotificationEnabled=0, DcmDsdRequestSupplierNotificationEnabled=0
        DcmDsdServiceTable: DcmDsdSidTabId=0
          7 x DcmDsdService, all with DcmDsdServiceUsed=1, DcmDsdSidTabSessionLevelRef=EXTENDED_DIAGNOSTIC_SESSION:
            DcmDsdService_0x10: DcmDsdSidTabServiceId=16, DcmDsdSidTabSubfuncAvail=1, DcmDsdSidTabSessionLevelRef=DEFAULT_SESSION
              3 x DcmDsdSubService, all with DcmDsdSubServiceUsed=1:
                DcmDsdSubService_DefaultSession: DcmDsdSubServiceId=1
                DcmDsdSubService_ProgrammingSession: DcmDsdSubServiceId=2
                DcmDsdSubService_ExtendedSession: DcmDsdSubServiceId=3
            DcmDsdService_0x27: DcmDsdSidTabServiceId=39, DcmDsdSidTabSubfuncAvail=1
              DcmDsdSubService_SeedLevel0 (DcmDsdSubService): DcmDsdSubServiceId=1, DcmDsdSubServiceUsed=1, DcmDsdSubServiceSessionLevelRef=EXTENDED_DIAGNOSTIC_SESSION
              DcmDsdSubService_KeyLevel0 (DcmDsdSubService): DcmDsdSubServiceId=2, DcmDsdSubServiceUsed=1, DcmDsdSubServiceSessionLevelRef=EXTENDED_DIAGNOSTIC_SESSION
            DcmDsdService_0x22: DcmDsdSidTabServiceId=34, DcmDsdSidTabSubfuncAvail=0, DcmDsdSidTabSessionLevelRef=DEFAULT_SESSION
            DcmDsdService_0x2E: DcmDsdSidTabServiceId=46, DcmDsdSidTabSubfuncAvail=0, DcmDsdSidTabSessionLevelRef=DEFAULT_SESSION
            DcmDsdService_0x3E: DcmDsdSidTabServiceId=62, DcmDsdSidTabSubfuncAvail=1, DcmDsdSidTabSessionLevelRef=DEFAULT_SESSION
              DcmDsdSubService: DcmDsdSubServiceId=0, DcmDsdSubServiceUsed=1
            DcmDsdService_0x14: DcmDsdSidTabServiceId=20, DcmDsdSidTabSubfuncAvail=0, DcmDsdSidTabSessionLevelRef=DEFAULT_SESSION
            DcmDsdService_0x19: DcmDsdSidTabServiceId=25, DcmDsdSidTabSubfuncAvail=1, DcmDsdSidTabSessionLevelRef=DEFAULT_SESSION
              3 x DcmDsdSubService, all with DcmDsdSubServiceUsed=1:
                DcmDsdSubService_0x02: DcmDsdSubServiceId=2
                DcmDsdSubService_0x06: DcmDsdSubServiceId=6
                DcmDsdSubService_0x13: DcmDsdSubServiceId=19
      DcmDsl
        DcmDslBuffer: DcmDslBufferSize=256
        DcmDslDiagResp: DcmDslDiagRespMaxNumRespPend=10, DcmDslDiagRespOnSecondDeclinedRequest=0
        DcmDslProtocol
          DcmDslProtocolRow:
            DcmDslProtocolID = DCM_UDS_ON_CAN
            DcmDslProtocolPreemptTimeout = 0.5
            DcmDslProtocolPriority = 0
            DcmDslProtocolRowUsed = 1
            DcmSendRespPendOnTransToBoot = 1
            DcmTimStrP2ServerAdjust = 0.0
            DcmTimStrP2StarServerAdjust = 0.0
            DcmDslProtocolRxBufferRef = DcmDslBuffer
            DcmDslProtocolSIDTable = DcmDsdServiceTable
            DcmDslProtocolTxBufferRef = DcmDslBuffer
            DcmDslConnection
              DcmDslMainConnection: DcmDslProtocolRxTesterSourceAddr=0, DcmDslProtocolComMChannelRef=CanCluster
                DcmDslProtocolRx_Func (DcmDslProtocolRx): DcmDslProtocolRxAddrType=DCM_FUNCTIONAL_TYPE, DcmDslProtocolRxPduId=0, DcmDslProtocolRxPduRef=Pdu_UDS_Func_Rx_Dcm
                DcmDslProtocolTx: DcmDslTxConfirmationPduId=0, DcmDslProtocolTxPduRef=Pdu_UDS_Phys_Tx_Dcm
                DcmDslProtocolRx_Phys (DcmDslProtocolRx): DcmDslProtocolRxAddrType=DCM_PHYSICAL_TYPE, DcmDslProtocolRxPduId=1, DcmDslProtocolRxPduRef=Pdu_UDS_Phys_Rx_Dcm
      DcmPageBufferCfg: DcmPagedBufferEnabled=0
      DcmDsp: DcmDspMaxDidToRead=10
        DcmDspSecurity
          DcmDspSecurityRow:
            DcmDspSecurityDelayTime = 10.0
            DcmDspSecurityDelayTimeOnBoot = 10.0
            DcmDspSecurityKeySize = 2
            DcmDspSecurityLevel = 1
            DcmDspSecurityNumAttDelay = 5
            DcmDspSecuritySeedSize = 2
        DcmDspSession
          3 x DcmDspSessionRow, all with DcmDspSessionForBoot=DCM_NO_BOOT, DcmDspSessionP2ServerMax=0.05, DcmDspSessionP2StarServerMax=5.0:
            DEFAULT_SESSION: DcmDspSessionLevel=1
            PROGRAMMING_SESSION: DcmDspSessionLevel=2
            EXTENDED_DIAGNOSTIC_SESSION: DcmDspSessionLevel=3
        DcmDspDid_0x2345 (DcmDspDid): DcmDspDidIdentifier=9029, DcmDspDidUsed=1, DcmDspDidInfoRef=DcmDspDidInfo
          DcmDspDidSignal: DcmDspDidDataPos=0, DcmDspDidDataRef=DcmDspData
        DcmDspDataInfo: DcmDspDataScalingInfoSize=1
        DcmDspDidInfo: DcmDspDidDynamicallyDefined=0
          DcmDspDidRead: DcmDspDidReadSessionRef=DEFAULT_SESSION, DcmDspDidReadSessionRef=EXTENDED_DIAGNOSTIC_SESSION
          DcmDspDidWrite: DcmDspDidWriteSessionRef=EXTENDED_DIAGNOSTIC_SESSION, DcmDspDidWriteSessionRef=DEFAULT_SESSION
        DcmDspData:
          DcmDspDataType = UINT8
          DcmDspDataUsePort = USE_DATA_SYNCH_FNC
          DcmDspDataWriteFnc = Write_DID_0x2345
          DcmDspDataReadFnc = Read_DID_0x2345
          DcmDspDataSize = 8
          DcmDspDataConditionCheckReadFncUsed = 0
    DcmGeneral: DcmDevErrorDetect=1, DcmRespondAllRequest=1, DcmTaskTime=0.01, DcmVersionInfoApi=1, DcmAllowRteUnconnectedEnabled=1
