AUTOSAR XML (schema 4-2-1)
package /Eep
  module config Eep: ecuc-def-edition=1.0.0, implementation-config-variant=VARIANT-POST-BUILD, module-description=BSWImpl_Eep_31_AT25256B
    EepGeneral: EepDevErrorDetect=0, EepDriverIndex=0, EepUseInterrupts=0, EepVersionInfoApi=0, EepWriteCycleReduction=0, EepVersionCheckForeignModule=0
    EepInitConfiguration:
      EepBaseAddress = 0
      EepDefaultMode = MEMIF_MODE_SLOW
      EepFastReadBlockSize = 0
      EepFastWriteBlockSize = 0
      EepNormalReadBlockSize = 64
      EepNormalWriteBlockSize = 64
      EepSize = 32768
      EepWriteTimeOut = 1.0
      EepReadTimeOut = 1.0
      EepEraseTimeOut = 1.0
      EepJobCallCycle = 0.01
      EepJobEndNotification = Ea_JobEndNotification
      EepJobErrorNotification = Ea_JobErrorNotification
      EepExternalDriver: EepSpiReference=SpiSequence_EEP_READ, EepSpiReference=SpiSequence_EEP_READSTATUS, EepSpiReference=SpiSequence_EEP_WRITE
      EepDemEventParameterRefs:
        EEP_E_COMPARE_FAILED = DemEventParameter_EEP
        EEP_E_ERASE_FAILED = DemEventParameter_EEP
        EEP_E_READ_FAILED = DemEventParameter_EEP
        EEP_E_WRITE_FAILED = DemEventParameter_EEP
    EepPublishedInformation:
      EepAllowedWriteCycles = 65535
      EepEraseTime = 0.005
      EepEraseUnitSize = 64
      EepEraseValue = 255
      EepMinimumAddressType = 0
      EepMinimumLengthType = 0
      EepReadUnitSize = 64
      EepSpecifiedEraseCycles = 5
      EepTotalSize = 32768
      EepWriteTime = 0.005
      EepWriteUnitSize = 64
