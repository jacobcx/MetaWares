AUTOSAR XML (schema 4-0-3)
package /Base
  module config Base: ecuc-def-edition=1.0.0, implementation-config-variant=VARIANT-PRE-COMPILE, module-description=BswImplementation_0
    CommonPublishedInformation:
      ArReleaseMajorVersion = 4
      ArReleaseMinorVersion = 0
      ArReleaseRevisionVersion = 3
      ModuleId = 0
      SwMajorVersion = 1
      SwMinorVersion = 0
      SwPatchVersion = 2
      VendorId = 43
