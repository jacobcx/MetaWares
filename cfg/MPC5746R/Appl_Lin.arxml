AUTOSAR XML (schema 4-2-1)
package /Lin
  module config Lin: ecuc-def-edition=1.0.0, implementation-config-variant=VARIANT-POST-BUILD, module-description=BswImplementation_0
    NonAutosar: LinEnableDualClockMode=0, LinDisableDemReportErrorStatus=0, LinDisableFrameTimeout=0
    LinGeneral: LinDevErrorDetect=0, LinIndex=0, LinTimeoutDuration=1000, LinVersionInfoApi=1
    LinGlobalConfig
      LinChannel_SBC (LinChannel):
        LinChannelId = 0
        LinChannelBaudRate = 19200
        BreakLength = BL_13
        LinHwChannel = LinHWCh_3
        LinChannelWakeupSupport = 0
        LinClockRef = McuClockReferencePoint_LIN
        LinChannelEcuMWakeupSource = EcuMWakeupSource_Lin
    CommonPublishedInformation:
      ArReleaseMajorVersion = 4
      ArReleaseMinorVersion = 0
      ArReleaseRevisionVersion = 3
      ModuleId = 82
      SwMajorVersion = 1
      SwMinorVersion = 0
      SwPatchVersion = 2
      VendorId = 43
