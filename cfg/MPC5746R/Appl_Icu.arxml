AUTOSAR XML (schema 4-2-1)
package /Icu
  module config Icu: ecuc-def-edition=1.0.0, implementation-config-variant=VARIANT-POST-BUILD, module-description=BswImplementation_0
    IcuConfigSet: IcuMaxChannel=1
      IcuChannel_SBC (IcuChannel):
        IcuChannelId = 0
        IcuHwIP = SIUL2
        IcuDMAChannelEnable = 0
        IcuDefaultStartEdge = ICU_RISING_EDGE
        IcuMeasurementMode = ICU_MODE_SIGNAL_EDGE_DETECT
        IcuOverflowNotification = NULL_PTR
        IcuLockableChannel = 0
        IcuWakeupCapability = 0
        IcuDMAChannelRef = (unset)
        IcuSiul2ChannelRef = IcuSiul2Channels
        IcuSignalEdgeDetection: IcuSignalNotification=NULL_PTR
      IcueMios: IcueMiosModule=EMIOS_0
        IcueMiosChannels:
          IcueMiosChannel = CH_10
          IcuEmiosFreeze = 0
          IcuEmiosPrescaler = EMIOS_PRESCALER_DIVIDE_1
          IcuEmiosPrescaler_Alternate = EMIOS_PRESCALER_DIVIDE_1
          IcuEmiosDigitalFilter = EMIOS_DIGITAL_FILTER_BYPASSED
          IcuEmiosBusSelect = EMIOS_BUS_A
          IcuUserModeForDutycycle = SAIC
          IcuSignalMeasureWithoutInterrupt = 0
      IcuSiul2: IcuEXT_ISR_InterruptFilterClockPrescaler=0, IcuEXT_ISR_AlternateInterruptFilterClockPrescaler=0
        IcuSiul2Channels: IcuSiul2Channel=IRQ_CH_0, Icu_EXT_ISR_IFERDigitalFilter=0, Icu_EXT_ISR_IFMCDigitalFilter=0
    IcuGeneral: IcuDevErrorDetect=0, IcuIndex=0, IcuReportWakeupSource=1, IcuEnableUserModeSupport=0
    IcuNonAUTOSAR:
      IcuEnableDualClockMode = 0
      IcuOverflowNotificationApi = 0
      IcuGetInputLevelApi = 0
      IcuRegisterLockingMode = NO_REGISTER_LOCKING
      IcuGetCaptureRegisterValueApi = 0
    IcuOptionalApis:
      IcuDeInitApi = 1
      IcuDisableWakeupApi = 1
      IcuEdgeCountApi = 1
      IcuEnableWakeupApi = 1
      IcuGetDutyCycleValuesApi = 1
      IcuGetInputStateApi = 1
      IcuGetTimeElapsedApi = 1
      IcuGetVersionInfoApi = 1
      IcuSetModeApi = 1
      IcuSignalMeasurementApi = 1
      IcuTimestampApi = 1
      IcuWakeupFunctionalityApi = 1
      IcuEdgeDetectApi = 1
    CommonPublishedInformation:
      ArReleaseMajorVersion = 4
      ArReleaseMinorVersion = 0
      ArReleaseRevisionVersion = 3
      ModuleId = 122
      SwMajorVersion = 1
      SwMinorVersion = 0
      SwPatchVersion = 2
      VendorId = 43
