AUTOSAR XML (schema 4-2-1)
package /Mcal_EcuM
  module config EcuM: ecuc-def-edition=1.0.0, implementation-config-variant=VARIANT-POST-BUILD, module-description=BswImpl_EcuM
    EcuMConfiguration
      EcuMCommonConfiguration: EcuMConfigConsistencyHash=0, EcuMDefaultAppMode=(unset), EcuMOSResource=(unset)
        EcuMDefaultShutdownTarget: EcuMDefaultState=EcuMStateReset
        EcuMSleepMode: EcuMSleepModeId=0, EcuMSleepModeSuspend=0, EcuMSleepModeMcuModeRef=(unset), EcuMWakeupSourceMask=(unset)
        EcuMWakeupSource_Lin (): EcuMWakeupSourceId=0, EcuMWakeupSourcePolling=0
    EcuMGeneral:
      EcuMDevErrorDetect = 0
      EcuMIncludeDet = 0
      EcuMMainFunctionPeriod = 0.01
      EcuMVersionInfoApi = 1
      EcuMGptPeriodInHalt = 0.1
      EcuMSleepActivityPeriod = 0.1
      EcuMIncludeDem = 1
