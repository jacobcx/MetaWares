AUTOSAR XML (schema 4-0-3)
package /Spi
  module config Spi: ecuc-def-edition=1.0.0, implementation-config-variant=VARIANT-POST-BUILD, module-description=BswImplementation_0
    CommonPublishedInformation:
      ArReleaseMajorVersion = 4
      ArReleaseMinorVersion = 0
      ArReleaseRevisionVersion = 3
      ModuleId = 83
      SwMajorVersion = 1
      SwMinorVersion = 0
      SwPatchVersion = 2
      VendorId = 43
    SpiPublishedInformation: SpiMaxHwUnit=5
    SpiDriver
      SpiChannel: SpiChannelId=0, SpiChannelType=EB, SpiDataWidth=16, SpiDefaultData=1, SpiEbMaxLength=10, SpiIbNBuffers=1, SpiTransferStart=MSB
      SpiExternalDevice_SBC (SpiExternalDevice):
        SpiSlaveMode = 0
        TSBModeEnable = 0
        ITSBModeEnable = 0
        SpiBaudrate = 1000000.0
        SpiEnableCs = 1
        SpiCsIdentifier = PCS0
        SpiCsPolarity = LOW
        SpiCsSelection = CS_VIA_PERIPHERAL_ENGINE
        SpiDataShiftEdge = LEADING
        SpiHwUnit = CSIB4
        SpiShiftClockIdleLevel = LOW
        SpiTimeClk2Cs = 1.0E-6
        SpiTimeCs2Clk = 1.0E-6
        SpiTimeCs2Cs = 6.4E-6
        SpiCsContinous = TRUE
      SpiJob:
        TSBModeEnable = 0
        ITSBModeEnable = 0
        SpiHwUnitSynchronous = SYNCHRONOUS
        SpiJobEndNotification = NULL_PTR
        SpiJobStartNotification = NULL_PTR
        SpiJobId = 0
        SpiJobPriority = 0
        TSBFrameSize = 16
        TS3_LEN = 0
        TS2_LEN = 0
        TS1_LEN = 0
        TS0_LEN = 0
        TS3_CONF = PF
        TS2_CONF = PF
        TS1_CONF = PF
        TS0_CONF = PF
        DsiCsIdentifier = DPCS0
        TransmitDataSource = DSISerializationRegister
        ChangeInDataTransfer = 0
        DualReceiverSupport = 0
        SecondaryFrameSize = 16
        SecondaryDsiCsIdentifier = DPCS1
        SpiDeviceAssignment = SpiExternalDevice_SBC
        SpiChannelList: SpiChannelIndex=0, SpiChannelAssignment=SpiChannel
      SpiSequence_SBC (SpiSequence): SpiInterruptibleSequence=0, SpiSeqEndNotification=NULL_PTR, SpiSequenceId=0, SpiJobAssignment=SpiJob
      SpiExternalDevice_CANA_TJA1145 (SpiExternalDevice):
        SpiSlaveMode = 0
        TSBModeEnable = 0
        ITSBModeEnable = 0
        SpiBaudrate = 1000000.0
        SpiEnableCs = 1
        SpiCsIdentifier = PCS5
        SpiCsPolarity = LOW
        SpiCsSelection = CS_VIA_PERIPHERAL_ENGINE
        SpiDataShiftEdge = LEADING
        SpiHwUnit = CSIB3
        SpiShiftClockIdleLevel = LOW
        SpiTimeClk2Cs = 1.0E-6
        SpiTimeCs2Clk = 1.0E-6
        SpiTimeCs2Cs = 6.4E-6
        SpiCsContinous = TRUE
      SpiJob_CANA_TJA1145 (SpiJob):
        TSBModeEnable = 0
        ITSBModeEnable = 0
        SpiHwUnitSynchronous = SYNCHRONOUS
        SpiJobEndNotification = NULL_PTR
        SpiJobStartNotification = NULL_PTR
        SpiJobId = 1
        SpiJobPriority = 0
        TSBFrameSize = 16
        TS3_LEN = 0
        TS2_LEN = 0
        TS1_LEN = 0
        TS0_LEN = 0
        TS3_CONF = PF
        TS2_CONF = PF
        TS1_CONF = PF
        TS0_CONF = PF
        DsiCsIdentifier = DPCS0
        TransmitDataSource = DSISerializationRegister
        ChangeInDataTransfer = 0
        DualReceiverSupport = 0
        SecondaryFrameSize = 16
        SecondaryDsiCsIdentifier = DPCS1
        SpiDeviceAssignment = SpiExternalDevice_CANA_TJA1145
        SpiChannelList: SpiChannelIndex=0, SpiChannelAssignment=SpiChannel_CANA_TJA1145
      SpiChannel_CANA_TJA1145 (SpiChannel): SpiChannelId=1, SpiChannelType=EB, SpiDataWidth=16, SpiDefaultData=1, SpiEbMaxLength=10, SpiIbNBuffers=1, SpiTransferStart=MSB
      SpiSequence_CANA_TJA1145 (SpiSequence): SpiInterruptibleSequence=0, SpiSeqEndNotification=NULL_PTR, SpiSequenceId=1, SpiJobAssignment=SpiJob_CANA_TJA1145
      SpiExternalDevice_CAND_TJA1145 (SpiExternalDevice):
        SpiSlaveMode = 0
        TSBModeEnable = 0
        ITSBModeEnable = 0
        SpiBaudrate = 1000000.0
        SpiEnableCs = 1
        SpiCsIdentifier = PCS2
        SpiCsPolarity = LOW
        SpiCsSelection = CS_VIA_PERIPHERAL_ENGINE
        SpiDataShiftEdge = LEADING
        SpiHwUnit = CSIB3
        SpiShiftClockIdleLevel = LOW
        SpiTimeClk2Cs = 1.0E-6
        SpiTimeCs2Clk = 1.0E-6
        SpiTimeCs2Cs = 6.4E-6
        SpiCsContinous = TRUE
      SpiSequence_CAND_TJA1145 (SpiSequence): SpiInterruptibleSequence=0, SpiSeqEndNotification=NULL_PTR, SpiSequenceId=2, SpiJobAssignment=SpiJob_CAND_TJA1145
      SpiJob_CAND_TJA1145 (SpiJob):
        TSBModeEnable = 0
        ITSBModeEnable = 0
        SpiHwUnitSynchronous = SYNCHRONOUS
        SpiJobEndNotification = NULL_PTR
        SpiJobStartNotification = NULL_PTR
        SpiJobId = 2
        SpiJobPriority = 0
        TSBFrameSize = 16
        TS3_LEN = 0
        TS2_LEN = 0
        TS1_LEN = 0
        TS0_LEN = 0
        TS3_CONF = PF
        TS2_CONF = PF
        TS1_CONF = PF
        TS0_CONF = PF
        DsiCsIdentifier = DPCS0
        TransmitDataSource = DSISerializationRegister
        ChangeInDataTransfer = 0
        DualReceiverSupport = 0
        SecondaryFrameSize = 16
        SecondaryDsiCsIdentifier = DPCS1
        SpiDeviceAssignment = SpiExternalDevice_CAND_TJA1145
        SpiChannelList: SpiChannelIndex=0, SpiChannelAssignment=SpiChannel_CANA_TJA1145
      3 x SpiSequence, all with SpiInterruptibleSequence=0:
        SpiSequence_EEP_READ: SpiSeqEndNotification=Eep_SpiReadSeqEndNotification, SpiSequenceId=3, SpiJobAssignment=SpiJob_EEP_DataJob
        SpiSequence_EEP_WRITE: SpiSeqEndNotification=Eep_SpiWriteSeqEndNotification, SpiSequenceId=4, SpiJobAssignment=SpiJob_EEP_CommandJob, SpiJobAssignment=SpiJob_EEP_DataJob
        SpiSequence_EEP_READSTATUS: SpiSeqEndNotification=Eep_SpiReadStatusRegSeqEndNotification, SpiSequenceId=5, SpiJobAssignment=SpiJob_EEP_ReadStatusReg
      SpiJob_EEP_DataJob (SpiJob):
        TSBModeEnable = 0
        ITSBModeEnable = 0
        SpiHwUnitSynchronous = ASYNCHRONOUS
        SpiJobEndNotification = NULL_PTR
        SpiJobStartNotification = NULL_PTR
        SpiJobId = 4
        SpiJobPriority = 0
        TSBFrameSize = 16
        TS3_LEN = 0
        TS2_LEN = 0
        TS1_LEN = 0
        TS0_LEN = 0
        TS3_CONF = PF
        TS2_CONF = PF
        TS1_CONF = PF
        TS0_CONF = PF
        DsiCsIdentifier = DPCS0
        TransmitDataSource = DSISerializationRegister
        ChangeInDataTransfer = 0
        DualReceiverSupport = 0
        SecondaryFrameSize = 16
        SecondaryDsiCsIdentifier = DPCS1
        SpiDeviceAssignment = SpiExternalDevice_EEP
        SpiChannelList: SpiChannelIndex=0, SpiChannelAssignment=SpiChannel_EEP_CommandAddress
        SpiChannelList1 (SpiChannelList): SpiChannelIndex=1, SpiChannelAssignment=SpiChannel_EEP_Data
      SpiChannel_EEP_CommandAddress (SpiChannel): SpiChannelId=2, SpiChannelType=EB, SpiDataWidth=8, SpiDefaultData=1, SpiEbMaxLength=3, SpiIbNBuffers=1, SpiTransferStart=MSB
      SpiChannel_EEP_Data (SpiChannel): SpiChannelId=3, SpiChannelType=EB, SpiDataWidth=8, SpiDefaultData=1, SpiEbMaxLength=64, SpiIbNBuffers=1, SpiTransferStart=MSB
      SpiJob_EEP_CommandJob (SpiJob):
        TSBModeEnable = 0
        ITSBModeEnable = 0
        SpiHwUnitSynchronous = ASYNCHRONOUS
        SpiJobEndNotification = NULL_PTR
        SpiJobStartNotification = NULL_PTR
        SpiJobId = 3
        SpiJobPriority = 1
        TSBFrameSize = 16
        TS3_LEN = 0
        TS2_LEN = 0
        TS1_LEN = 0
        TS0_LEN = 0
        TS3_CONF = PF
        TS2_CONF = PF
        TS1_CONF = PF
        TS0_CONF = PF
        DsiCsIdentifier = DPCS0
        TransmitDataSource = DSISerializationRegister
        ChangeInDataTransfer = 0
        DualReceiverSupport = 0
        SecondaryFrameSize = 16
        SecondaryDsiCsIdentifier = DPCS1
        SpiDeviceAssignment = SpiExternalDevice_EEP
        SpiChannelList: SpiChannelIndex=0, SpiChannelAssignment=SpiChannel_EEP_LatchCommand
      SpiChannel_EEP_LatchCommand (SpiChannel): SpiChannelId=4, SpiChannelType=EB, SpiDataWidth=8, SpiDefaultData=1, SpiEbMaxLength=1, SpiIbNBuffers=1, SpiTransferStart=MSB
      SpiChannel_EEP_StatusReg (SpiChannel): SpiChannelId=5, SpiChannelType=EB, SpiDataWidth=8, SpiDefaultData=1, SpiEbMaxLength=2, SpiIbNBuffers=1, SpiTransferStart=MSB
      SpiJob_EEP_ReadStatusReg (SpiJob):
        TSBModeEnable = 0
        ITSBModeEnable = 0
        SpiHwUnitSynchronous = ASYNCHRONOUS
        SpiJobEndNotification = NULL_PTR
        SpiJobStartNotification = NULL_PTR
        SpiJobId = 5
        SpiJobPriority = 0
        TSBFrameSize = 16
        TS3_LEN = 0
        TS2_LEN = 0
        TS1_LEN = 0
        TS0_LEN = 0
        TS3_CONF = PF
        TS2_CONF = PF
        TS1_CONF = PF
        TS0_CONF = PF
        DsiCsIdentifier = DPCS0
        TransmitDataSource = DSISerializationRegister
        ChangeInDataTransfer = 0
        DualReceiverSupport = 0
        SecondaryFrameSize = 16
        SecondaryDsiCsIdentifier = DPCS1
        SpiDeviceAssignment = SpiExternalDevice_EEP
        SpiChannelList: SpiChannelIndex=0, SpiChannelAssignment=SpiChannel_EEP_StatusReg
      SpiExternalDevice_EEP (SpiExternalDevice):
        SpiSlaveMode = 0
        TSBModeEnable = 0
        ITSBModeEnable = 0
        SpiBaudrate = 1000000.0
        SpiEnableCs = 1
        SpiCsIdentifier = PCS2
        SpiCsPolarity = LOW
        SpiCsSelection = CS_VIA_PERIPHERAL_ENGINE
        SpiDataShiftEdge = TRAILING
        SpiHwUnit = CSIB4
        SpiShiftClockIdleLevel = LOW
        SpiTimeClk2Cs = 1.0E-6
        SpiTimeCs2Clk = 1.0E-6
        SpiTimeCs2Cs = 6.4E-6
        SpiCsContinous = TRUE
    SpiGeneral:
      SpiCancelApi = 1
      SpiChannelBuffersAllowed = 2
      SpiDevErrorDetect = 0
      SpiEnableUserModeSupport = 0
      SpiHwStatusApi = 1
      SpiInterruptibleSeqAllowed = 0
      SpiLevelDelivered = 2
      SpiSupportConcurrentSyncTransmit = 0
      SpiVersionInfoApi = 1
      SpiGlobalDmaEnable = 0
      SpiTransmitTimeout = 50000
      SpiOptimizeOneJobSequences = 0
      SpiOptimizedSeqNumber = 0
      SpiOptimizedChannelsNumber = 0
      SpiMainFunctionPeriod = 0.01
      SpiCPUClockRef = McuClockReferencePoint_SystemClk
      5 x SpiPhyUnit, all with SpiPhyUnitMode=SPI_MASTER, SpiPhyUnitAsyncMethod=PIO_FIFO, SpiPhyUnitClockRef=McuClockReferencePoint_SPI:
        SpiPhyUnit_2: SpiPhyUnitMapping=DSPI_2, SpiPhyUnitSync=1
        SpiPhyUnit_0: SpiPhyUnitMapping=DSPI_0, SpiPhyUnitSync=1
        SpiPhyUnit_1: SpiPhyUnitMapping=DSPI_1, SpiPhyUnitSync=1
        SpiPhyUnit_3: SpiPhyUnitMapping=DSPI_3, SpiPhyUnitSync=1
        SpiPhyUnit_4: SpiPhyUnitMapping=DSPI_4, SpiPhyUnitSync=0
    SpiNonAUTOSAR:
      SpiAllowBigSizeCollections = 0
      SpiEnableHWUnitAsyncMode = 1
      SpiTSBModeSupport = 0
      SpiITSBModeSupport = 0
      SpiJobStartNotificationEnable = 0
      SpiForceDataType = 1
      SpiDisableDemReportErrorStatus = 0
