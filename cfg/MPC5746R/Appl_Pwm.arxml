AUTOSAR XML (schema 4-2-1)
package /Pwm
  module config Pwm: ecuc-def-edition=1.0.0, implementation-config-variant=VARIANT-POST-BUILD, module-description=BswImplementation_0
    PwmConfigurationOfOptApiServices:
      PwmDeInitApi = 1
      PwmGetOutputState = 1
      PwmSetDutyCycle = 1
      PwmSetOutputToIdle = 1
      PwmSetPeriodAndDuty = 1
      PwmVersionInfoApi = 1
      PwmGetChannelStateApi = 1
      MultiPwmChannelSynch = 1
      PwmSetCounterBusApi = 1
      PwmSetChannelOutputApi = 1
      PwmSetTriggerDelayApi = 0
    PwmGeneral:
      PwmDevErrorDetect = 0
      PwmDutycycleUpdatedEndperiod = 1
      PwmNotificationSupported = 1
      PwmEnableDualClockMode = 0
      PwmPeriodUpdatedEndperiod = 1
      PwmChangeRegisterA = 0
      PwmEnableUserModeSupport = 0
      PwmIndex = 0
      PwmRegisterLockingMode = UserModeSoftLocking
      PwmTimerPrecision = PWM_16BIT
    PwmChannelConfigSet
      PwmChannel_LS_DRI_IN1 (PwmChannel):
        PwmChannelId = 0
        PwmHwIP = eMios
        PwmPeriodInTicks = 1
        PwmPeriodDefault = 50000.0
        PwmPolarity = PWM_HIGH
        PwmDutycycleDefault = 16384
        PwmIdleState = PWM_LOW
        PwmNotification = NULL
        PwmChannelClass = PWM_FIXED_PERIOD
        PwmeMiosChannel = PwmeMiosChannels
      PwmeMios: PwmeMiosModule=eMios_0, PwmClockRef=McuClockReferencePoint_eMIOS
        PwmeMiosChannels:
          PwmeMiosChannel = Channel_12
          PwmPrescaler = PwmPrescalerDiv4
          PwmPrescaler_Alternate = PwmPrescalerDiv4
          PwmModeSelect = PWM_MODE_OPWFMB_U32
          EmiosUnifiedChannelBusSelect = PWM_BUS_INTERNAL_COUNTER_U32
          PwmOffset = 0
          PwmTriggerDelay = 0
          Pwm_Deadtime = 0
          OffsetDelayAdjust = 0
          PwmFreezeEnable = 0
    CommonPublishedInformation:
      ArReleaseMajorVersion = 4
      ArReleaseMinorVersion = 0
      ArReleaseRevisionVersion = 3
      ModuleId = 121
      SwMajorVersion = 1
      SwMinorVersion = 0
      SwPatchVersion = 2
      VendorId = 43
