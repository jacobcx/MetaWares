AUTOSAR XML (schema 4-0-3)
standard types defined: boolean, uint8, uint16, uint32, sint8, sint16, sint32, uint8_least, uint16_least, uint32_least, sint8_least, sint16_least, sint32_least, float32, float64
