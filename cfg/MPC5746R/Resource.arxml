AUTOSAR XML (schema 4-0-3)
package /Resource
  module config Resource
    CommonPublishedInformation:
      ArReleaseMajorVersion = 4
      ArReleaseMinorVersion = 0
      ArReleaseRevisionVersion = 3
      ModuleId = 0
      SwMajorVersion = 1
      SwMinorVersion = 0
      SwPatchVersion = 2
      VendorId = 43
    ResourceGeneral: ResourceSubderivative=mpc5746r_mapbga252
