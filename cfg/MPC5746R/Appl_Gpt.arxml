AUTOSAR XML (schema 4-2-1)
package /Gpt
  module config Gpt: ecuc-def-edition=1.0.0, implementation-config-variant=VARIANT-POST-BUILD, module-description=BswImplementation_0
    GptChannelConfigSet
      GptChannelConfiguration:
        GptChannelId = 0
        GptHwChannel = EMIOS_0_CH_8
        GptChannelMode = GPT_CH_MODE_ONESHOT
        GptChannelTickFrequency = 1.0E8
        GptChannelTickValueMax = 16777215
        GptFreezeEnable = 1
        GptEnableWakeup = 0
        GptChannelPrescaler = 1
        GptChannelClkSrcRef = GptClockReferencePoint_eMIOS
      GptChannel_Wdg (GptChannelConfiguration):
        GptChannelId = 1
        GptHwChannel = PIT_0_CH_7
        GptChannelMode = GPT_CH_MODE_CONTINUOUS
        GptChannelTickFrequency = 5.0E7
        GptChannelTickValueMax = 4294967295
        GptFreezeEnable = 1
        GptEnableWakeup = 0
        GptChannelPrescaler = 1
        GptNotification = Wdg_Cbk_GptNotification1
        GptChannelClkSrcRef = GptClockReferencePoint_PER
    GptConfigurationOfOptApiServices:
      GptDeinitApi = 1
      GptEnableDisableNotificationApi = 1
      GptTimeElapsedApi = 1
      GptTimeRemainingApi = 1
      GptVersionInfoApi = 1
      GptWakeupFunctionalityApi = 1
      GptTimeout = 65535
    GptNonAUTOSAR: GptEnableDualClockMode=0, GptDisableDemReportErrorStatus=0, GptChangeNextTimeoutValueApi=0
    GptDriverConfiguration: GptDevErrorDetect=0, GptReportWakeupSource=1, GptRegisterLockingMode=NO_REGISTER_LOCKING
      GptClockReferencePoint_eMIOS (GptClockReferencePoint): GptClockReference=McuClockReferencePoint_eMIOS
      GptClockReferencePoint_PER (GptClockReferencePoint): GptClockReference=McuClockReferencePoint_PER
    CommonPublishedInformation:
      ArReleaseMajorVersion = 4
      ArReleaseMinorVersion = 0
      ArReleaseRevisionVersion = 3
      ModuleId = 100
      SwMajorVersion = 1
      SwMinorVersion = 0
      SwPatchVersion = 2
      VendorId = 43
