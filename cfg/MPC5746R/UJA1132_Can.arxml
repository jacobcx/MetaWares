AUTOSAR XML (schema 4-2-1)
package /CanTrcv_UJA1132
  module config CanTrcv_SBC: definition=CanTrcv, ecuc-def-edition=1.0.0, implementation-config-variant=VARIANT-LINK-TIME, module-description=CanTrcvBswImp
    CanTrcvConfigSet: CanTrcvSPICommRetries=0, CanTrcvSPICommTimeout=0
      CanTrcvChannel_SBC (CanTrcvChannel):
        CanTrcvChannelId = 0
        CanTrcvChannelUsed = 1
        CanTrcvControlsPowerSupply = 0
        CanTrcvHwPnSupport = 0
        CanTrcvInitState = CANTRCV_OP_MODE_NORMAL
        CanTrcvMaxBaudrate = 1000
        CanTrcvWakeupByBusUsed = 0
        CanTrcvRxDioPin = DioChannel_SBC_INT1
        CanTrcvIcuChannelRef = IcuChannel_SBC
        CanTrcvAccess
          CanTrcvSpiAccess
            CanTrcvSpiSequence: CanTrcvSpiAccessSynchronous=1, CanTrcvSpiSequenceName=SpiSequence_SBC
    CanTrcvGeneral:
      CanTrcvDevErrorDetect = 0
      CanTrcvGetVersionInfo = 0
      CanTrcvIndex = 0
      CanTrcvWakeUpSupport = CANTRCV_WAKEUP_NOT_SUPPORTED
      CanTrcvMainFunctionTimePeriod = 0.01
      CanTrcvSBCSISupport = 0
      CanTrcvSPICommRetries = 0
      CanTrcvSPICommTimeout = 0
      CanTrcvWaitCount = 0
      CanTrcvMainFunctionPeriod = 0.01
      CanTrcvMainFunctionDiagnosticsPeriod = 0.01
      CanTrcvTimerType = None
      CanTrcvVersionCheckForeignModule = 0
