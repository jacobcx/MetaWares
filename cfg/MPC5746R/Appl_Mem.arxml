AUTOSAR XML (schema 4-2-1)
package /Mem
  module config MemIf: ecuc-def-edition=1.0.0, implementation-config-variant=VARIANT-LINK-TIME, module-description=BswImpl_MemIf
    MemIfGeneral: MemIfDevErrorDetect=0, MemIfNumberOfDevices=1, MemIfVersionInfoApi=1, MemIfVersionCheckForeignModule=1
  module config NvM: ecuc-def-edition=1.0.0, implementation-config-variant=VARIANT-LINK-TIME, module-description=BswImpl_NvM
    NvMCommon:
      NvMApiConfigClass = NVM_API_CONFIG_CLASS_3
      NvMBswMMultiBlockJobStatusInformation = 1
      NvMCompiledConfigId = 1
      NvMCrcNumOfBytes = 65535
      NvMDatasetSelectionBits = 1
      NvMDevErrorDetect = 0
      NvMDrvModeSwitch = 0
      NvMDynamicConfiguration = 0
      NvMJobPrioritization = 0
      NvMMainFunctionPeriod = 0.01
      NvMPollingMode = 0
      NvMRepeatMirrorOperations = 0
      NvMSetRamBlockStatusApi = 1
      NvMSizeStandardJobQueue = 5
      NvMVersionInfoApi = 1
      NvM421FeaturesEnable = 1
      NvMVersionCheckForeignModule = 0
    3 x NvMBlockDescriptor, all with NvMBlockJobPriority=0, NvMBlockUseAutoValidation=0, NvMBlockUseCRCCompMechanism=0, NvMBlockUseSetRamBlockStatus=1, NvMBlockUseSyncMechanism=0, NvMBlockWriteProt=0, NvMBswMBlockStatusInformation=0, NvMNvramDeviceId=0, NvMResistantToChangedSw=0, NvMRomBlockNum=0, NvMStaticBlockIDCheck=0, NvMWriteBlockOnce=0, NvMWriteVerification=0, NvMWriteVerificationDataSize=1:
      NvMBlockDescriptor_Cfg: NvMBlockManagementType=NVM_BLOCK_REDUNDANT, NvMBlockUseCrc=1, NvMMaxNumOfReadRetries=0, NvMMaxNumOfWriteRetries=0, NvMNvBlockBaseNumber=1, NvMNvBlockLength=100, NvMNvBlockNum=2, NvMNvramBlockIdentifier=1, NvMBlockCrcType=NVM_CRC16, NvMSelectBlockForReadAll=0, NvMSelectBlockForWriteAll=0, NvMRamBlockDataAddress=NvM_Cfg_Ram
        NvMTargetBlockReference
          NvMEaRef: NvMNameOfEaBlock=EaBlockConfiguration_Cfg
      NvMBlockDescriptor_Appl: NvMBlockManagementType=NVM_BLOCK_NATIVE, NvMBlockUseCrc=0, NvMMaxNumOfReadRetries=0, NvMMaxNumOfWriteRetries=0, NvMNvBlockBaseNumber=2, NvMNvBlockLength=256, NvMNvBlockNum=1, NvMNvramBlockIdentifier=2, NvMRamBlockDataAddress=NvM_Cfg_Appl
        NvMTargetBlockReference
          NvMEaRef: NvMNameOfEaBlock=EaBlockConfiguration_Appl
      NvMBlockDescriptor_BSW: NvMBlockManagementType=NVM_BLOCK_REDUNDANT, NvMBlockUseCrc=0, NvMMaxNumOfReadRetries=1, NvMMaxNumOfWriteRetries=1, NvMNvBlockBaseNumber=1, NvMNvBlockLength=256, NvMNvBlockNum=2, NvMNvramBlockIdentifier=3, NvMRamBlockDataAddress=NvM_Cfg_BSW
        NvMTargetBlockReference
          NvMEaRef: NvMNameOfEaBlock=EaBlockConfiguration_BSW
  module config Ea: ecuc-def-edition=1.0.0, implementation-config-variant=VARIANT-LINK-TIME, module-description=BswImpl_Ea
    EaGeneral:
      EaDevErrorDetect = 0
      EaMainFunctionPeriod = 0.01
      EaPollingMode = 0
      EaSetModeSupported = 1
      EaVersionInfoApi = 1
      EaVirtualPageSize = 64
      EaIndex = 1
      EaVersionCheckForeignModule = 0
      EaNvmJobEndNotification = NvM_JobEndNotification
      EaNvmJobErrorNotification = NvM_JobErrorNotification
    EaPublishedInformation: EaBlockOverhead=0, EaPageOverhead=0, EaMaximumBlockingTime=1.0
    3 x EaBlockConfiguration, all with EaImmediateData=0, EaNumberOfWriteCycles=10000, EaDeviceIndex=EepGeneral:
      EaBlockConfiguration_Cfg: EaBlockNumber=2, EaBlockSize=100
      EaBlockConfiguration_BSW: EaBlockNumber=2, EaBlockSize=100
      EaBlockConfiguration_Appl: EaBlockNumber=4, EaBlockSize=256
