AUTOSAR XML (schema 4-2-1)
package /LinTrcv_UJA1132
  module config LinTrcv_SBC: definition=LinTrcv, ecuc-def-edition=1.0.0, implementation-config-variant=VARIANT-LINK-TIME, module-description=LinTrcv_UJA1132BswImp
    LinTrcvChannel:
      LinTrcvChannelId = 0
      LinTrcvChannelUsed = 1
      LinTrcvInitState = LINTRCV_TRCV_MODE_NORMAL
      LinTrcvWakeupByBusUsed = 0
      LinTrcvName = LIN1
      LinTrcvRxDioPin = DioChannel_SBC_INT1
      LinTrcvAccess
        LinTrcvSpiSequence: LinTrcvSpiSequenceName=SpiSequence_SBC
    LinTrcvGeneral:
      LinTrcvDevErrorDetect = 0
      LinTrcvGetVersionInfo = 0
      LinTrcvIndex = 0
      LinTrcvWakeUpSupport = 0
      LinTrcvSBCSIUsage = 0
      LinTrcvWaitCount = 0
      LinTrcvTimerType = None
      LinTrcvVersionCheckForeignModule = 0
