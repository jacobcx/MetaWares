AUTOSAR XML (schema 4-2-1)
package /Mcu
  module config Mcu: ecuc-def-edition=1.0.0, implementation-config-variant=VARIANT-POST-BUILD, module-description=BswImplementation_0
    McuGeneralConfiguration:
      McuDevErrorDetect = 0
      McuVersionInfoApi = 0
      McuGetRamStateApi = 0
      McuInitClock = 1
      McuNoPll = 0
      McuEnterLowPowerMode = 1
      McuTimeout = 10000
      McuEnableUserModeSupport = 0
      McuPerformResetApi = 0
      McuCalloutBeforePerformReset = 0
      McuPerformResetCallout = NULL_PTR
    McuDebugConfiguration:
      McuDisableDemReportErrorStatus = 0
      McuGetPeriphStateApi = 0
      McuGetSystemStatetApi = 0
      McuGetPowerModeStatetApi = 0
      McuGetPowerDomainApi = 0
      McuSscmGetMemConfigApi = 0
      McuSscmGetStatusApi = 0
      McuGetMidrStructureApi = 0
      McuEmiosConfigureGprenApi = 0
      McuDisableCmuApi = 0
    McuCoreControlConfiguration: McuCADDRnControl=0
    McuEMIOSConfiguration: McuEMIOSControl=1
    McuPublishedInformation
      21 x McuResetReasonConf:
        MCU_EDR_RESET: McuResetReason=6
        MCU_EXR_RESET: McuResetReason=12
        MCU_EXT_POWER_ON_RESET: McuResetReason=1
        MCU_FCCU_HARD_RESET: McuResetReason=15
        MCU_FCCU_SOFT_RESET: McuResetReason=16
        MCU_FFRR_RESET: McuResetReason=3
        MCU_FIF_RESET: McuResetReason=7
        MCU_JTAG_DEST_RESET: McuResetReason=8
        MCU_JTAG_FUNC_RESET: McuResetReason=17
        MCU_PMC_RESET: McuResetReason=11
        MCU_POWER_ON_RESET: McuResetReason=0
        MCU_RESET_UNDEFINED: McuResetReason=22
        MCU_SOFT_DEST_RESET: McuResetReason=2
        MCU_SOFT_FUNC_RESET: McuResetReason=14
        MCU_SSR_RESET: McuResetReason=5
        MCU_ST_DONE_RESET: McuResetReason=13
        MCU_SUF_RESET: McuResetReason=4
        MCU_TSR_DEST_RESET: McuResetReason=9
        MCU_TSR_FUNC_RESET: McuResetReason=18
        MCU_VOR_DEST_RESET: McuResetReason=10
        MCU_VOR_FUNC_RESET: McuResetReason=19
    CommonPublishedInformation:
      ArReleaseMajorVersion = 4
      ArReleaseMinorVersion = 0
      ArReleaseRevisionVersion = 3
      ModuleId = 101
      SwMajorVersion = 1
      SwMinorVersion = 0
      SwPatchVersion = 2
      VendorApiInfix = (unset)
      VendorId = 43
    McuModuleConfiguration: McuNumberOfMcuModes=1, McuCrystalFrequencyHz=4.0E7, McuClockSrcFailureNotification=ENABLED, McuRamSectors=1
      McuClockSettingConfig: McuClockSettingId=1, McuSystemClockFrequency=2.0E8, McuSystemClockSwitch=PLL0_PHI, McuClkSetXOSC_En=1, McuClkSetPLL0_En=1, McuClkSetPLL1_En=0
        McuXOSC: McuXoscUnderMcuControl=1, McuXoscByPass=0, McuXoscCounter=100
        Mcu16MHzIRC: McuIrcUnderMcuControl=0, McuIRC_Trim=0
        McuProgClkSwitch: McuProgresSwitchDuration=0
          3 x McuPcsConfig, all with McuPCS_DivInit=999, McuPCS_DivRate=0, McuPCS_DivStart=999, McuPCS_DivEnd=999:
            McuPcsConfig: McuPCS_Name=PCS_1
            McuPcsConfig1: McuPCS_Name=PCS_2
            McuPcsConfig2: McuPCS_Name=PCS_4
        McuDividerUpdate:
          McuAuxiliaryClock10DividerUpdate = 1
          McuAuxiliaryClock9DividerUpdate = 1
          McuAuxiliaryClock8DividerUpdate = 1
          McuAuxiliaryClock6DividerUpdate = 1
          McuAuxiliaryClock5DividerUpdate = 1
          McuAuxiliaryClock2DividerUpdate = 1
          McuAuxiliaryClock1DividerUpdate = 1
          McuAuxiliaryClock0DividerUpdate = 1
        McuSystemClockDivider: McuClksysClockMcuControl=1
          McuSystemClockDivider0: McuSystemClockClk=2.0E8, McuSystemClockEn=1, McuSystemClockDivider=1
          McuSystemClockDivider1: McuSystemClockClk=1.0E8, McuSystemClockEn=1, McuSystemClockDivider=2
          McuSystemClockDivider2: McuSystemClockClk=5.0E7, McuSystemClockEn=1, McuSystemClockDivider=4
        McuAuxClock0: McuAuxClockUnderMcuControl=1, McuAuxClk0_Source=PLL0_PHI
          McuAuxiliaryClock0Divider0: McuAuxiliaryClock0Divider0_Clk=5.0E7, McuAuxClk0Div0_En=1, McuAuxClk0Div0_Divisor=4
          McuAuxiliaryClock0Divider1: McuAuxiliaryClock0Divider1_Clk=1.0E7, McuAuxClk0Div1_En=1, McuAuxClk0Div1_Divisor=20
          McuAuxiliaryClock0Divider2: McuAuxiliaryClock0Divider2_Clk=2.0E7, McuAuxClk0Div2_En=1, McuAuxClk0Div2_Divisor=10
          McuAuxiliaryClock0Divider3: McuAuxiliaryClock0Divider3_Clk=4.0E7, McuAuxClk0Div3_En=1, McuAuxClk0Div3_Divisor=5, McuAuxClk0Div3_DivFmt=0
          McuAuxiliaryClock0Divider4: McuAuxiliaryClock0Divider4_Clk=4.0E7, McuAuxClk0Div4_En=1, McuAuxClk0Div4_Divisor=5
        McuAuxClock1: McuAuxClockUnderMcuControl=1, McuAuxClk1_Source=PLL0_PHI, McuSipiClkIn=2.0E7
          McuAuxiliaryClock1Divider0: McuAuxiliaryClock1Divider0_Clk=2.0E7, McuAuxClk1Div0_En=1, McuAuxClk1Div0_Divisor=10
        McuAuxClock2: McuAuxClockUnderMcuControl=1, McuAuxClk2_Source=PLL0_PHI
          McuAuxiliaryClock2Divider0: McuAuxiliaryClock2Divider0_Clk=4.0E7, McuAuxClk2Div0_En=1, McuAuxClk2Div0_Divisor=5
        McuAuxClock3: McuAuxClockUnderMcuControl=1, McuAuxClk3_Source=XOSC, McuAuxClk3_Frequency=4.0E7
        McuAuxClock4: McuAuxClockUnderMcuControl=1, McuAuxClk4_Source=XOSC, McuAuxClk4_Frequency=4.0E7
        McuAuxClock5: McuAuxClockUnderMcuControl=1, McuAuxClk5_Source=PLL0_PHI
          McuAuxiliaryClock5Divider0: McuAuxiliaryClock5Divider0_Clk=1.0E8, McuAuxClk5Div0_En=1, McuAuxClk5Div0_Divisor=2
          McuAuxiliaryClock5Divider1: McuAuxiliaryClock5Divider1_Clk=1.0E8, McuAuxClk5Div1_En=1, McuAuxClk5Div1_Divisor=2
        McuAuxClock6: McuAuxClockUnderMcuControl=1, McuAuxClk6_Source=PLL0_PHI
          McuAuxiliaryClock6Divider0: McuAuxiliaryClock6Divider0_Clk=4.0E7, McuAuxClk6Div0_En=1, McuAuxClk6Div0_Divisor=5
        McuAuxClock8: McuAuxClockUnderMcuControl=1, McuAuxClk8_Source=PLL0_PHI
          McuAuxiliaryClock8Divider0: McuAuxiliaryClock8Divider0_Clk=4.0E7, McuAuxClk8Div0_En=1, McuAuxClk8Div0_Divisor=5
        McuAuxClock9: McuAuxClockUnderMcuControl=1, McuAuxClk9_Source=XOSC
          McuAuxiliaryClock9Divider0: McuAuxiliaryClock9Divider0_Clk=4.0E7, McuAuxClk9Div0_En=1, McuAuxClk9Div0_Divisor=1
        McuAuxClock10: McuAuxClockUnderMcuControl=1, McuAuxClk10_Source=PLL0_PHI
          McuAuxiliaryClock10Divider0: McuAuxiliaryClock10Divider0_Clk=4.0E7, McuAuxClk10Div0_En=1, McuAuxClk10Div0_Divisor=5
        McuPll_0: McuPllUnderMcuControl=1
          McuPll0_Parameter:
            PLL0_PHI_Frequency = 2.0E8
            PLL0_PHI1_Frequency = 4.0E7
            PLL0_VCO_Frequency = 8.0E8
            McuInputClkPreDivider = 2
            McuPHI_ReducedFreqDivider = 2
            McuPHI1_ReducedFreqDivider = 10
            McuLoopMultiplicationClkDivider = 20
            McuExternalPowerDownCycleInt = 0
            McuLossOfLockInt = 0
            McuLossOfLockReset = 0
        McuPll_1: McuPllUnderMcuControl=1
          McuPll1_Parameter:
            PLL1_PHI_Frequency = 1.6E8
            PLL1_VCO_Frequency = 6.4E8
            McuPHI_ReducedFreqDivider = 2
            McuLoopMultiplicationClkDivider = 16
            McuExternalPowerDownCycleInt = 0
            McuLossOfLockInt = 0
            McuLossOfLockReset = 0
            McuModulationEnable = 0
            McuFracDivEnable = 0
          McuFmPll1_Parameter: McuModulationPeriod=0, McuModulationIncrementStep=0, McuSpreadSelection=Down_Spread
          McuFdPll1_Parameter: McuDthDisable=0, McuFractionalDivider=0
        McuEMIOS
          McuEMIOS_0:
            McuEMIOS_Clk = 1.0E8
            McuMdisBit = 0
            McuFreezeBit = 0
            McuGlobalTimeBaseEnable = 1
            McuExternalTimeBase = 0
            McuGlobalPrescalerEnable = 1
            McuServerTimeSlot = 0
            McuGlobalPrescaler = 1
          McuEMIOS_1:
            McuEMIOS_Clk = 1.0E8
            McuMdisBit = 0
            McuFreezeBit = 0
            McuGlobalTimeBaseEnable = 1
            McuExternalTimeBase = 0
            McuGlobalPrescalerEnable = 1
            McuServerTimeSlot = 0
            McuGlobalPrescaler = 1
        McuClkMonitor_0: McuClkMonitorEn=0, McuRCDivisorFactor=DIV_8, McuHighFrequencyRef=4095, McuLowFrequencyRef=0
        McuClkMonitor_{1..9}: McuClkMonitorEn=0, McuHighFrequencyRef=4095, McuLowFrequencyRef=0
        McuClkMonitor_12: McuClkMonitorEn=0, McuHighFrequencyRef=4095, McuLowFrequencyRef=0
        McuFlash: McuFlashAddrPipelineControl=2, McuFlashReadWaitStateControl=5
        McuRam: McuRam_PRI=2, McuRam_P1_BO_DIS=0, McuRam_P0_BO_DIS=0, McuRam_FT_DIS=0
        7 x McuClockReferencePoint:
          McuClockReferencePoint_SystemClk: McuClockReferencePointFrequency=2.0E8, McuClockFrequencySelect=SYS_CLK
          McuClockReferencePoint_SPI: McuClockReferencePointFrequency=4.0E7, McuClockFrequencySelect=DSPI_CLK1
          McuClockReferencePoint_CAN: McuClockReferencePointFrequency=4.0E7, McuClockFrequencySelect=FLEXCAN_CLK
          McuClockReferencePoint_eMIOS: McuClockReferencePointFrequency=1.0E8, McuClockFrequencySelect=eMIOS_CLK
          McuClockReferencePoint_LIN: McuClockReferencePointFrequency=1.0E8, McuClockFrequencySelect=LIN_CLK
          McuClockReferencePoint_PER: McuClockReferencePointFrequency=5.0E7, McuClockFrequencySelect=PER_CLK
          McuClockReferencePoint_PBRIDGEx: McuClockReferencePointFrequency=5.0E7, McuClockFrequencySelect=PBRIDGEA_CLK
      McuModeSettingConf:
        McuMode = 1
        McuPowerMode = DRUN
        McuSystemClockSwitch = XOSC
        McuIRCOscControl = 1
        McuXOSCControl = 1
        McuSystemFMPLLControl = 0
        McuSecondaryFMPLLControl = 0
        McuFlashPowerControl = NormalMode
        McuMainVoltageRegulatorControl = 1
        McuOutputPowerDownControl = 0
        McuPowerLevelControl = 0
        McuFastTransition = 0
        McuCoreConfiguration:
          McuCore0ResetEnable = 0
          McuCore0DefaultBootAddrEnable = 0
          McuCore0BootAddr = 0
          McuCore1ResetEnable = 0
          McuCore1DefaultBootAddrEnable = 0
          McuCore1BootAddr = 0
          McuCore0sResetEnable = 0
          McuCore0sDefaultBootAddrEnable = 0
          McuCore0sResetAddr = 0
        McuModeSettingConfAfterWkp:
          McuSystemClockSwitch = XOSC
          McuIRCOscControl = 1
          McuXOSCControl = 1
          McuSystemFMPLLControl = 0
          McuSecondaryFMPLLControl = 0
          McuFlashPowerControl = NormalMode
          McuMainVoltageRegulatorControl = 1
          McuOutputPowerDownControl = 0
          McuPowerLevelControl = 0
      McuEnableMode: McuModeStop0=1, McuModeHalt0=1, McuModeRun3=1, McuModeRun2=1, McuModeRun1=1, McuModeTest=0
      McuCoreConfiguration
        McuCore0Configuration:
          McuCoreReset = 0
          McuUseDefaultBootAddrEnable = 0
          McuBootAddress = 0
          McuCCTL0Run3 = 1
          McuCCTL0Run2 = 1
          McuCCTL0Run1 = 1
          McuCCTL0Run0 = 1
          McuCCTL0Drun = 1
          McuCCTL0Safe = 1
          McuCCTL0Test = 1
        McuCore1Configuration:
          McuCoreReset = 0
          McuUseDefaultBootAddrEnable = 0
          McuBootAddress = 0
          McuCCTL1Run3 = 1
          McuCCTL1Run2 = 1
          McuCCTL1Run1 = 1
          McuCCTL1Run0 = 1
          McuCCTL1Drun = 1
          McuCCTL1Safe = 1
          McuCCTL1Test = 1
        McuCore0sConfiguration:
          McuCoreReset = 0
          McuUseDefaultBootAddrEnable = 0
          McuBootAddress = 0
          McuCCTL2Run3 = 0
          McuCCTL2Run2 = 0
          McuCCTL2Run1 = 0
          McuCCTL2Run0 = 0
          McuCCTL2Drun = 0
          McuCCTL2Safe = 0
          McuCCTL2Test = 0
      McuInterruptTransition: McuTransitionComplete=0, McuSafeMode=0, McuInvalidMode=0, McuInvalidConfiguration=0, McuInvalidClockConfiguration=0, McuInvalidCoreConfiguration=0
      McuInterruptEvents: McuAlternateResetEvent=0, McuVoltageErrorEvent=0, McuTemperatureErrorEvent=0
      McuPlatformFlashConfig
        McuPFCR1:
          McuPort0Master15Prefetch = 0
          McuPort0Master14Prefetch = 0
          McuPort0Master13Prefetch = 0
          McuPort0Master12Prefetch = 0
          McuPort0Master11Prefetch = 0
          McuPort0Master10Prefetch = 0
          McuPort0Master9Prefetch = 0
          McuPort0Master8Prefetch = 0
          McuPort0Master7Prefetch = 0
          McuPort0Master6Prefetch = 0
          McuPort0Master5Prefetch = 0
          McuPort0Master4Prefetch = 0
          McuPort0Master3Prefetch = 0
          McuPort0Master2Prefetch = 0
          McuPort0Master1Prefetch = 0
          McuPort0Master0Prefetch = 0
          McuPort0DataPrefetch = 0
          McuPort0InstructionPrefetch = 0
          McuPort0PrefetchLimit = 0
          McuPort0ReadBufferEnable = 1
        McuPFCR2:
          McuPort1Master15Prefetch = 0
          McuPort1Master14Prefetch = 0
          McuPort1Master13Prefetch = 0
          McuPort1Master12Prefetch = 0
          McuPort1Master11Prefetch = 0
          McuPort1Master10Prefetch = 0
          McuPort1Master9Prefetch = 0
          McuPort1Master8Prefetch = 0
          McuPort1Master7Prefetch = 0
          McuPort1Master6Prefetch = 0
          McuPort1Master5Prefetch = 0
          McuPort1Master4Prefetch = 0
          McuPort1Master3Prefetch = 0
          McuPort1Master2Prefetch = 0
          McuPort1Master1Prefetch = 0
          McuPort1Master0Prefetch = 0
          McuPort1DataPrefetch = 0
          McuPort1InstructionPrefetch = 0
          McuPort1PrefetchLimit = 0
          McuPort1ReadBufferEnable = 1
        McuPFCR3:
          McuPort0PageBufferConfiguration = 0
          McuPort1LineBufferConfiguration = 0
          McuBuddyDeviceReadMode = 0
          McuBAFDisable = 0
          McuArbitrationMode = 0
          McuDataErrorSuppression = 0
        McuPFAPR:
          McuMaster{0..15}AccessProt = 3
      8 x McuRunConfig, all with McuModeRun3=1, McuModeRun2=1, McuModeRun1=1, McuModeRun0=1, McuModeDRun=1, McuModeSafe=1, McuModeTest=0:
        McuRunConfig
        McuRunConfig{1..7}
      8 x McuLowPowerConfig, all with McuStop0=0, McuHalt0=0:
        McuLowPowerConfig
        McuLowPowerConfig{1..7}
      48 x McuPeripheral, all with McuPerDBGConfig=0, McuPerRunConfig=McuRunConfig, McuPerLowPwrConfig=McuLowPowerConfig:
        McuPeripheral: McuPerName=PCTL9_LFAST_0
        McuPeripheral1: McuPerName=PCTL11_SIPI_0
        McuPeripheral2: McuPerName=PCTL15_SIUL2
        McuPeripheral3: McuPerName=PCTL28_DECFILT_1
        McuPeripheral4: McuPerName=PCTL29_DECFILT_0
        McuPeripheral5: McuPerName=PCTL30_PIT_RTI_0
        McuPeripheral6: McuPerName=PCTL31_PIT_RTI_1
        McuPeripheral7: McuPerName=PCTL36_DMA_CH_MUX_0_2
        McuPeripheral8: McuPerName=PCTL38_CRC_0
        McuPeripheral9: McuPerName=PCTL45_JTAGM
        McuPeripheral10: McuPerName=PCTL59_ADCSD_2
        McuPeripheral11: McuPerName=PCTL60_ADCSD_0
        McuPeripheral12: McuPerName=PCTL69_ADCSAR_2
        McuPeripheral13: McuPerName=PCTL71_ADCSAR_0
        McuPeripheral14: McuPerName=PCTL81_FLEXCAN_2
        McuPeripheral15: McuPerName=PCTL83_FLEXCAN_0
        McuPeripheral16: McuPerName=PCTL85_LINFLEX_M0
        McuPeripheral17: McuPerName=PCTL91_LINFLEX_2
        McuPeripheral18: McuPerName=PCTL92_LINFLEX_0
        McuPeripheral19: McuPerName=PCTL96_DSPI_M0
        McuPeripheral20: McuPerName=PCTL97_DSPI_4
        McuPeripheral21: McuPerName=PCTL98_DSPI_2
        McuPeripheral22: McuPerName=PCTL99_DSPI_0
        McuPeripheral23: McuPerName=PCTL102_EMIOS
        McuPeripheral24: McuPerName=PCTL104_SENT_0
        McuPeripheral25: McuPerName=PCTL143_DMA_CH_MUX_3
        McuPeripheral26: McuPerName=PCTL166_CRC_1
        McuPeripheral27: McuPerName=PCTL188_ADCSD_1
        McuPeripheral28: McuPerName=PCTL196_ADCSAR_3
        McuPeripheral29: McuPerName=PCTL197_IGF
        McuPeripheral30: McuPerName=PCTL198_ADCSAR_1
        McuPeripheral31: McuPerName=PCTL202_ETPU_SCRAM_1
        McuPeripheral32: McuPerName=PCTL203_ETPU_SCRAM_2
        McuPeripheral33: McuPerName=PCTL204_ETPU_SPRAM_1
        McuPeripheral34: McuPerName=PCTL205_ETPU_SPRAM_2
        McuPeripheral35: McuPerName=PCTL206_REACM
        McuPeripheral36: McuPerName=PCTL207_ETPU
        McuPeripheral37: McuPerName=PCTL208_FLEXCAN_3
        McuPeripheral38: McuPerName=PCTL210_FLEXCAN_1
        McuPeripheral39: McuPerName=PCTL213_LINFLEX_M1
        McuPeripheral40: McuPerName=PCTL219_LINFLEX_3
        McuPeripheral41: McuPerName=PCTL220_LINFLEX_1
        McuPeripheral42: McuPerName=PCTL225_DSPI_M1
        McuPeripheral43: McuPerName=PCTL226_DSPI_3
        McuPeripheral44: McuPerName=PCTL227_DSPI_1
        McuPeripheral45: McuPerName=PCTL230_EMIOS_1
        McuPeripheral46: McuPerName=PCTL232_SENT_1
        McuPeripheral47: McuPerName=PCTL251_BTCU
      McuResetConfig: McuResetType=FunctionalReset, McuFuncResetEscThreshold=15, McuDestResetEscThreshold=8
        McuPMC_STF_ResetSource: McuResetPin=0
        McuVOR_DEST_ResetSource: McuDisableReset=0, McuResetPin=0
        McuTSR_DEST_ResetSource: McuDisableReset=0, McuResetPin=0
        McuJTAG_DEST_ResetSource: McuDisableReset=0, McuResetPin=1
        McuFIF_ResetSource: McuDisableReset=0, McuResetPin=0
        McuEDR_ResetSource: McuDisableReset=0, McuResetPin=0
        McuSUF_ResetSource: McuDisableReset=0, McuResetPin=0
        McuFFRR_ResetSource: McuDisableReset=0, McuResetPin=0
        McuSOFT_DEST_ResetSource: McuDisableReset=0, McuResetPin=0
        McuPORST_ResetSource: McuDisableReset=0, McuEnableInterruptSafe=0, McuResetPin=0
        McuPOR_ResetSource: McuResetPin=0
        McuVOR_FUNC_ResetSource: McuDisableReset=0, McuEnableInterruptSafe=0, McuResetPhase=PHASE_1, McuResetPin=1
        McuTSR_FUNC_ResetSource: McuDisableReset=0, McuEnableInterruptSafe=0, McuResetPhase=PHASE_1, McuResetPin=1
        McuJTAG_FUNC_ResetSource: McuDisableReset=0, McuResetPhase=PHASE_1, McuResetPin=1
        McuFCCU_SOFT_ResetSource: McuDisableReset=0, McuResetPhase=PHASE_3, McuResetPin=1
        McuFCCU_HARD_ResetSource: McuDisableReset=0, McuResetPhase=PHASE_1, McuResetPin=1
        McuSOFT_FUNC_ResetSource: McuDisableReset=0, McuResetPhase=PHASE_1, McuResetPin=1
        McuST_DONE_ResetSource: McuDisableReset=0, McuResetPhase=PHASE_1, McuResetPin=0
        McuESR0_ResetSource: McuResetPhase=PHASE_1, McuResetPin=0
      McuPowerControl
        McuTempSensorInterruptConfig: McuTS_EN=0, McuTS1_2IE=0, McuTS1_0IE=0, McuTS0_2IE=0, McuTS0_0IE=0
        McuTempResetEventEnConfig: McuTEMP1_2=0, McuTEMP1_0=0, McuTEMP0_2=0, McuTEMP0_0=0
        McuTempResetEventSelConfig: McuTEMP1_2=0, McuTEMP1_0=0, McuTEMP0_2=0, McuTEMP0_0=0
        McuTempDetectorConfig: McuTS1_DOUT_EN=1, McuTS0_DOUT_EN=1
        McuVoltageInterruptConfig: McuPMCEnable=0, McuLVD_PMC=0, McuLVD_SAR_ADC=0, McuLVD_IO=0, McuHVD_FLASH=0, McuLVD_FLASH=0, McuHVD_HV=0, McuHVD_CORE=0, McuLVD_CORE_HOT=0, McuLVD_CORE_COLD=0
        McuResetEventEnConfig: McuLVD_SAR_ADC=0, McuHVD_FLASH=0, McuHVD_HV=0, McuHVD_CORE=0, McuLVD_CORE_COLD=0
        McuResetEventSelConfig: McuLVD_SAR_ADC=0, McuHVD_FLASH=0, McuHVD_HV=0, McuHVD_CORE=0, McuLVD_CORE_COLD=0
      McuRamSectorSettingConf:
        McuRamSectorId = 0
        McuRamDefaultValue = 0
        McuRamSectionBaseAddress = 1073938176
        McuRamSectionSize = 256
        McuRamSectionBaseAddrLinkerSym = (unset)
        McuRamSectionSizeLinkerSym = (unset)
