AUTOSAR XML (schema 4-0-3)
package /TJA1145
  module config CanTrcv_TJA1145: definition=CanTrcv, ecuc-def-edition=1.0.0, implementation-config-variant=VARIANT-POST-BUILD, module-description=CanTrcvBswImp
    CanTrcvConfigSet: CanTrcvSPICommRetries=0, CanTrcvSPICommTimeout=0
      CanTrcvChannel_CANA (CanTrcvChannel):
        CanTrcvChannelId = 0
        CanTrcvChannelUsed = 1
        CanTrcvControlsPowerSupply = 0
        CanTrcvHwPnSupport = 0
        CanTrcvInitState = CANTRCV_OP_MODE_NORMAL
        CanTrcvMaxBaudrate = 1000
        CanTrcvWakeOnRisingEdge = 0
        CanTrcvWakeOnFallingEdge = 0
        CanTrcvWakeupByBusUsed = 0
        CanTrcvPorWakeupSourceRef = EcuMWakeupSource
        CanTrcvSyserrWakeupSourceRef = EcuMWakeupSource
        CanTrcvAccess
          CanTrcvSpiAccess
            CanTrcvSpiSequence: CanTrcvSpiAccessSynchronous=1, CanTrcvSpiSequenceName=SpiSequence_CANA_TJA1145
      CanTrcvChannel_CAND (CanTrcvChannel):
        CanTrcvChannelId = 1
        CanTrcvChannelUsed = 1
        CanTrcvControlsPowerSupply = 0
        CanTrcvHwPnSupport = 0
        CanTrcvInitState = CANTRCV_OP_MODE_NORMAL
        CanTrcvMaxBaudrate = 1000
        CanTrcvWakeOnRisingEdge = 0
        CanTrcvWakeOnFallingEdge = 0
        CanTrcvWakeupByBusUsed = 0
        CanTrcvPorWakeupSourceRef = EcuMWakeupSource
        CanTrcvSyserrWakeupSourceRef = EcuMWakeupSource
        CanTrcvAccess
          CanTrcvSpiAccess
            CanTrcvSpiSequence: CanTrcvSpiAccessSynchronous=1, CanTrcvSpiSequenceName=SpiSequence_CAND_TJA1145
    CanTrcvGeneral:
      CanTrcvDevErrorDetect = 0
      CanTrcvGetVersionInfo = 0
      CanTrcvIndex = 0
      CanTrcvWakeUpSupport = CANTRCV_WAKEUP_NOT_SUPPORTED
      CanTrcvMainFunctionTimePeriod = 0.01
      CanTrcvMainFunctionDiagnosticsTimePeriod = 0.01
      CanTrcvPnGlobalSupport = 0
      CanTrcvWaitCount = 10000
      CanTrcvSPICommRetries = 0
      CanTrcvSPICommTimeout = 0
      CanTrcvFailureDetection = 0
      CanTrcvFDSupport = 0
      CanTrcvSilenceDetection = 0
      CanTrcvVersionCheckForeginModule = 0
      CanTrcvWakeUpDetection = 0
