AUTOSAR XML (schema 4-2-2)
package /Adc
  module config Adc: ecuc-def-edition=1.0.0, implementation-config-variant=VARIANT-POST-BUILD, module-description=BswImplementation_0
    AdcConfigSet
      AdcHwUnit:
        AdcTransferType = ADC_INTERRUPT
        AdcHwUnitId = ADC0
        AdcLogicalUnitId = 0
        AdcAltPrescale = 2
        AdcPowerDownDelay = 15
        AdcAltPowerDownDelay = 15
        AdcMuxDelay = 15
        AdcAutoClockOff = 0
        AdcBypassSampling = 0
        AdcPresamplingInternalSignal{0..2} = VSS_HV_ADV_SAR
        AdcChannel: AdcLogicalChannelId=0, AdcChannelId=AN_0, AdcChannelResolution=12, AdcEnablePresampling=0, AdcEnableThresholds=0, AdcWdogNotification=NULL_PTR
        AdcGroup:
          AdcGroupAccessMode = ADC_ACCESS_MODE_SINGLE
          AdcGroupConversionMode = ADC_CONV_MODE_ONESHOT
          AdcGroupConversionType = ADC_CONV_TYPE_NORMAL
          AdcGroupId = 0
          AdcGroupTriggSrc = ADC_TRIGG_SRC_SW
          AdcExtraNotification = NULL_PTR
          AdcStreamingBufferMode = ADC_STREAM_BUFFER_LINEAR
          AdcEnableDoubleBuffering = 0
          AdcStreamingNumSamples = 1
          AdcEnableChDisableChGroup = 0
          AdcWithoutInterrupts = 0
          AdcMultipleHardwareTriggerGroup = 0
          AdcGroupDefinition = AdcChannel
          AdcGroupConversionConfiguration: AdcSamplingDuration=8, AdcSamplingDuration1=8, AdcSamplingDuration2=8
          AdcAlternateGroupConvTimings: AdcAltGroupSamplingDuration=8, AdcAltGroupSamplingDuration1=8, AdcAltGroupSamplingDuration2=8
    AdcGeneral:
      AdcDeInitApi = 1
      AdcDevErrorDetect = 0
      AdcEnableUserModeSupport = 0
      AdcEnableLimitCheck = 1
      AdcEnableQueuing = 1
      AdcEnableStartStopGroupApi = 1
      AdcGrpNotifCapability = 1
      AdcHwTriggerApi = 0
      AdcReadGroupApi = 1
      AdcVersionInfoApi = 1
      AdcPriorityImplementation = ADC_PRIORITY_NONE
      AdcResultAlignment = ADC_ALIGN_RIGHT
      AdcSetOnceRegisters = 0
      AdcTimeout = 65535
      AdcPriorityQueueMaxDepth = 1
    AdcPublishedInformation: AdcChannelValueSigned=0, AdcGroupFirstChannelFixed=0, AdcMaxChannelResolution=12
    CommonPublishedInformation:
      ArReleaseMajorVersion = 4
      ArReleaseMinorVersion = 0
      ArReleaseRevisionVersion = 3
      ModuleId = 123
      SwMajorVersion = 1
      SwMinorVersion = 0
      SwPatchVersion = 2
      VendorApiInfix = (unset)
      VendorId = 43
    NonAutosar:
      AdcSetModeApi = 0
      AdcEnableGroupDependentChannelNames = 0
      AdcBypassConsistencyLoop = 0
      AdcEnableChDisableChApi = 0
      AdcGetInjectedConvStatusApi = 0
      AdcConvTimeOnce = 0
      AdcOptimizeOneShotHwTriggerConversions = 0
      AdcEnableDoubleBufferingOptimization = 0
      AdcPreSamplingOnce = 0
      AdcEnableDualClockMode = 0
      AdcEnableThresholdConfiguration = 0
      AdcEnableCalibration = 0
      AdcEnableCtuTrigNonAutosarApi = 0
      AdcEnableCtuControlModeApi = 0
      AdcEnableSetChannel = 0
      AdcEnableInitialNotification = 0
      AdcDisableDemReportErrorStatus = 0
    Safety: AdcRegisterLockingMode=USER_MODE_SOFT_LOCKING
