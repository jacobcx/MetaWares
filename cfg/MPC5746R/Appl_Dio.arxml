AUTOSAR XML (schema 4-2-1)
package /Dio
  module config Dio: ecuc-def-edition=1.0.0, implementation-config-variant=VARIANT-PRE-COMPILE, module-description=BswImplementation_0
    DioConfig
      DioPort: DioPortId=10
        4 x DioChannel:
          DioChannel_LED_B: DioChannelId=0
          DioChannel_LED_A: DioChannelId=1
          DioChannel_LED_C: DioChannelId=2
          DioChannel_LED_D: DioChannelId=5
      DioPort_Z (DioPort): DioPortId=15
        DioChannel_SBC_INT1 (DioChannel): DioChannelId=13
    DioGeneral:
      DioDevErrorDetect = 0
      DioVersionInfoApi = 0
      DioReversePortBits = 0
      DioFlipChannelApi = 1
      DioReadZeroForUndefinedPortPins = 0
      DioMaskedWritePortApi = 1
      DioEnableUserModeSupport = 0
    CommonPublishedInformation:
      ArReleaseMajorVersion = 4
      ArReleaseMinorVersion = 0
      ArReleaseRevisionVersion = 3
      ModuleId = 120
      SwMajorVersion = 1
      SwMinorVersion = 0
      SwPatchVersion = 2
      VendorId = 43
