AUTOSAR XML (schema 4-2-1)
package /Mcal_Dem
  module config Dem: ecuc-def-edition=1.0.0, implementation-config-variant=VARIANT-POST-BUILD, module-description=BswImpl_Dem
    DemConfigSet
      DemEventParameter:
        DemEventAvailable = 1
        DemEventFailureCycleCounterThreshold = 0
        DemEventId = 1
        DemEventKind = DEM_EVENT_KIND_SWC
        DemFFPrestorageSupported = 0
        DemOperationCycleRef = DemOperationCycle
        DemDebounceAlgorithmClass
    DemGeneral:
      DemAgingRequieresTestedCycle = 1
      DemAvailabilitySupport = DEM_NO_AVAILABILITY
      DemClearDTCBehavior = DEM_CLRRESP_VOLATILE
      DemDataElementDefaultEndianness = (unset)
      DemDebounceCounterBasedSupport = 1
      DemDebounceTimeBasedSupport = 0
      DemDevErrorDetect = 1
      DemDtcStatusAvailabilityMask = 255
      DemEventCombinationSupport = (unset)
      DemEventDisplacementStrategy = DEM_DISPLACEMENT_NONE
      DemEventMemoryEntryStorageTrigger = DEM_TRIGGER_ON_TEST_FAILED
      DemGeneralInterfaceSupport = 0
      DemMaxNumberEventEntryPermanent = 3
      DemMaxNumberPrestoredFF = 0
      DemOBDSupport = DEM_OBD_NO_OBD_SUPPORT
      DemOccurrenceCounterProcessing = DEM_PROCESS_OCCCTR_TF
      DemOperationCycleStatusStorage = 1
      DemPTOSupport = 0
      DemResetConfirmedBitOnOverflow = 1
      DemStatusBitHandlingTestFailedSinceLastClear = DEM_STATUS_BIT_NORMAL
      DemStatusBitStorageTestFailed = 1
      DemSuppressionSupport = DEM_NO_SUPPRESSION
      DemTaskTime = 0.02
      DemTriggerDcmReports = 0
      DemTriggerDltReports = 0
      DemTriggerFiMReports = 0
      DemTriggerMonitorInitBeforeClearOk = 1
      DemTypeOfDTCSupported = DEM_DTC_TRANSLATION_ISO14229_1
      DemTypeOfFreezeFrameRecordNumeration = DEM_FF_RECNUM_CONFIGURED
      DemVersionInfoApi = 1
      DemFreezeFrameBufferLength = 1
      DemNumberOfExtendedDataEntries = 10
      DemOperationCycle: DemOperationCycleId=(unset), DemOperationCycleType=DEM_OPCYC_OBD_DCY
      DemPrimaryMemory: DemMaxNumberEventEntryPrimary=10
