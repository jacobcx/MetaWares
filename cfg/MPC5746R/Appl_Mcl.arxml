AUTOSAR XML (schema 4-2-1)
package /Mcl
  module config Mcl: ecuc-def-edition=1.0.0, implementation-config-variant=VARIANT-POST-BUILD, module-description=BswImplementation_0
    MclGeneral:
      MclDisableDemReportErrorStatus = 0
      MclDevErrorDetect = 0
      MclDmaNotificationSupported = 1
      MclErrorChecking = 1
      Mcl_VersionInfoApi = 1
      Mcl_DmaGetChannelErrorStatusApi = 0
      Mcl_DmaGetGlobalErrorStatusApi = 0
      Mcl_DeInitApi = 0
      EnableDMA = 1
      MclEnableCrossbarSwitch = 0
      MclEnableUserModeSupport = 0
      MclErrorNotificationDma0 = NULL_PTR
      64 x MclIsrAvailable, all with MclIsrName=eDMA_0, MclIsrEnabled=1:
        MclIsrAvailable
        MclIsrAvailable{1..63}
    MclConfigSet
      DmaInstance:
        DmaHwInstance = eDMA_Instance0
        MclEDMA_CX = 0
        MclEDMA_ECX = 0
        MclEDMAChGroup{0..3}Priority = {0..3}
        MclEDMA_CLM = 0
        MclEDMA_HALT = 0
        MclEDMA_HOE = 0
        MclEDMA_ERGA = 0
        MclEDMA_ERCA = 0
        MclEDMA_EDBG = 0
      DMAChannel:
        MclDMAChannelId = 0
        DmaHwChannel = eDMA_0
        DMAChannelPriority = 0
        ECP = 0
        DPA = 0
        EMI = 0
        MclDmaTransferCompletionNotif = NULL_PTR
        MclDMAChannelEnable = 0
        MclDMAChannelTriggerEnable = 0
        DmaSource{0..9} = NOT_USED
    CommonPublishedInformation:
      ArReleaseMajorVersion = 4
      ArReleaseMinorVersion = 0
      ArReleaseRevisionVersion = 3
      ModuleId = 255
      SwMajorVersion = 1
      SwMinorVersion = 0
      SwPatchVersion = 2
      VendorId = 43
